/*
 * Auto-generated by scripts/alp_orchestrate.py -- do not edit.
 * Regenerate after changes to board.yaml `ipc:` or the SoM's
 * memory_map block.  #include this file from your kernel /
 * Zephyr DT.
 */

/ {
    reserved-memory {
        #address-cells = <1>;
        #size-cells = <1>;

        alp_default_rpmsg: alp_default_rpmsg@23c0000 {
            compatible = "shared-dma-pool";
            reg = <0x023c0000 0x00040000>;
            no-map;
            label = "alp_default_rpmsg";
        };

    };
};
