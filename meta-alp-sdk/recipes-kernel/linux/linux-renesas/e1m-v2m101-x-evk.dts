// SPDX-License-Identifier: (GPL-2.0-only OR BSD-2-Clause)
/*
 * ALP E1M-V2M101 SoM on the E1M-X-EVK carrier
 * (Renesas RZ/V2N + on-module DEEPX DX-M1 NPU over PCIe).
 * Composition: SoC dtsi (via SoM) -> SoM dtsi -> carrier dtsi -> DEEPX.
 * Builds to renesas/e1m-v2m101-x-evk.dtb.
 * STATUS: UNVALIDATED — first DEEPX PCIe bring-up; verify on the bench.
 */

/dts-v1/;

#include "e1m-v2n-som.dtsi"
#include "e1m-x-evk.dtsi"
#include "e1m-v2m-deepx.dtsi"

/*
 * One dtb serves every V2M SKU: the V2M101/V2M102/V2M103 machines all build
 * this file and U-Boot loads it by this name (CONFIG_ALP_E1M_FDTFILE), since
 * the SKUs differ only in memory/flash population. So "model" names no SKU
 * (a V2M103 used to print "Machine model: ALP E1M-V2M101 ..."); the unit's
 * own SKU comes from its identity EEPROM via U-Boot's /chosen/alp,sku. The
 * root compatible names the shared board design and stays as is: the
 * brcmfmac board-named firmware links (cyw-fmac-firmware) key on it.
 */
/ {
	model = "ALP E1M-V2M on E1M-X-EVK (RZ/V2N + DEEPX DX-M1)";
	compatible = "alp,e1m-v2m101-x-evk",
		     "renesas,r9a09g056n48", "renesas,r9a09g056";

	memory@48000000 {
		device_type = "memory";
		/* First 128 MB reserved for the secure area.  U-Boot
		 * overwrites this node at boot (ARCH_FIXUP_FDT_MEMORY) with
		 * the size from its own control DT inside the FIP, so the
		 * authoritative per-SKU DRAM size lives in the firmware
		 * pack (U-Boot dts + TF-A DDR parameters), not here.  This
		 * value is only the no-fixup fallback. */
		reg = <0x0 0x48000000 0x1 0xf8000000>;
	};
};

/*
 * Per-product core ownership of the assignable peripherals (UART0/1, SPI0,
 * CAN-FD): GENERATED by scripts/gen_linux_ownership_dt.py (or, per project,
 * from the system-manifest by the linux-renesas bbappend).  Included LAST, after
 * the SoM, carrier and board nodes, so the status it sets for a CM33-owned
 * instance (`disabled`) cannot be re-enabled by anything above it.
 */
#include "e1m-v2n-ownership.dtsi"
