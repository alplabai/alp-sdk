// SPDX-License-Identifier: (GPL-2.0-only OR BSD-2-Clause)
/*
 * e1m-v2n101-x-evk plus an opt-in CAM0 camera path (#1149, #2612, #2633).  Built
 * only when ALP_CAMERA_CAM0 = "<module_id>" is set; the bbappend stages the
 * generated fragment e1m-x-evk-cam0-<module_id>.dtsi (scripts/gen_camera_dt.py)
 * under the module-neutral name e1m-x-evk-cam0-sensor.dtsi.  BENCH-UNVERIFIED.
 */
#include "e1m-v2n101-x-evk.dts"
#include "e1m-x-evk-cam0-sensor.dtsi"
