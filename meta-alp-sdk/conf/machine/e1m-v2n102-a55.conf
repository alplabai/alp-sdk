## tests/unit/adc_gd32_bridge_burst/testcase.yaml
```yaml
tests:
  alp.unit.adc_gd32_bridge_burst:
    platform_allow:
      - native_sim
      - native_sim/native/64
    integration_platforms:
      - native_sim
      - native_sim/native/64
    tags:
      - alp
      - adc
      - gd32-bridge
      - unit
```

## tests/unit/adc_stream_begin2_rollback/testcase.yaml
```yaml
tests:
  alp.unit.adc_stream_begin2_rollback:
    platform_allow:
      - native_sim
      - native_sim/native/64
    integration_platforms:
      - native_sim
      - native_sim/native/64
    tags:
      - alp
      - adc
      - gd32-bridge
      - unit
```

## tests/unit/adc_stream_close_slot/testcase.yaml
```yaml
tests:
  alp.unit.adc_stream_close_slot:
    platform_allow:
      - native_sim
      - native_sim/native/64
    integration_platforms:
      - native_sim
      - native_sim/native/64
    tags:
      - alp
      - adc
      - gd32-bridge
      - unit
```

## tests/unit/alif_pdm_burst_plan/testcase.yaml
```yaml
# SPDX-License-Identifier: Apache-2.0
tests:
  alp.unit.alif_pdm_burst_plan:
    platform_allow:
      - native_sim
      - native_sim/native/64
    integration_platforms:
      - native_sim/native/64
    tags:
      - alp
      - aen
      - unit
```

## tests/unit/audio_in_enomsg_timeout/testcase.yaml
```yaml
# SPDX-License-Identifier: Apache-2.0
tests:
  alp.unit.audio_in_enomsg_timeout:
    platform_allow:
      - native_sim
      - native_sim/native/64
    integration_platforms:
      - native_sim
      - native_sim/native/64
    tags:
      - alp
      - audio
      - backend
      - unit
```

## tests/unit/camera_zephyr_video/testcase.yaml
```yaml
# SPDX-License-Identifier: Apache-2.0
tests:
  alp.unit.camera_zephyr_video:
    platform_allow:
      - native_sim
      - native_sim/native/64
    integration_platforms:
      - native_sim
      - native_sim/native/64
    tags:
      - alp
      - camera
      - backend
      - unit
```

## tests/unit/cc3501e_ota_abort_race/testcase.yaml
```yaml
tests:
  alp.unit.cc3501e_ota_abort_race:
    platform_allow:
      - native_sim
      - native_sim/native/64
    integration_platforms:
      - native_sim
      - native_sim/native/64
    tags:
      - alp
      - cc3501e
      - ota
      - unit
```

## tests/unit/gd32_protocol_015/testcase.yaml
```yaml
tests:
  alp.unit.gd32_protocol_015:
    platform_allow:
      - native_sim
      - native_sim/native/64
    integration_platforms:
      - native_sim
      - native_sim/native/64
    tags:
      - alp
      - gd32-bridge
      - unit
```

## tests/unit/gd32_swd_connect_under_reset/testcase.yaml
```yaml
tests:
  alp.unit.gd32_swd_connect_under_reset:
    platform_allow:
      - native_sim
      - native_sim/native/64
    integration_platforms:
      - native_sim
      - native_sim/native/64
    tags:
      - alp
      - gd32-bridge
      - unit
```

## tests/unit/gpio_cc3501e_unrouted/testcase.yaml
```yaml
tests:
  alp.unit.gpio_cc3501e_unrouted:
    platform_allow:
      - native_sim
      - native_sim/native/64
    integration_platforms:
      - native_sim
      - native_sim/native/64
    tags:
      - alp
      - gpio
      - cc3501e
      - backend
      - unit
```

## tests/unit/isp_ae_calib_envelope_sync/testcase.yaml
```yaml
# SPDX-License-Identifier: Apache-2.0
tests:
  alp.unit.isp_ae_calib_envelope_sync:
    platform_allow:
      - native_sim
      - native_sim/native/64
    integration_platforms:
      - native_sim/native/64
    tags:
      - alp
      - unit
      - isp
      - video
```

## tests/unit/isp_ae_ctrl_clamp/testcase.yaml
```yaml
# SPDX-License-Identifier: Apache-2.0
tests:
  alp.unit.isp_ae_ctrl_clamp:
    platform_allow:
      - native_sim
      - native_sim/native/64
    integration_platforms:
      - native_sim/native/64
    tags:
      - alp
      - unit
      - isp
```

## tests/unit/power_som_domains/testcase.yaml
```yaml
tests:
  alp.unit.power_som_domains:
    platform_allow:
      - native_sim
      - native_sim/native/64
    integration_platforms:
      - native_sim/native/64
    tags:
      - alp
      - unit
      - power
  alp.unit.power_som_domains.rail_off:
    extra_args: ALP_TEST_RAIL_OFF=1
    platform_allow:
      - native_sim
      - native_sim/native/64
    integration_platforms:
      - native_sim/native/64
    tags:
      - alp
      - unit
      - power
```

## tests/unit/pwm_gd32_bridge_period/testcase.yaml
```yaml
tests:
  alp.unit.pwm_gd32_bridge_period:
    platform_allow:
      - native_sim
      - native_sim/native/64
    integration_platforms:
      - native_sim
      - native_sim/native/64
    tags:
      - alp
      - pwm
      - gd32-bridge
      - unit
```

## tests/unit/sdhc_dwc_r2_realign/testcase.yaml
```yaml
# SPDX-License-Identifier: Apache-2.0
tests:
  alp.unit.sdhc_dwc_r2_realign:
    platform_allow:
      - native_sim
      - native_sim/native/64
    integration_platforms:
      - native_sim/native/64
    tags:
      - alp
      - aen
      - unit
```
