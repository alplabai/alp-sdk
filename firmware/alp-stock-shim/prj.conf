## CMakeLists.txt
```
# SPDX-License-Identifier: Apache-2.0

cmake_minimum_required(VERSION 3.20)

find_package(Zephyr REQUIRED HINTS $ENV{ZEPHYR_BASE})
project(alp_stock_shim LANGUAGES C)

target_sources(app PRIVATE src/main.c)
# <alp/protocol/amp_beacon.h>: the beacon layout shared with the A55 backend.
target_include_directories(app PRIVATE ${ZEPHYR_ALP_SDK_MODULE_DIR}/include)
```

## prj.conf
```kconfig
# SPDX-License-Identifier: Apache-2.0
#
# Nothing to configure: the beacon is plain memory stores plus k_sleep(), and
# the CM33 has no console on these SoMs.  No CONFIG_ALP_SDK -- the shim calls
# no <alp/*> API.  Board-specific releases of the GD32 link (V2N / V2M CM33)
# live in boards/<board>.conf and boards/<board>.overlay.
```

## boards/alp_e1m_v2m101_m33_sm_r9a09g056n48gbg_cm33.conf
```kconfig
# SPDX-License-Identifier: Apache-2.0
#
# Release the GD32 link (SCI7 SPI on P96 SCK7 / P97 CS): the board defconfig
# enables SPI and the board DTS enables &sci7 and &gpio9 for real CM33
# firmware, which would mux P96/P97 and drive the chip-select at boot.  The
# idle shim must leave them untouched until a real CM33 image takes the link
# (the matching .overlay disables the nodes as well).
CONFIG_SPI=n
CONFIG_GPIO=n
```

## boards/alp_e1m_v2m101_m33_sm_r9a09g056n48gbg_cm33.overlay
```dts
/* SPDX-License-Identifier: Apache-2.0 */

/*
 * The idle stock shim claims no peripheral.  The board DTS enables the GD32
 * link (&sci7 Simple-SPI on P96 SCK7, chip-select P97 on &gpio9) for real
 * CM33 firmware; disable both here so the shim never muxes those pads or
 * drives the chip-select.
 */
&sci7 {
	status = "disabled";
};

&gpio9 {
	status = "disabled";
};
```

## src/main.c
```c
/*
 * Copyright (c) 2026 Alp Lab AB
 * SPDX-License-Identifier: Apache-2.0
 */

/*
 * Liveness beacon for the RZ/V2N / RZ/V2M CM33 stock image.
 *
 * The CM33 has no console on these SoMs (sci0 must stay disabled: a floating
 * RXD faults the core before main), so the only way to tell from Linux that
 * this core is running is memory.  The shim writes the liveness beacon into
 * the last 16 bytes of the `rsctbl` page -- the layout shared with the rpmsg-v2n
 * example and the A55 backend (<alp/protocol/amp_beacon.h>), so the A55 side
 * reads one format.  Linux sees it at the rsctbl page's A55
 * alias (see README.md; the page is the SoC metadata's `openamp_carveout`).
 *
 * Plain stores only.  No peripheral, no interrupt, no IPC (no MHU, no sci0,
 * no RIIC8, no port 9 / GD32 SPI, no DMAC).  The window is the board DTS's
 * `openamp_shm` reservation, which the A55 DT keeps `no-map`, so Linux never
 * hands it out.
 */

#include <zephyr/kernel.h>
#include <zephyr/sys/barrier.h>

#include <alp/protocol/amp_beacon.h>

/* Only the V2N / V2M CM33 boards have the `rsctbl` window; every other core
 * (AEN M55) gets the plain idle loop below. */
#if DT_NODE_EXISTS(DT_NODELABEL(rsctbl))
/* The beacon is the top 16 bytes of the rsctbl page, the same layout the RPC
 * firmware (examples/multicore/rpmsg-v2n/m33_sm) and the A55 backend use:
 * <alp/protocol/amp_beacon.h>.  The page address and size come from the board
 * .dts, generated from the SoC metadata's `openamp_carveout`.  This image
 * publishes the idle-shim version (no RPC); the attach epoch is zeroed once at boot
 * (clearing a stale odd value from a previous image) and never written again. */
#define RSCTBL_BASE DT_REG_ADDR(DT_NODELABEL(rsctbl))
#define RSCTBL_SIZE DT_REG_SIZE(DT_NODELABEL(rsctbl))
#define BEACON      ALP_AMP_BEACON_AT(RSCTBL_BASE, RSCTBL_SIZE)
#endif /* DT_NODE_EXISTS(rsctbl) */

int main(void)
{
#if DT_NODE_EXISTS(DT_NODELABEL(rsctbl))
	uint32_t count = 0;

	/* The window keeps its contents across a CM33 reset: clear the counter
	 * and publish the magic last, so a reader never pairs a fresh magic
	 * with a stale count. */
	BEACON->heartbeat    = 0;
	BEACON->attach_epoch = 0;
	BEACON->version      = ALP_AMP_BEACON_VERSION_IDLE_SHIM;
	barrier_dsync_fence_full();
	BEACON->magic = ALP_AMP_BEACON_MAGIC;
	barrier_dsync_fence_full();

	while (1) {
		k_sleep(K_SECONDS(1));
		BEACON->heartbeat = ++count;
		barrier_dsync_fence_full();
	}
#else
	while (1) {
		k_sleep(K_FOREVER);
	}
#endif

	return 0;
}
```
