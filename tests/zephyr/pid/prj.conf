## CMakeLists.txt
```
# SPDX-License-Identifier: Apache-2.0

cmake_minimum_required(VERSION 3.20)

find_package(Zephyr REQUIRED HINTS $ENV{ZEPHYR_BASE})
project(alp_sdk_pid_test LANGUAGES C)

target_sources(app PRIVATE src/main.c)
```

## prj.conf
```kconfig
# SPDX-License-Identifier: Apache-2.0
CONFIG_ZTEST=y
CONFIG_ALP_SDK=y

# Compiles src/pid.c (the portable PID surface under test).
CONFIG_ALP_SDK_PID=y

CONFIG_THREAD_LOCAL_STORAGE=y
CONFIG_CBPRINTF_FP_SUPPORT=y
```

## src/main.c
```c
/*
 * Copyright 2026 Alp Lab AB
 * SPDX-License-Identifier: Apache-2.0
 *
 * Unit tests for the portable <alp/pid.h> controller (native_sim).
 * Covers arg guards, P/I/D term behaviour, output clamp + integrator
 * anti-windup, reset, and closed-loop convergence against a simple plant.
 */
#include <zephyr/ztest.h>

#include "alp/pid.h"

ZTEST(alp_pid, test_init_rejects_null)
{
	alp_pid_t              pid;
	const alp_pid_config_t cfg = { .kp = 1.0f };
	zassert_equal(alp_pid_init(NULL, &cfg), ALP_ERR_INVAL, NULL);
	zassert_equal(alp_pid_init(&pid, NULL), ALP_ERR_INVAL, NULL);
	zassert_equal(alp_pid_init(&pid, &cfg), ALP_OK, NULL);
}

ZTEST(alp_pid, test_step_guards_return_zero)
{
	alp_pid_t              pid;
	const alp_pid_config_t cfg = { .kp = 1.0f };
	alp_pid_init(&pid, &cfg);
	zassert_within(alp_pid_step(NULL, 1.0f, 0.0f, 0.01f), 0.0f, 1e-6f, NULL);
	zassert_within(alp_pid_step(&pid, 1.0f, 0.0f, 0.0f), 0.0f, 1e-6f, "dt=0");
	zassert_within(alp_pid_step(&pid, 1.0f, 0.0f, -1.0f), 0.0f, 1e-6f, "dt<0");
}

ZTEST(alp_pid, test_proportional_only)
{
	alp_pid_t              pid;
	const alp_pid_config_t cfg = { .kp = 2.0f, .out_min = -100.0f, .out_max = 100.0f };
	alp_pid_init(&pid, &cfg);
	/* err = 3 - 0 = 3 -> u = kp*err = 6 (no I/D). */
	zassert_within(alp_pid_step(&pid, 3.0f, 0.0f, 0.01f), 6.0f, 1e-4f, NULL);
}

ZTEST(alp_pid, test_output_saturates)
{
	alp_pid_t              pid;
	const alp_pid_config_t cfg = { .kp = 10.0f, .out_min = -1.0f, .out_max = 1.0f };
	alp_pid_init(&pid, &cfg);
	/* kp*err = 50, clamped to out_max = 1. */
	zassert_within(alp_pid_step(&pid, 5.0f, 0.0f, 0.01f), 1.0f, 1e-6f, NULL);
	/* Negative error clamps to out_min. */
	zassert_within(alp_pid_step(&pid, -5.0f, 0.0f, 0.01f), -1.0f, 1e-6f, NULL);
}

ZTEST(alp_pid, test_integrator_windup_clamped)
{
	alp_pid_t pid;
	/* Explicit integ_limit = 3 (below the +/-10 output clamp) so the value
	 * we see is the ANTI-WINDUP limit, not the output saturation.  Ki=1 so
	 * the integral term is bounded to 3. */
	const alp_pid_config_t cfg = {
		.ki = 1.0f, .integ_limit = 3.0f, .out_min = -10.0f, .out_max = 10.0f
	};
	alp_pid_init(&pid, &cfg);
	/* Drive a big sustained error for many steps; integ must not run away. */
	float out = 0.0f;
	for (int i = 0; i < 1000; i++) {
		out = alp_pid_step(&pid, 100.0f, 0.0f, 0.1f);
	}
	zassert_within(out, 3.0f, 1e-3f, "windup not clamped: %f", (double)out);
}

/* Default integ_limit (<= 0): the I term ki*integ must be able to reach half
 * the output span even when ki != 1 (the limit scales by 1/ki). */
ZTEST(alp_pid, test_default_integ_limit_scales_with_ki)
{
	alp_pid_t              pid;
	const alp_pid_config_t cfg = {
		.ki = 0.2f, .integ_limit = 0.0f, .out_min = -1.0f, .out_max = 1.0f
	};
	alp_pid_init(&pid, &cfg);
	for (int i = 0; i < 1000; i++) {
		(void)alp_pid_step(&pid, 100.0f, 0.0f, 0.1f);
	}
	/* Span 2.0 -> half span 1.0 -> integ limit 1.0 / ki = 5.0. */
	zassert_within(pid.integ, 5.0f, 1e-3f, "integ not span/(2*ki): %f", (double)pid.integ);
}

/* Negative ki (reverse-acting loop): the default limit uses |ki|, so the
 * accumulator still stops at span/(2*|ki|) instead of winding up. */
ZTEST(alp_pid, test_default_integ_limit_negative_ki)
{
	alp_pid_t              pid;
	const alp_pid_config_t cfg = {
		.ki = -0.2f, .integ_limit = 0.0f, .out_min = -1.0f, .out_max = 1.0f
	};
	alp_pid_init(&pid, &cfg);
	for (int i = 0; i < 1000; i++) {
		(void)alp_pid_step(&pid, 100.0f, 0.0f, 0.1f);
	}
	zassert_within(pid.integ, 5.0f, 1e-3f, "integ not span/(2*|ki|): %f", (double)pid.integ);
}

/* ki == 0: default limit falls back to span/2 so the accumulator is finite. */
ZTEST(alp_pid, test_default_integ_limit_zero_ki)
{
	alp_pid_t              pid;
	const alp_pid_config_t cfg = {
		.ki = 0.0f, .integ_limit = 0.0f, .out_min = -1.0f, .out_max = 1.0f
	};
	alp_pid_init(&pid, &cfg);
	for (int i = 0; i < 1000; i++) {
		(void)alp_pid_step(&pid, 100.0f, 0.0f, 0.1f);
	}
	zassert_within(pid.integ, 1.0f, 1e-3f, "integ not span/2: %f", (double)pid.integ);
}

ZTEST(alp_pid, test_reset_clears_integrator)
{
	alp_pid_t              pid;
	const alp_pid_config_t cfg = { .ki = 1.0f, .out_min = -10.0f, .out_max = 10.0f };
	alp_pid_init(&pid, &cfg);
	for (int i = 0; i < 10; i++) {
		(void)alp_pid_step(&pid, 1.0f, 0.0f, 0.1f);
	}
	alp_pid_reset(&pid);
	/* After reset, integ=0, so a zero-error step yields ~0 output. */
	zassert_within(alp_pid_step(&pid, 0.0f, 0.0f, 0.1f), 0.0f, 1e-6f, NULL);
}

ZTEST(alp_pid, test_converges_to_setpoint)
{
	alp_pid_t              pid;
	const alp_pid_config_t cfg = {
		.kp                   = 1.0f,
		.ki                   = 0.5f,
		.kd                   = 0.05f,
		.out_min              = -10.0f,
		.out_max              = 10.0f,
		.deriv_on_measurement = true,
	};
	alp_pid_init(&pid, &cfg);
	/* First-order integrator plant: y += u*dt.  A PI(D) controller must
	 * drive y to the setpoint with zero steady-state error. */
	const float dt = 0.01f, setpoint = 1.0f;
	float       y = 0.0f;
	for (int i = 0; i < 2000; i++) {
		float u = alp_pid_step(&pid, setpoint, y, dt);
		y += u * dt;
	}
	zassert_within(y, setpoint, 1e-2f, "did not converge: y=%f", (double)y);
}

ZTEST_SUITE(alp_pid, NULL, NULL, NULL, NULL, NULL);
```
