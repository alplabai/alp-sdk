## CMakeLists.txt
```
# SPDX-License-Identifier: Apache-2.0

cmake_minimum_required(VERSION 3.20)

find_package(Zephyr REQUIRED HINTS $ENV{ZEPHYR_BASE})
project(alp_sdk_cloud_sdks_test LANGUAGES C)

target_sources(app PRIVATE src/main.c)
```

## Kconfig
```
# SPDX-License-Identifier: Apache-2.0

# True when both west `extras-cloud` checkouts exist: at the path given by
# $ALP_AWS_IOT_SDK_DIR / $ALP_AZURE_IOT_SDK_DIR if set, else where west puts
# them (vendors/cloud-sdk-dir.cmake resolves them the same way).  Evaluated
# during twister's Kconfig-only filter pass, which never runs CMake, so it
# reads ENVIRONMENT variables only: a CMake -DALP_*_SDK_DIR override does not
# affect this skip.  The AWS probe also needs an initialised submodule
# (coreMQTT), so an AWS checkout without `--recurse-submodules` skips.
config CLOUD_SDKS_PRESENT
	def_bool "$(shell,test -f "${ALP_AWS_IOT_SDK_DIR:-$ZEPHYR_BASE/../modules/lib/aws-iot-device-sdk-embedded-C}/libraries/standard/coreMQTT/mqttFilePaths.cmake" && test -d "${ALP_AZURE_IOT_SDK_DIR:-$ZEPHYR_BASE/../modules/lib/azure-sdk-for-c}" && echo y)" = "y"

source "Kconfig.zephyr"
```

## prj.conf
```kconfig
CONFIG_ZTEST=y
CONFIG_ALP_SDK=y
CONFIG_ALP_AWS_IOT=y
CONFIG_ALP_AZURE_IOT=y
```

## cloud.conf
```kconfig
CONFIG_ALP_AWS_IOT=y
CONFIG_ALP_AZURE_IOT=y
```

## src/main.c
```c
/* SPDX-License-Identifier: Apache-2.0 */

/*
 * Links the west-pinned AWS IoT (coreMQTT + coreJSON) and Azure IoT
 * (az_core + hub client) sources through the vendors/ glue and calls one
 * pure function from each.  No network, no TLS.
 */

#include <zephyr/ztest.h>

#include <azure/core/az_span.h>
#include <azure/iot/az_iot_hub_client.h>
#include <core_json.h>
#include <core_mqtt_serializer.h>

ZTEST(cloud_sdks, test_aws_corejson_validate)
{
	static const char doc[] = "{\"a\":1}";

	zassert_equal(JSON_Validate(doc, sizeof(doc) - 1), JSONSuccess);
	zassert_equal(JSON_Validate("{", 1), JSONPartial);
}

ZTEST(cloud_sdks, test_aws_coremqtt_serializer)
{
	size_t packet;

	/* PINGREQ is a fixed 2-byte packet. */
	zassert_equal(MQTT_GetPingreqPacketSize(&packet), MQTTSuccess);
	zassert_equal(packet, 2);
	zassert_equal(MQTT_GetIncomingPacketTypeAndLength(NULL, NULL, NULL), MQTTBadParameter);
}

ZTEST(cloud_sdks, test_azure_span_and_hub_client)
{
	az_span           s = AZ_SPAN_FROM_STR("hub.azure-devices.net");
	az_iot_hub_client client;
	char              topic[64];
	size_t            len;

	zassert_equal(az_span_size(s), 21);
	zassert_true(
	    az_result_succeeded(az_iot_hub_client_init(&client, s, AZ_SPAN_FROM_STR("dev1"), NULL)));
	zassert_true(az_result_succeeded(
	    az_iot_hub_client_telemetry_get_publish_topic(&client, NULL, topic, sizeof(topic), &len)));
	zassert_str_equal(topic, "devices/dev1/messages/events/");
}

ZTEST_SUITE(cloud_sdks, NULL, NULL, NULL, NULL, NULL);
```
