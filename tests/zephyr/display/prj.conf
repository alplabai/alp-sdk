## CMakeLists.txt
```
# SPDX-License-Identifier: Apache-2.0

cmake_minimum_required(VERSION 3.20)

find_package(Zephyr REQUIRED HINTS $ENV{ZEPHYR_BASE})
project(alp_sdk_display_test LANGUAGES C)

target_sources(app PRIVATE src/main.c)
```

## prj.conf
```kconfig
# SPDX-License-Identifier: Apache-2.0

CONFIG_ZTEST=y
CONFIG_ALP_SDK=y

# Pin the SoC choice so alp_backend_select("display", ALP_SOC_REF_STR)
# exercises the same selector path real customer builds hit.
CONFIG_ALP_SOC_ALIF_ENSEMBLE_E7=y

# Zephyr display subsystem -- pulls in the real zephyr_drv backend
# (CONFIG_ALP_SDK_DISPLAY_ZEPHYR_DRV defaults y).  The dummy display
# driver (CONFIG_DUMMY_DISPLAY) auto-enables when the overlay
# provides a zephyr,dummy-dc node.
CONFIG_DISPLAY=y

# native_sim's DTS carries a zephyr,sdl-dc node, so CONFIG_DISPLAY=y
# also drags in the SDL display driver by default.  The suite only
# targets the dummy display, and SDL's GL teardown asserts inside
# libGLdispatch (DispatchCurrentUnref) on headless hosts -- the CI
# runner has no display server -- killing the process with SIGABRT
# AFTER the suite passes.  Keep SDL out of the build entirely.
CONFIG_SDL_DISPLAY=n

# Required for thread-local last-error storage.
CONFIG_THREAD_LOCAL_STORAGE=y

CONFIG_LOG=y
```

## prj_mipi_dbi_type_c.conf
```kconfig
# SPDX-License-Identifier: Apache-2.0

CONFIG_ZTEST=y
CONFIG_ALP_SDK=y

# Keep the backend-selector path identical to the runtime display ztest.
CONFIG_ALP_SOC_ALIF_ENSEMBLE_E7=y

# Zephyr display + the alp-sdk driver-class wrapper.  The overlay's
# sitronix,st7789v node auto-enables CONFIG_ST7789V, which selects
# Zephyr's MIPI DBI host layer; the zephyr,mipi-dbi-spi controller
# auto-enables CONFIG_MIPI_DBI_SPI.
CONFIG_DISPLAY=y

# native_sim has an SDL display node by default.  This fixture is about
# the DBI Type C devicetree path, and it must stay headless in CI.
CONFIG_SDL_DISPLAY=n

# GPIO is used for D/C# and reset in the 4-wire Type C fixture.
CONFIG_GPIO=y

# native_sim's SPI/GPIO devices are emulated controllers.  The scenario
# is build-only, but these symbols must still be present so Zephyr emits
# the controller devices referenced by the DBI node.
CONFIG_EMUL=y
CONFIG_GPIO_EMUL=y
CONFIG_SPI_EMUL=y

# Required for thread-local last-error storage.
CONFIG_THREAD_LOCAL_STORAGE=y

CONFIG_LOG=y
```

## prj_stub.conf
```kconfig
# SPDX-License-Identifier: Apache-2.0
#
# Stub-fallback scenario: no Zephyr display subsystem, so
# CONFIG_ALP_SDK_DISPLAY_ZEPHYR_DRV can't compile and the wildcard
# priority-0 zephyr_stub is the selected backend.  Proves the
# NOT_IMPLEMENTED degrade stays clean on builds without a display.

CONFIG_DISPLAY=n
```

## src/main.c
```c
/* SPDX-License-Identifier: Apache-2.0
 *
 * ZTESTs for the <alp/display.h> portable surface over the
 * zephyr_drv backend (issue #23).  Three twister scenarios share
 * this source, split at compile time:
 *
 *   - alp_sdk.display.zephyr_drv   -- alp-display0 alias backed by
 *     the upstream dummy display controller (zephyr,dummy-dc,
 *     320x240, ARGB8888 default): the real open / get_caps / blit /
 *     clear / close paths plus param validation.
 *   - alp_sdk.display.no_device    -- zephyr_drv compiled but no
 *     alp-displayN alias in DT: open degrades with NOT_READY.
 *   - alp_sdk.display.stub_fallback -- CONFIG_DISPLAY=n, so only
 *     the priority-0 stub registers: open degrades with
 *     NOT_IMPLEMENTED.
 *
 * The dummy driver's declared geometry (320x240) is mirrored in
 * overlays/dummy_display.overlay -- keep the two in sync.
 */

#include <stdbool.h>
#include <stddef.h>
#include <stdint.h>
#include <string.h>

#include <zephyr/devicetree.h>
#include <zephyr/ztest.h>

#include <alp/backend.h>

/* for alp_display_slot_epoch() -- internal, same as this suite's other
 * white-box reaches into the dispatcher. */
#include "../../../../src/backends/display/display_ops.h"
#include <alp/cap_instance.h>
#include <alp/display.h>
#include <alp/peripheral.h>
#include <alp/soc_caps.h>

#define HAVE_DISPLAY_NODE DT_NODE_HAS_STATUS(DT_ALIAS(alp_display0), okay)

ZTEST_SUITE(alp_display, NULL, NULL, NULL, NULL, NULL);

/* ---------- Selector / registry inventory --------------------------- */

ZTEST(alp_display, test_backend_selection)
{
	const alp_backend_t *be = alp_backend_select("display", ALP_SOC_REF_STR);

	zassert_not_null(be);
#ifdef CONFIG_ALP_SDK_DISPLAY_ZEPHYR_DRV
	/* Real wrapper registered: wins over the stub on priority. */
	zassert_equal(strcmp(be->vendor, "zephyr"), 0);
	zassert_equal(be->priority, 50);
	zassert_equal(alp_backend_count("display"), 2u);
#else
	/* CONFIG_DISPLAY=n build: only the stub registers. */
	zassert_equal(strcmp(be->vendor, "stub"), 0);
	zassert_equal(be->priority, 0);
	zassert_equal(alp_backend_count("display"), 1u);
#endif
}

/* ---------- Front-door param validation (all scenarios) ------------- */

ZTEST(alp_display, test_open_null_cfg_rejected)
{
	zassert_is_null(alp_display_open(NULL));
	zassert_equal(alp_last_error(), ALP_ERR_INVAL);
}

ZTEST(alp_display, test_ops_on_null_handle)
{
	alp_display_caps_t caps;

	zassert_equal(alp_display_get_caps(NULL, &caps), ALP_ERR_NOT_READY);
	zassert_equal(alp_display_blit(NULL, 0, 0, 1, 1, &caps), ALP_ERR_NOT_READY);
	zassert_equal(alp_display_clear(NULL), ALP_ERR_NOT_READY);
	zassert_is_null(alp_display_capabilities(NULL));
	alp_display_close(NULL); /* must be a no-op, not a crash */
}

#if HAVE_DISPLAY_NODE

/* ---------- Real-backend path (dummy display present) ---------------- */

ZTEST(alp_display, test_open_and_close)
{
	const alp_display_config_t cfg = { .display_id = 0 };
	alp_display_t             *d   = alp_display_open(&cfg);

	zassert_not_null(d, "open failed: last_error=%d", alp_last_error());
	zassert_not_null(alp_display_capabilities(d));

	alp_display_close(d);

	/* Ops on a closed handle must refuse, not touch the driver. */
	alp_display_caps_t caps;
	zassert_equal(alp_display_get_caps(d, &caps), ALP_ERR_NOT_READY);
}

/* Issue #1698: the handle pool is static, so alp_display_close() followed by
 * alp_display_open() hands the SAME address back.  A holder that cached the
 * pointer (LVGL's user-data in src/gui_lvgl.c) cannot tell "still my display"
 * from "my slot, someone else's display" by pointer alone -- and because
 * alp_display_blit() gates on the lifecycle byte, the reused slot reads OPEN
 * and the blit SUCCEEDS against the wrong screen.  That is silent corruption,
 * not a crash, which is why the epoch exists.  This asserts the invariant the
 * gui_lvgl guard depends on: same address, different generation. */
ZTEST(alp_display, test_slot_epoch_changes_across_reuse_1698)
{
	const alp_display_config_t cfg = { .display_id = 0 };

	alp_display_t *first = alp_display_open(&cfg);
	zassert_not_null(first, "open failed: last_error=%d", alp_last_error());
	const uint32_t first_epoch = alp_display_slot_epoch(first);
	alp_display_close(first);

	alp_display_t *second = alp_display_open(&cfg);
	zassert_not_null(second, "reopen failed: last_error=%d", alp_last_error());
	const uint32_t second_epoch = alp_display_slot_epoch(second);

	/* The address coming back identical is the whole hazard -- assert it
	 * rather than assume it, so this test still means something if the
	 * allocator ever stops reusing the slot. */
	zassert_equal(first, second, "expected the pool to hand back the same slot");
	zassert_not_equal(first_epoch,
	                  second_epoch,
	                  "epoch must change across reuse, else a stale holder "
	                  "cannot detect the new owner");

	alp_display_close(second);
}

ZTEST(alp_display, test_slot_epoch_of_null_is_zero_1698)
{
	zassert_equal(alp_display_slot_epoch(NULL), 0u);
}

ZTEST(alp_display, test_get_caps_matches_dt)
{
	const alp_display_config_t cfg = { .display_id = 0 };
	alp_display_t             *d   = alp_display_open(&cfg);

	zassert_not_null(d);

	alp_display_caps_t caps;
	zassert_equal(alp_display_get_caps(d, &caps), ALP_OK);
	/* Geometry from overlays/dummy_display.overlay; format is the
	 * dummy driver's ARGB8888 default (representable, so open()
	 * keeps it). */
	zassert_equal(caps.width, 320);
	zassert_equal(caps.height, 240);
	zassert_equal(caps.format, ALP_PIXFMT_ARGB8888);
	/* The dummy panel declares no mount-rotation: scanned as mounted. (The
	 * property lives on tes,cdc-2.1; the dummy-dc binding does not allow it, so
	 * a non-zero value is covered by the Alif board builds, not here.) */
	zassert_equal(caps.rotation, 0);

	zassert_equal(alp_display_get_caps(d, NULL), ALP_ERR_INVAL);

	alp_display_close(d);
}

ZTEST(alp_display, test_blit_ok_and_param_validation)
{
	const alp_display_config_t cfg = { .display_id = 0 };
	alp_display_t             *d   = alp_display_open(&cfg);

	zassert_not_null(d);

	/* 4x2 ARGB8888 patch = 32 bytes. */
	static const uint8_t patch[4 * 2 * 4];

	zassert_equal(alp_display_blit(d, 0, 0, 4, 2, patch), ALP_OK);
	/* Bottom-right corner still in bounds. */
	zassert_equal(alp_display_blit(d, 316, 238, 4, 2, patch), ALP_OK);

	/* NULL pixels rejected at the dispatcher front door. */
	zassert_equal(alp_display_blit(d, 0, 0, 4, 2, NULL), ALP_ERR_INVAL);
	/* Zero-sized rects are invalid. */
	zassert_equal(alp_display_blit(d, 0, 0, 0, 2, patch), ALP_ERR_INVAL);
	zassert_equal(alp_display_blit(d, 0, 0, 4, 0, patch), ALP_ERR_INVAL);
	/* Rects crossing the panel edge are out of range. */
	zassert_equal(alp_display_blit(d, 317, 0, 4, 2, patch), ALP_ERR_OUT_OF_RANGE);
	zassert_equal(alp_display_blit(d, 0, 239, 4, 2, patch), ALP_ERR_OUT_OF_RANGE);

	alp_display_close(d);
}

ZTEST(alp_display, test_clear_via_sw_fallback)
{
	const alp_display_config_t cfg = { .display_id = 0 };
	alp_display_t             *d   = alp_display_open(&cfg);

	zassert_not_null(d);

	/* The dummy driver has no clear op (-ENOSYS), so this exercises
	 * the backend's chunked zero-fill display_write fallback across
	 * the full 320x240 panel. */
	zassert_equal(alp_display_clear(d), ALP_OK);

	alp_display_close(d);
}

ZTEST(alp_display, test_open_unresolved_and_out_of_range_ids)
{
	/* display_id 3 is a valid slot but has no DT alias. */
	const alp_display_config_t no_alias = { .display_id = 3 };
	zassert_is_null(alp_display_open(&no_alias));
	zassert_equal(alp_last_error(), ALP_ERR_NOT_READY);

	/* display_id beyond the alias table is INVAL. */
	const alp_display_config_t oob = { .display_id = 99 };
	zassert_is_null(alp_display_open(&oob));
	zassert_equal(alp_last_error(), ALP_ERR_INVAL);
}

#elif defined(CONFIG_ALP_SDK_DISPLAY_ZEPHYR_DRV)

/* ---------- No-device degrade (zephyr_drv, no DT alias) -------------- */

ZTEST(alp_display, test_open_degrades_not_ready_without_node)
{
	const alp_display_config_t cfg = { .display_id = 0 };

	zassert_is_null(alp_display_open(&cfg));
	zassert_equal(alp_last_error(), ALP_ERR_NOT_READY);
}

#else

/* ---------- Stub degrade (CONFIG_DISPLAY=n) --------------------------- */

ZTEST(alp_display, test_open_degrades_not_implemented_on_stub)
{
	const alp_display_config_t cfg = { .display_id = 0 };

	zassert_is_null(alp_display_open(&cfg));
	zassert_equal(alp_last_error(), ALP_ERR_NOT_IMPLEMENTED);
}

#endif /* HAVE_DISPLAY_NODE */
```
