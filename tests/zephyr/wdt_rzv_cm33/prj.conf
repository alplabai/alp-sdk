## CMakeLists.txt
```
# SPDX-License-Identifier: Apache-2.0

cmake_minimum_required(VERSION 3.20)

find_package(Zephyr REQUIRED HINTS $ENV{ZEPHYR_BASE})
project(alp_sdk_wdt_rzv_cm33 LANGUAGES C)

target_sources(app PRIVATE src/main.c)
```

## prj.conf
```kconfig
# SPDX-License-Identifier: Apache-2.0

CONFIG_ALP_SDK=y
CONFIG_PRINTK=y

# The Zephyr watchdog class: pulls src/backends/wdt/zephyr_drv.c and, with the
# overlay's `&wdt0 { status = "okay"; }`, the renesas,rzv-wdt driver + the
# vendored FSP r_wdt module.  Both are needed for a build that proves the whole
# chain (alias alp-wdt0 -> wdt_renesas_rzv.c -> r_wdt.c).
CONFIG_WATCHDOG=y
CONFIG_ALP_SOC_RENESAS_RZV2N_N44=y
CONFIG_ALP_SDK_CHIP_GD32G553=y
```

## boards/alp_e1m_v2m101_m33_sm_r9a09g056n48gbg_cm33.overlay
```dts
/* SPDX-License-Identifier: Apache-2.0 */

/*
 * Enable the CM33's own watchdog (WDT0).  Disabled by default in the generated
 * board dts because an expiry resets the whole SoM; this build-only test turns it
 * on to prove the node, the renesas,rzv-wdt driver and the vendored r_wdt compile.
 */
&wdt0 {
	status = "okay";
};
```

## src/main.c
```c
/*
 * Copyright (c) 2026 Alp Lab AB
 * SPDX-License-Identifier: Apache-2.0
 *
 * Build-only: arms the CM33 watchdog through the portable <alp/wdt.h> API.
 * Never run in CI -- a started WDT0 cannot be stopped and resets the whole SoM.
 * Bench steps: docs/bench/rzv-wdt0-cm33.md.
 */

#include <zephyr/kernel.h>

#include <alp/e1m_x_pinout.h>
#include <alp/wdt.h>

int main(void)
{
	/* 1000 ms is above the longest WDT0 period (174.8 ms at 24 MHz): the driver runs its software
	 * keeper (extended mode).  Use 175 for direct mode.
	 */
	alp_wdt_t *wdt = alp_wdt_open(&(alp_wdt_config_t){
	    .wdt_id     = ALP_E1M_X_WDT0,
	    .timeout_ms = 1000,
	    .on_timeout = ALP_WDT_RESET_SOC,
	});

	if (wdt == NULL) {
		printk("wdt: open failed\n");
		return 0;
	}

	while (1) {
		(void)alp_wdt_feed(wdt);
		k_sleep(K_MSEC(500));
	}

	return 0;
}
```
