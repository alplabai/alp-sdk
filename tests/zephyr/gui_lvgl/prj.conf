## CMakeLists.txt
```
# SPDX-License-Identifier: Apache-2.0

cmake_minimum_required(VERSION 3.20)

find_package(Zephyr REQUIRED HINTS $ENV{ZEPHYR_BASE})
project(alp_sdk_gui_lvgl_test LANGUAGES C)

target_sources(app PRIVATE src/main.c)
```

## prj.conf
```kconfig
# SPDX-License-Identifier: Apache-2.0

CONFIG_ZTEST=y
CONFIG_ALP_SDK=y

# Pin the SoC choice so alp_backend_select("display", ALP_SOC_REF_STR)
# exercises the same selector path real customer builds hit; the local
# test-double backend in src/main.c registers at silicon_ref="*"
# priority 255 so it wins regardless.
CONFIG_ALP_SOC_ALIF_ENSEMBLE_E7=y

# Required for thread-local last-error storage.
CONFIG_THREAD_LOCAL_STORAGE=y

CONFIG_LOG=y

# LVGL v9 -- pulls in the real alp_gui_lvgl_attach() bridge
# (CONFIG_ALP_SDK_HAS_LVGL defaults y when CONFIG_LVGL=y, mirrored
# into the ALP_HAS_LVGL compile define by zephyr/CMakeLists.txt).
# Overridden to n by prj_no_lvgl.conf for the NOSUPPORT scenario.
CONFIG_LVGL=y
CONFIG_LV_COLOR_DEPTH_16=y
# LVGL's own internal allocator pool (lv_malloc) -- the 2048-byte
# default is too small once a label + its span-draw stack exist.
CONFIG_LV_Z_MEM_POOL_SIZE=16384

# Zephyr's LVGL glue (modules/lvgl/lvgl.c) requires a "zephyr,display"
# chosen node to compile, regardless of whether this suite's bridge
# ever uses it -- boards/native_sim_native_64.overlay wires the dummy
# display driver to satisfy that.  alp_gui_lvgl_attach() itself never
# touches this device: it binds to the priority-255 test-double display
# backend registered in src/main.c.  Harmless to also carry in the
# CONFIG_LVGL=n scenario (prj_no_lvgl.conf).
CONFIG_DISPLAY=y
CONFIG_DUMMY_DISPLAY=y

# native_sim's DTS carries a zephyr,sdl-dc node, so CONFIG_DISPLAY=y also
# drags in the SDL display driver by default; its GL teardown asserts
# inside libGLdispatch on headless hosts (no display server) AFTER the
# suite passes (same trap tests/zephyr/display/prj.conf documents).
# Keep SDL out of the build entirely.
CONFIG_SDL_DISPLAY=n

# Zephyr's own LVGL auto-init (SYS_INIT before main()) would otherwise
# allocate a SECOND lv_display_t against the tiny 32x16 dummy_dc above,
# sized by CONFIG_LV_Z_VDB_SIZE's screen-percentage default -- too small
# a fraction of a 32x16 panel to round up to a whole line, which trips
# LVGL's own "buffer is too small" assert. This suite manages lv_init()
# and the one real lv_display_t (over the test-double backend) itself,
# so the auto-created display is both unneeded and the thing that was
# crashing; disable it.
CONFIG_LV_Z_AUTO_INIT=n

CONFIG_MAIN_STACK_SIZE=4096
CONFIG_HEAP_MEM_POOL_SIZE=16384
```

## prj_no_lvgl.conf
```kconfig
# SPDX-License-Identifier: Apache-2.0
#
# NOSUPPORT scenario: no LVGL in the build at all, so ALP_HAS_LVGL is
# never defined and alp_gui_lvgl_attach() takes the guard-clause path
# (src/gui_lvgl.c). Overrides the base prj.conf's CONFIG_LVGL=y.

CONFIG_LVGL=n
```

## boards/native_sim_native_64.overlay
```dts
/*
 * Copyright 2026 Alp Lab AB
 * SPDX-License-Identifier: Apache-2.0
 *
 * native_sim board overlay -- LVGL's own Zephyr glue (modules/lvgl/
 * lvgl.c) requires a "zephyr,display" chosen node (or a zephyr,displays
 * compatible node) to compile at all, even though this suite's
 * alp_gui_lvgl_attach() bridge never touches it: the bridge creates its
 * OWN independent lv_display_t bound to the priority-255 test-double
 * display backend registered in src/main.c (see that file's header --
 * the "don't point an alp-displayN alias at the panel LVGL owns"
 * caution in src/backends/display/zephyr_drv.c does not apply here,
 * because this dummy_dc is deliberately NOT aliased to any alp-displayN
 * slot). Wiring the dummy display driver here just satisfies LVGL's
 * compile-time requirement cheaply -- same choice lvgl-benchmark /
 * lvgl-widgets-demo make for the same reason.
 */

/ {
	chosen {
		zephyr,display = &dummy_dc;
	};

	dummy_dc: dummy_dc {
		compatible = "zephyr,dummy-dc";
		height = <16>;
		width = <32>;
	};
};
```

## src/main.c
```c
/* SPDX-License-Identifier: Apache-2.0
 *
 * ZTESTs for alp_gui_lvgl_attach() -- the <alp/gui.h> LVGL v9 bridge
 * (issue #23).  Two twister scenarios, split at compile time:
 *
 *   - alp_sdk.gui.lvgl_attach            -- CONFIG_LVGL=y.  Registers a
 *     local priority-255 test-double display backend (the
 *     ALP_BACKEND_REGISTER test-double convention documented on
 *     <alp/backend.h>, precedented by tests/zephyr/security_fallback/'s
 *     fake_hw/fake_sw) and proves the real flush_cb path reaches
 *     alp_display_blit() once LVGL renders a frame.  Also proves the
 *     unsupported-pixel-format (MONO_VLSB) rejection.
 *   - alp_sdk.gui.lvgl_attach_nosupport  -- CONFIG_LVGL=n.  Confirms the
 *     guard-clause degrade (NOSUPPORT) still holds when no build wires
 *     LVGL in.
 *
 * NULL-rejection (ALP_ERR_INVAL) is common to both -- alp_gui_lvgl_attach()
 * checks it before ever branching on ALP_HAS_LVGL.
 */

#include <stdbool.h>
#include <stddef.h>
#include <stdint.h>

#include <zephyr/ztest.h>

#include <alp/display.h>
#include <alp/gui.h>
#include <alp/peripheral.h>

ZTEST_SUITE(alp_gui_lvgl, NULL, NULL, NULL, NULL, NULL);

ZTEST(alp_gui_lvgl, test_attach_null_rejected)
{
	zassert_equal(alp_gui_lvgl_attach(NULL), ALP_ERR_INVAL);
}

#ifdef CONFIG_LVGL

#include <lvgl.h>

#include <alp/backend.h>
#include <alp/cap_instance.h>

#include "../../../../src/backends/display/display_ops.h"

/* ---------------------------------------------------------------------
 * Local priority-255 test-double display backend -- outranks every real
 * backend (see the priority note on ALP_BACKEND_REGISTER in
 * <alp/backend.h>).  display_id 0 reports a small RGB565 panel and
 * counts blits, so the test can prove the LVGL flush_cb path actually
 * reaches alp_display_blit() without any real/emulated display
 * controller; display_id 1 reports MONO_VLSB, to exercise
 * alp_gui_lvgl_attach()'s unsupported-format rejection.
 * --------------------------------------------------------------------- */

#define TD_WIDTH  32
#define TD_HEIGHT 16

static uint32_t g_blit_count;
static uint16_t g_last_w;
static uint16_t g_last_h;

static alp_status_t td_open(const alp_display_config_t  *cfg,
                            alp_display_backend_state_t *st,
                            alp_capabilities_t          *caps_out)
{
	(void)cfg;
	(void)caps_out;
	st->be_data = NULL;
	return ALP_OK;
}

static alp_status_t td_get_caps(alp_display_backend_state_t *st, alp_display_caps_t *out)
{
	out->width  = TD_WIDTH;
	out->height = TD_HEIGHT;
	out->format = (st->display_id == 1) ? ALP_PIXFMT_MONO_VLSB : ALP_PIXFMT_RGB565;
	return ALP_OK;
}

static alp_status_t td_blit(alp_display_backend_state_t *st,
                            uint16_t                     x,
                            uint16_t                     y,
                            uint16_t                     w,
                            uint16_t                     h,
                            const void                  *pixels)
{
	(void)st;
	(void)x;
	(void)y;
	(void)pixels;
	g_blit_count++;
	g_last_w = w;
	g_last_h = h;
	return ALP_OK;
}

static alp_status_t td_clear(alp_display_backend_state_t *st)
{
	(void)st;
	return ALP_OK;
}

static void td_close(alp_display_backend_state_t *st)
{
	(void)st;
}

static const alp_display_ops_t _td_ops = {
	.open     = td_open,
	.get_caps = td_get_caps,
	.blit     = td_blit,
	.clear    = td_clear,
	.close    = td_close,
};

ALP_BACKEND_REGISTER(display,
                     alp_gui_lvgl_test,
                     {
                         .silicon_ref = "*",
                         .vendor      = "alp_gui_test",
                         .base_caps   = 0u,
                         .priority    = 255,
                         .ops         = &_td_ops,
                         .probe       = NULL,
                     });

ZTEST(alp_gui_lvgl, test_attach_ok_and_flush_reaches_blit)
{
	g_blit_count = 0;
	g_last_w     = 0;
	g_last_h     = 0;

	const alp_display_config_t cfg = { .display_id = 0 };
	alp_display_t             *d   = alp_display_open(&cfg);
	zassert_not_null(d, "open failed: last_error=%d", alp_last_error());

	/* Single ZTEST_SUITE in this image -- lv_init() runs exactly once,
	 * before any lv_display_create()/lv_obj_create() call. */
	lv_init();

	zassert_equal(alp_gui_lvgl_attach(d), ALP_OK);

	lv_obj_t *label = lv_label_create(lv_screen_active());
	lv_label_set_text(label, "alp");

	/* Force a synchronous render + flush cycle -- lv_refr_now() drives
	 * the dirty area straight through to our flush_cb. */
	lv_refr_now(NULL);

	zassert_true(g_blit_count > 0, "flush_cb never reached alp_display_blit");
	zassert_true(g_last_w > 0 && g_last_h > 0, "flush rect had zero area");

	alp_display_close(d);
}

ZTEST(alp_gui_lvgl, test_attach_rejects_unsupported_pixfmt)
{
	/* display_id 1 -> the test double reports MONO_VLSB, which has no
	 * LVGL v9 equivalent (see src/gui_lvgl.c's _map_pixfmt comment). */
	const alp_display_config_t cfg = { .display_id = 1 };
	alp_display_t             *d   = alp_display_open(&cfg);
	zassert_not_null(d, "open failed: last_error=%d", alp_last_error());

	zassert_equal(alp_gui_lvgl_attach(d), ALP_ERR_NOSUPPORT);

	alp_display_close(d);
}

#else /* !CONFIG_LVGL */

ZTEST(alp_gui_lvgl, test_attach_degrades_to_nosupport_without_lvgl)
{
	/* The guard clause (src/gui_lvgl.c's #else body) never dereferences
	 * a non-NULL display -- it only branches on NULL vs not -- so a
	 * fake handle exercises the contract without needing a real open().
	 * (The test-double backend above is compiled out in this
	 * CONFIG_LVGL=n build, and zephyr_drv/zephyr_stub's own open()
	 * paths don't hand back a usable handle here either, so a fake
	 * handle is the simplest correct fixture.)  Mirrors
	 * tests/zephyr/chips/src/test_core_surfaces.c's identical
	 * guard-clause test. */
	alp_display_t *fake_handle = (alp_display_t *)0x1;
	zassert_equal(alp_gui_lvgl_attach(fake_handle), ALP_ERR_NOSUPPORT);
}

#endif /* CONFIG_LVGL */
```
