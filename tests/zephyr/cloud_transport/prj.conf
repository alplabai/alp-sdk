## CMakeLists.txt
```
# SPDX-License-Identifier: Apache-2.0

cmake_minimum_required(VERSION 3.20)

find_package(Zephyr REQUIRED HINTS $ENV{ZEPHYR_BASE})
project(alp_sdk_cloud_transport_test LANGUAGES C)

target_sources(app PRIVATE src/main.c)
target_sources_ifdef(CONFIG_ALP_AWS_IOT app PRIVATE src/coremqtt.c)

if(CONFIG_NET_SOCKETS_SOCKOPT_TLS)
  target_sources(app PRIVATE src/tls.c)

  # Zephyr's own test PKI (samples/net/sockets/echo_server): a CA, a
  # CN=localhost server certificate it signed, that server's key, and an
  # unrelated self-signed certificate used here as the WRONG trust anchor.
  # Taken from the Zephyr tree at build time so no key material lives in this
  # repository.
  set(_certs ${ZEPHYR_BASE}/samples/net/sockets/echo_server/src)
  set(_gen ${ZEPHYR_BINARY_DIR}/include/generated)
  foreach(_f ca.der server.der server_privkey.der echo-apps-cert.der)
    generate_inc_file_for_target(app ${_certs}/${_f} ${_gen}/${_f}.inc)
  endforeach()
endif()
```

## Kconfig
```
# SPDX-License-Identifier: Apache-2.0

# True when the west `extras-cloud` AWS checkout exists with its coreMQTT
# submodule: at $ALP_AWS_IOT_SDK_DIR if set, else where west puts it (the same
# probe as tests/zephyr/cloud_sdks/Kconfig, minus Azure).  Evaluated during
# twister's Kconfig-only filter pass, so it reads ENVIRONMENT variables only.
config CLOUD_TRANSPORT_AWS_PRESENT
	def_bool "$(shell,test -f "${ALP_AWS_IOT_SDK_DIR:-$ZEPHYR_BASE/../modules/lib/aws-iot-device-sdk-embedded-C}/libraries/standard/coreMQTT/mqttFilePaths.cmake" && echo y)" = "y"

source "Kconfig.zephyr"
```

## prj.conf
```kconfig
CONFIG_ZTEST=y
CONFIG_ALP_SDK=y
CONFIG_ALP_CLOUD_TRANSPORT=y

# Loopback TCP: the test is its own peer on 127.0.0.1, no host network.
CONFIG_NETWORKING=y
CONFIG_NET_IPV4=y
CONFIG_NET_IPV6=n
CONFIG_NET_TCP=y
CONFIG_NET_SOCKETS=y
CONFIG_NET_DRIVERS=y
CONFIG_NET_LOOPBACK=y
CONFIG_NET_TCP_TIME_WAIT_DELAY=0

CONFIG_MAIN_STACK_SIZE=4096
CONFIG_ZTEST_STACK_SIZE=4096
```

## prj_coremqtt.conf
```kconfig
# coreMQTT over the transport: needs the west `extras-cloud` AWS checkout.
CONFIG_ALP_AWS_IOT=y
```

## prj_tls.conf
```kconfig
# TLS handshake over loopback, the test acting as its own TLS server.
CONFIG_NET_SOCKETS_SOCKOPT_TLS=y
CONFIG_NET_SOCKETS_TLS_MAX_CONTEXTS=4
CONFIG_TLS_MAX_CREDENTIALS_NUMBER=8
CONFIG_MBEDTLS=y
CONFIG_MBEDTLS_ENABLE_HEAP=y
CONFIG_MBEDTLS_HEAP_SIZE=60000
CONFIG_MBEDTLS_SSL_MAX_CONTENT_LEN=2048
# One certificate ciphersuite matching the bundled RSA test PKI.  The option
# selects TLS 1.2, X.509 parsing and the PSA algorithms it needs.
CONFIG_MBEDTLS_CIPHERSUITE_TLS_ECDHE_RSA_WITH_AES_128_CBC_SHA256=y
CONFIG_MBEDTLS_SSL_SERVER_NAME_INDICATION=y
CONFIG_MBEDTLS_SSL_ALPN=y
CONFIG_TEST_RANDOM_GENERATOR=y
CONFIG_ZVFS_OPEN_ADD_SIZE_NET=10
CONFIG_NET_MAX_CONTEXTS=10
CONFIG_NET_PKT_TX_COUNT=24
CONFIG_NET_PKT_RX_COUNT=24
CONFIG_NET_BUF_TX_COUNT=80
CONFIG_NET_BUF_RX_COUNT=80

# native_sim has no real entropy source, so the SDK's weak-RNG guard refuses
# an mbedtls build by default.  This image is a loopback test against public
# test certificates and never ships; acknowledge that explicitly.
CONFIG_ALP_SDK_ALLOW_TEST_ENTROPY=y
```

## src/main.c
```c
/* SPDX-License-Identifier: Apache-2.0 */

/*
 * <alp/cloud_transport.h> over plain-TCP loopback: argument checks, the
 * lifecycle, and the receive contract an MQTT process loop depends on
 * (0 = retry, negative = error or peer gone).  The test is its own peer; no
 * host network, no TLS handshake.  The send side covers success, not
 * connected and a full send window (returns 0); a partial send is not
 * exercised here.
 */

#include <errno.h>
#include <string.h>

#include <zephyr/net/socket.h>
#include <zephyr/ztest.h>

#include <alp/cloud_transport.h>

#include "peer.h"

/* One port per test: a closed listener's port is not reusable immediately. */
enum {
	PORT_ROUND_TRIP = 4201,
	PORT_TIMEOUT,
	PORT_PEER_CLOSE,
	PORT_LIFECYCLE,
	PORT_NO_LISTENER,
	PORT_SEND_BLOCKED,
};

#define RECV_TIMEOUT_MS 100

int peer_listen(uint16_t port)
{
	struct sockaddr_in addr = { .sin_family = AF_INET, .sin_port = htons(port) };
	int                fd   = zsock_socket(AF_INET, SOCK_STREAM, IPPROTO_TCP);

	zassert_true(fd >= 0, "socket: %d", errno);
	zassert_equal(zsock_inet_pton(AF_INET, PEER_HOST, &addr.sin_addr), 1);
	zassert_ok(zsock_bind(fd, (struct sockaddr *)&addr, sizeof(addr)), "bind: %d", errno);
	zassert_ok(zsock_listen(fd, 1), "listen: %d", errno);
	return fd;
}

int peer_accept(int listen_fd)
{
	int fd = zsock_accept(listen_fd, NULL, NULL);

	zassert_true(fd >= 0, "accept: %d", errno);
	return fd;
}

static alp_cloud_transport_config_t plaintext_cfg(uint16_t port)
{
	return (alp_cloud_transport_config_t){
		.host            = PEER_HOST,
		.port            = port,
		.plaintext       = true,
		.recv_timeout_ms = RECV_TIMEOUT_MS,
	};
}

ZTEST(cloud_transport, test_connect_rejects_bad_arguments)
{
	alp_cloud_transport_t        t   = ALP_CLOUD_TRANSPORT_INIT;
	alp_cloud_transport_config_t cfg = plaintext_cfg(PORT_NO_LISTENER);

	zassert_equal(alp_cloud_transport_connect(NULL, &cfg), ALP_ERR_INVAL);
	zassert_equal(alp_cloud_transport_connect(&t, NULL), ALP_ERR_INVAL);

	cfg.host = "";
	zassert_equal(alp_cloud_transport_connect(&t, &cfg), ALP_ERR_INVAL);
	cfg.host = NULL;
	zassert_equal(alp_cloud_transport_connect(&t, &cfg), ALP_ERR_INVAL);

	cfg = plaintext_cfg(0);
	zassert_equal(alp_cloud_transport_connect(&t, &cfg), ALP_ERR_INVAL);
	zassert_false(t.connected, "a rejected connect must not leave a socket behind");
}

ZTEST(cloud_transport, test_tls_is_never_silently_downgraded)
{
	static const int             tags[] = { 1 };
	alp_cloud_transport_t        t      = ALP_CLOUD_TRANSPORT_INIT;
	alp_cloud_transport_config_t cfg    = plaintext_cfg(PORT_NO_LISTENER);

	/* TLS (plaintext not asked for) with no security tag: nothing to verify
	 * the peer against, so it is an error, not a fall-back to plain TCP. */
	cfg.plaintext = false;
	zassert_equal(alp_cloud_transport_connect(&t, &cfg), ALP_ERR_INVAL);

	cfg.sec_tags      = tags;
	cfg.sec_tag_count = 0;
	zassert_equal(alp_cloud_transport_connect(&t, &cfg), ALP_ERR_INVAL);

	if (!IS_ENABLED(CONFIG_NET_SOCKETS_SOCKOPT_TLS)) {
		/* TLS asked for with credentials, in a build without TLS sockets. */
		cfg.sec_tag_count = ARRAY_SIZE(tags);
		zassert_equal(alp_cloud_transport_connect(&t, &cfg), ALP_ERR_NOSUPPORT);
	}
	zassert_false(t.connected);
}

ZTEST(cloud_transport, test_unresolvable_host_is_reported)
{
	alp_cloud_transport_t        t   = ALP_CLOUD_TRANSPORT_INIT;
	alp_cloud_transport_config_t cfg = plaintext_cfg(PORT_NO_LISTENER);

	if (IS_ENABLED(CONFIG_DNS_RESOLVER)) {
		ztest_test_skip();
	}
	cfg.host = "broker.invalid";
	zassert_equal(alp_cloud_transport_connect(&t, &cfg), ALP_ERR_NOT_FOUND);
	zassert_false(t.connected);
}

ZTEST(cloud_transport, test_connect_without_listener_fails)
{
	alp_cloud_transport_t        t   = ALP_CLOUD_TRANSPORT_INIT;
	alp_cloud_transport_config_t cfg = plaintext_cfg(PORT_NO_LISTENER);

	zassert_equal(alp_cloud_transport_connect(&t, &cfg), ALP_ERR_IO);
	zassert_equal(t.last_errno, ECONNREFUSED, "last_errno = %d", t.last_errno);
	zassert_false(t.connected);
}

ZTEST(cloud_transport, test_round_trip)
{
	static const char            ping[] = "ping";
	static const char            pong[] = "pong!";
	char                         buf[16];
	alp_cloud_transport_t        t   = ALP_CLOUD_TRANSPORT_INIT;
	alp_cloud_transport_config_t cfg = plaintext_cfg(PORT_ROUND_TRIP);
	int                          lfd = peer_listen(PORT_ROUND_TRIP);

	zassert_ok(alp_cloud_transport_connect(&t, &cfg));
	int pfd = peer_accept(lfd);

	zassert_equal(alp_cloud_transport_send(&t, ping, sizeof(ping)), sizeof(ping));
	zassert_equal(zsock_recv(pfd, buf, sizeof(buf), 0), sizeof(ping));
	zassert_mem_equal(buf, ping, sizeof(ping));

	zassert_equal(zsock_send(pfd, pong, sizeof(pong), 0), sizeof(pong));
	zassert_equal(alp_cloud_transport_recv(&t, buf, sizeof(buf)), sizeof(pong));
	zassert_mem_equal(buf, pong, sizeof(pong));

	alp_cloud_transport_close(&t);
	zsock_close(pfd);
	zsock_close(lfd);
}

ZTEST(cloud_transport, test_recv_timeout_returns_zero)
{
	char                         buf[8];
	alp_cloud_transport_t        t   = ALP_CLOUD_TRANSPORT_INIT;
	alp_cloud_transport_config_t cfg = plaintext_cfg(PORT_TIMEOUT);
	int                          lfd = peer_listen(PORT_TIMEOUT);

	zassert_ok(alp_cloud_transport_connect(&t, &cfg));
	int     pfd   = peer_accept(lfd);
	int64_t start = k_uptime_get();

	/* The peer is connected and silent: "no data yet", so 0, and only after
	 * the configured timeout rather than at once or never. */
	zassert_equal(alp_cloud_transport_recv(&t, buf, sizeof(buf)), 0);
	zassert_true(k_uptime_get() - start >= RECV_TIMEOUT_MS / 2);

	alp_cloud_transport_close(&t);
	zsock_close(pfd);
	zsock_close(lfd);
}

ZTEST(cloud_transport, test_peer_close_is_an_error_not_zero)
{
	char                         buf[8];
	alp_cloud_transport_t        t   = ALP_CLOUD_TRANSPORT_INIT;
	alp_cloud_transport_config_t cfg = plaintext_cfg(PORT_PEER_CLOSE);
	int                          lfd = peer_listen(PORT_PEER_CLOSE);

	zassert_ok(alp_cloud_transport_connect(&t, &cfg));
	zsock_close(peer_accept(lfd));

	/* coreMQTT retries on 0 forever; a closed connection must be negative. */
	zassert_equal(alp_cloud_transport_recv(&t, buf, sizeof(buf)), ALP_ERR_IO);
	zassert_equal(t.last_errno, ENOTCONN);

	alp_cloud_transport_close(&t);
	zsock_close(lfd);
}

ZTEST(cloud_transport, test_lifecycle)
{
	char                         buf[4] = { 0 };
	alp_cloud_transport_t        t      = ALP_CLOUD_TRANSPORT_INIT;
	alp_cloud_transport_config_t cfg    = plaintext_cfg(PORT_LIFECYCLE);
	int                          lfd    = peer_listen(PORT_LIFECYCLE);

	zassert_equal(alp_cloud_transport_send(&t, buf, sizeof(buf)), ALP_ERR_NOT_READY);
	zassert_equal(alp_cloud_transport_recv(&t, buf, sizeof(buf)), ALP_ERR_NOT_READY);

	zassert_ok(alp_cloud_transport_connect(&t, &cfg));
	int pfd = peer_accept(lfd);

	zassert_equal(alp_cloud_transport_connect(&t, &cfg), ALP_ERR_BUSY);
	zassert_equal(alp_cloud_transport_send(&t, NULL, 1), ALP_ERR_INVAL);
	zassert_equal(alp_cloud_transport_recv(&t, NULL, 1), ALP_ERR_INVAL);
	zassert_equal(alp_cloud_transport_send(&t, buf, 0), 0);

	alp_cloud_transport_close(&t);
	zassert_false(t.connected);
	alp_cloud_transport_close(&t); /* idempotent */
	alp_cloud_transport_close(NULL);
	zassert_equal(alp_cloud_transport_send(&t, buf, sizeof(buf)), ALP_ERR_NOT_READY);

	zsock_close(pfd);
	zsock_close(lfd);
}

ZTEST(cloud_transport, test_zero_filled_transport_is_unconnected)
{
	char                  buf[4] = { 0 };
	alp_cloud_transport_t t;

	/* A static transport in BSS is all zero, so fd == 0.  That must not read
	 * as a held socket: descriptor 0 belongs to someone else. */
	memset(&t, 0, sizeof(t));
	zassert_equal(alp_cloud_transport_send(&t, buf, sizeof(buf)), ALP_ERR_NOT_READY);
	zassert_equal(alp_cloud_transport_recv(&t, buf, sizeof(buf)), ALP_ERR_NOT_READY);

	/* close() must not touch descriptor 0: it is still open afterwards. */
	int fd0 = zsock_socket(AF_INET, SOCK_STREAM, IPPROTO_TCP);

	zassert_true(fd0 >= 0);
	t.fd = fd0;
	alp_cloud_transport_close(&t);
	zassert_equal(t.fd, fd0, "close() acted on an unconnected transport");
	zassert_ok(zsock_close(fd0), "close() already closed the descriptor");
}

ZTEST(cloud_transport, test_send_returns_zero_when_it_would_block)
{
	static const char            chunk[1024];
	alp_cloud_transport_t        t   = ALP_CLOUD_TRANSPORT_INIT;
	alp_cloud_transport_config_t cfg = plaintext_cfg(PORT_SEND_BLOCKED);
	int                          lfd = peer_listen(PORT_SEND_BLOCKED);

	cfg.send_timeout_ms = 100;
	zassert_ok(alp_cloud_transport_connect(&t, &cfg));
	int pfd = peer_accept(lfd);

	/* The peer never reads: once its window and our buffers fill, send()
	 * times out and must report "nothing accepted" (0), not an error. */
	int32_t n = 1;

	for (int i = 0; i < 4096 && n > 0; i++) {
		n = alp_cloud_transport_send(&t, chunk, sizeof(chunk));
	}
	zassert_equal(n, 0, "send() = %d, expected 0 on timeout", n);
	zassert_equal(t.last_errno, 0);

	alp_cloud_transport_close(&t);
	zsock_close(pfd);
	zsock_close(lfd);
}

ZTEST_SUITE(cloud_transport, NULL, NULL, NULL, NULL, NULL);
```

## src/coremqtt.c
```c
/* SPDX-License-Identifier: Apache-2.0 */

/*
 * The coreMQTT TransportInterface_t adapter, driven by a real MQTTContext_t
 * over plain-TCP loopback.  The test plays the broker by hand: it reads the
 * PINGREQ coreMQTT sends and answers with a PINGRESP.
 */

#include <zephyr/net/socket.h>
#include <zephyr/ztest.h>

#include <core_mqtt.h>

#include "alp_cloud_transport_coremqtt.h"
#include "peer.h"

#define PORT_COREMQTT 4301

static const uint8_t PINGREQ[]  = { 0xC0, 0x00 };
static const uint8_t PINGRESP[] = { 0xD0, 0x00 };

static uint32_t now_ms(void)
{
	return k_uptime_get_32();
}

static void on_event(MQTTContext_t *ctx, MQTTPacketInfo_t *packet, MQTTDeserializedInfo_t *info)
{
	ARG_UNUSED(ctx);
	ARG_UNUSED(packet);
	ARG_UNUSED(info);
}

ZTEST(cloud_transport_coremqtt, test_ping_round_trip)
{
	static uint8_t               net_buf[128];
	uint8_t                      got[sizeof(PINGREQ)];
	TransportInterface_t         iface;
	NetworkContext_t             net_ctx;
	MQTTContext_t                mqtt;
	MQTTFixedBuffer_t            fixed = { .pBuffer = net_buf, .size = sizeof(net_buf) };
	alp_cloud_transport_t        t     = ALP_CLOUD_TRANSPORT_INIT;
	alp_cloud_transport_config_t cfg   = {
		.host            = PEER_HOST,
		.port            = PORT_COREMQTT,
		.plaintext       = true,
		.recv_timeout_ms = 50,
	};
	int lfd = peer_listen(PORT_COREMQTT);

	zassert_ok(alp_cloud_transport_connect(&t, &cfg));
	int broker = peer_accept(lfd);

	alp_cloud_transport_coremqtt(&iface, &net_ctx, &t);
	zassert_is_null(iface.writev, "coreMQTT must fall back to send");
	zassert_equal(MQTT_Init(&mqtt, &iface, now_ms, on_event, &fixed), MQTTSuccess);

	/* MQTT_Ping does not require a completed CONNECT; it only serialises
	 * and sends, which is exactly the path under test. */
	/* Pokes a coreMQTT internal (field as of the pinned extras-cloud checkout);
	 * revisit on a coreMQTT bump. */
	mqtt.connectStatus = MQTTConnected;
	zassert_equal(MQTT_Ping(&mqtt), MQTTSuccess);
	zassert_equal(zsock_recv(broker, got, sizeof(got), 0), sizeof(got));
	zassert_mem_equal(got, PINGREQ, sizeof(PINGREQ));
	zassert_true(mqtt.waitingForPingResp);

	/* Nothing from the broker yet: the adapter reports "no data" (0), which
	 * coreMQTT turns into a clean pass with the ping still outstanding --
	 * not an error, and not a spin. */
	zassert_equal(MQTT_ProcessLoop(&mqtt), MQTTSuccess);
	zassert_true(mqtt.waitingForPingResp);

	zassert_equal(zsock_send(broker, PINGRESP, sizeof(PINGRESP), 0), sizeof(PINGRESP));
	/* coreMQTT consumes a PINGRESP itself (no application callback) and
	 * clears the outstanding-ping flag: proof the bytes came through recv. */
	zassert_equal(MQTT_ProcessLoop(&mqtt), MQTTSuccess);
	zassert_false(mqtt.waitingForPingResp);

	/* Broker goes away: the adapter must surface it, so coreMQTT stops. */
	zsock_close(broker);
	zassert_equal(MQTT_ProcessLoop(&mqtt), MQTTRecvFailed);

	alp_cloud_transport_close(&t);
	zsock_close(lfd);
}

ZTEST(cloud_transport_coremqtt, test_bind_tolerates_null)
{
	TransportInterface_t iface = { 0 };
	NetworkContext_t     ctx   = { 0 };

	alp_cloud_transport_coremqtt(NULL, &ctx, NULL);
	alp_cloud_transport_coremqtt(&iface, NULL, NULL);
	zassert_is_null(iface.recv);
}

ZTEST_SUITE(cloud_transport_coremqtt, NULL, NULL, NULL, NULL, NULL);
```

## src/peer.h
```c
/* SPDX-License-Identifier: Apache-2.0 */

/* The loopback peer the tests talk to: a listening socket on 127.0.0.1. */

#ifndef CLOUD_TRANSPORT_TEST_PEER_H
#define CLOUD_TRANSPORT_TEST_PEER_H

#include <stdint.h>

#define PEER_HOST "127.0.0.1"

/* Start listening on @p port.  Returns the listening socket. */
int peer_listen(uint16_t port);

/* Accept the pending connection on @p listen_fd.  Returns the peer socket. */
int peer_accept(int listen_fd);

#endif /* CLOUD_TRANSPORT_TEST_PEER_H */
```

## src/tls.c
```c
/* SPDX-License-Identifier: Apache-2.0 */

/*
 * The TLS path of <alp/cloud_transport.h> over loopback.  A server thread terminates
 * TLS with Zephyr's bundled test certificate (CN=localhost, signed by the
 * bundled test CA); the transport connects to 127.0.0.1 and verifies it by
 * name.  The two refusal tests are the point: a peer that does not chain to
 * the configured CA, or whose certificate is for another name, must not
 * connect.
 */

#include <errno.h>

#include <zephyr/kernel.h>
#include <zephyr/net/socket.h>
#include <zephyr/net/tls_credentials.h>
#include <zephyr/ztest.h>

#include <alp/cloud_transport.h>

#include "peer.h"

static const unsigned char ca_cert[] = {
#include "ca.der.inc"
};
static const unsigned char server_cert[] = {
#include "server.der.inc"
};
static const unsigned char server_key[] = {
#include "server_privkey.der.inc"
};
/* Self-signed and unrelated to ca_cert: a trust anchor the server does not
 * chain to. */
static const unsigned char other_ca_cert[] = {
#include "echo-apps-cert.der.inc"
};

enum {
	TAG_SERVER = 10,
	TAG_CA,
	TAG_OTHER_CA,
};

enum {
	PORT_TLS_OK = 4401,
	PORT_TLS_WRONG_CA,
	PORT_TLS_WRONG_NAME,
	PORT_TLS_WRONG_NAME_DEFAULT,
	PORT_TLS_ALPN_OK,
	PORT_TLS_ALPN_MISMATCH,
};

/* The protocol the test server offers when a test asks for ALPN. */
#define SERVER_ALPN "x-alp-test"

/* What a refused handshake looks like to the caller: Zephyr reports a failed
 * TLS handshake on connect() as ECONNABORTED, mapped to ALP_ERR_IO.  Asserted
 * exactly, so a refusal cannot be confused with a config or memory failure. */
#define assert_handshake_refused(t, cfg) \
	do { \
		zassert_equal(alp_cloud_transport_connect((t), (cfg)), ALP_ERR_IO); \
		zassert_equal((t)->last_errno, ECONNABORTED, "last_errno = %d", (t)->last_errno); \
		zassert_false((t)->connected); \
	} while (0)

/* The certificate's subject; the socket itself connects to PEER_HOST. */
#define SERVER_NAME "localhost"

#define SERVER_STACK_SIZE 8192
K_THREAD_STACK_DEFINE(g_server_stack, SERVER_STACK_SIZE);
static struct k_thread g_server_thread;
/* The listening socket of the running server, or -1 when none is running. */
static int g_listen_fd = -1;

/* Accept one connection (the TLS handshake happens inside accept), echo one
 * message back, and close.  A refused handshake makes accept fail; that is the
 * expected outcome of the refusal tests, so it is not asserted here. */
static void tls_server(void *p1, void *p2, void *p3)
{
	int  lfd = POINTER_TO_INT(p1);
	char buf[32];

	ARG_UNUSED(p2);
	ARG_UNUSED(p3);

	int fd = zsock_accept(lfd, NULL, NULL);

	if (fd < 0) {
		return;
	}

	ssize_t n = zsock_recv(fd, buf, sizeof(buf), 0);

	if (n > 0) {
		(void)zsock_send(fd, buf, n, 0);
	}
	zsock_close(fd);
}

static void tls_listen_alpn(uint16_t port, bool offer_alpn)
{
	static const sec_tag_t   tags[] = { TAG_SERVER };
	static const char *const alpn[] = { SERVER_ALPN };
	struct sockaddr_in       addr   = { .sin_family = AF_INET, .sin_port = htons(port) };
	int                      fd     = zsock_socket(AF_INET, SOCK_STREAM, IPPROTO_TLS_1_2);

	zassert_true(fd >= 0, "socket: %d", errno);
	/* Recorded first, so a failed assertion below still gets it closed. */
	g_listen_fd = fd;
	zassert_ok(zsock_setsockopt(fd, SOL_TLS, TLS_SEC_TAG_LIST, tags, sizeof(tags)));
	if (offer_alpn) {
		zassert_ok(zsock_setsockopt(fd, SOL_TLS, TLS_ALPN_LIST, alpn, sizeof(alpn)));
	}
	zassert_equal(zsock_inet_pton(AF_INET, PEER_HOST, &addr.sin_addr), 1);
	zassert_ok(zsock_bind(fd, (struct sockaddr *)&addr, sizeof(addr)), "bind: %d", errno);
	zassert_ok(zsock_listen(fd, 1), "listen: %d", errno);

	k_thread_create(&g_server_thread,
	                g_server_stack,
	                SERVER_STACK_SIZE,
	                tls_server,
	                INT_TO_POINTER(fd),
	                NULL,
	                NULL,
	                K_PRIO_PREEMPT(8),
	                0,
	                K_NO_WAIT);
}

static void tls_listen(uint16_t port)
{
	tls_listen_alpn(port, false);
}

/* Closing the listener unblocks a server still parked in accept.  Also the
 * suite's `after` hook, so a failed assertion cannot leave the thread object
 * live for the next test to reuse. */
static void tls_stop(void)
{
	if (g_listen_fd < 0) {
		return;
	}
	zsock_close(g_listen_fd);
	g_listen_fd = -1;
	if (k_thread_join(&g_server_thread, K_SECONDS(5)) != 0) {
		k_thread_abort(&g_server_thread);
	}
}

static void tls_after(void *fixture)
{
	ARG_UNUSED(fixture);
	tls_stop();
}

static void *tls_setup(void)
{
	zassert_ok(tls_credential_add(
	    TAG_SERVER, TLS_CREDENTIAL_PUBLIC_CERTIFICATE, server_cert, sizeof(server_cert)));
	zassert_ok(
	    tls_credential_add(TAG_SERVER, TLS_CREDENTIAL_PRIVATE_KEY, server_key, sizeof(server_key)));
	zassert_ok(tls_credential_add(TAG_CA, TLS_CREDENTIAL_CA_CERTIFICATE, ca_cert, sizeof(ca_cert)));
	zassert_ok(tls_credential_add(
	    TAG_OTHER_CA, TLS_CREDENTIAL_CA_CERTIFICATE, other_ca_cert, sizeof(other_ca_cert)));
	return NULL;
}

static alp_cloud_transport_config_t tls_cfg(uint16_t port, const int *tag, const char *name)
{
	return (alp_cloud_transport_config_t){
		.host            = PEER_HOST,
		.server_name     = name,
		.port            = port,
		.sec_tags        = tag,
		.sec_tag_count   = 1,
		.recv_timeout_ms = 2000,
	};
}

ZTEST(cloud_transport_tls, test_handshake_and_round_trip)
{
	static const int             tag   = TAG_CA;
	static const char            msg[] = "over tls";
	char                         buf[16];
	alp_cloud_transport_t        t   = ALP_CLOUD_TRANSPORT_INIT;
	alp_cloud_transport_config_t cfg = tls_cfg(PORT_TLS_OK, &tag, SERVER_NAME);

	tls_listen(PORT_TLS_OK);
	zassert_ok(alp_cloud_transport_connect(&t, &cfg));
	zassert_equal(alp_cloud_transport_send(&t, msg, sizeof(msg)), sizeof(msg));
	zassert_equal(alp_cloud_transport_recv(&t, buf, sizeof(buf)), sizeof(msg));
	zassert_mem_equal(buf, msg, sizeof(msg));

	alp_cloud_transport_close(&t);
}

ZTEST(cloud_transport_tls, test_untrusted_ca_is_refused)
{
	static const int             tag = TAG_OTHER_CA;
	alp_cloud_transport_t        t   = ALP_CLOUD_TRANSPORT_INIT;
	alp_cloud_transport_config_t cfg = tls_cfg(PORT_TLS_WRONG_CA, &tag, SERVER_NAME);

	tls_listen(PORT_TLS_WRONG_CA);
	/* A server that does not chain to the configured CA. */
	assert_handshake_refused(&t, &cfg);
}

ZTEST(cloud_transport_tls, test_wrong_server_name_is_refused)
{
	static const int             tag = TAG_CA;
	alp_cloud_transport_t        t   = ALP_CLOUD_TRANSPORT_INIT;
	alp_cloud_transport_config_t cfg = tls_cfg(PORT_TLS_WRONG_NAME, &tag, "broker.invalid");

	tls_listen(PORT_TLS_WRONG_NAME);
	/* A certificate issued for another name. */
	assert_handshake_refused(&t, &cfg);

	/* Same CA, same server, the name left to default to the IP literal:
	 * the certificate is for "localhost", so this is refused as well. */
	cfg.server_name = NULL;
	tls_stop();
	tls_listen(PORT_TLS_WRONG_NAME_DEFAULT);
	cfg.port = PORT_TLS_WRONG_NAME_DEFAULT;
	assert_handshake_refused(&t, &cfg);

	cfg.server_name = "";
	zassert_equal(alp_cloud_transport_connect(&t, &cfg), ALP_ERR_INVAL);
}

ZTEST(cloud_transport_tls, test_alpn_is_negotiated)
{
	static const int             tag    = TAG_CA;
	static const char *const     alpn[] = { SERVER_ALPN };
	static const char            msg[]  = "alpn";
	char                         buf[8];
	alp_cloud_transport_t        t   = ALP_CLOUD_TRANSPORT_INIT;
	alp_cloud_transport_config_t cfg = tls_cfg(PORT_TLS_ALPN_OK, &tag, SERVER_NAME);

	cfg.alpn       = alpn;
	cfg.alpn_count = ARRAY_SIZE(alpn);
	tls_listen_alpn(PORT_TLS_ALPN_OK, true);

	zassert_ok(alp_cloud_transport_connect(&t, &cfg));
	zassert_equal(alp_cloud_transport_send(&t, msg, sizeof(msg)), sizeof(msg));
	zassert_equal(alp_cloud_transport_recv(&t, buf, sizeof(buf)), sizeof(msg));

	alp_cloud_transport_close(&t);
}

ZTEST(cloud_transport_tls, test_alpn_mismatch_is_refused)
{
	static const int             tag    = TAG_CA;
	static const char *const     alpn[] = { "x-not-offered" };
	static const char *const     many[] = { "a", "b", "c", "d", "e" };
	alp_cloud_transport_t        t      = ALP_CLOUD_TRANSPORT_INIT;
	alp_cloud_transport_config_t cfg    = tls_cfg(PORT_TLS_ALPN_MISMATCH, &tag, SERVER_NAME);

	BUILD_ASSERT(ARRAY_SIZE(many) > CONFIG_NET_SOCKETS_TLS_MAX_APP_PROTOCOLS);

	/* The server offers SERVER_ALPN only: proof the client's list reaches
	 * the handshake rather than being dropped on the way. */
	cfg.alpn       = alpn;
	cfg.alpn_count = ARRAY_SIZE(alpn);
	tls_listen_alpn(PORT_TLS_ALPN_MISMATCH, true);
	assert_handshake_refused(&t, &cfg);

	/* More names than the stack holds is a caller error, caught before any
	 * socket exists. */
	cfg.alpn       = many;
	cfg.alpn_count = ARRAY_SIZE(many);
	zassert_equal(alp_cloud_transport_connect(&t, &cfg), ALP_ERR_INVAL);
}

ZTEST(cloud_transport_tls, test_sockopt_failure_closes_the_socket)
{
	/* More tags than the stack takes: setsockopt(TLS_SEC_TAG_LIST) fails
	 * with EINVAL after the socket exists. */
	static const int             tags[CONFIG_TLS_MAX_CREDENTIALS_NUMBER + 1] = { TAG_CA };
	alp_cloud_transport_t        t   = ALP_CLOUD_TRANSPORT_INIT;
	alp_cloud_transport_config_t cfg = tls_cfg(PORT_TLS_OK, tags, SERVER_NAME);

	cfg.sec_tag_count = ARRAY_SIZE(tags);

	/* More attempts than the socket table has slots: a leaked socket per
	 * failure would turn the status into a different error. */
	for (int i = 0; i < 3 * CONFIG_NET_SOCKETS_TLS_MAX_CONTEXTS; i++) {
		/* The stack frees a closed socket asynchronously. */
		k_msleep(50);
		t.last_errno = 0;
		int st       = alp_cloud_transport_connect(&t, &cfg);
		zassert_equal(st, ALP_ERR_INVAL, "attempt %d st %d errno %d", i, st, t.last_errno);
		zassert_equal(t.last_errno, EINVAL);
		zassert_false(t.connected);
	}
}

ZTEST_SUITE(cloud_transport_tls, NULL, tls_setup, NULL, tls_after, NULL);
```
