## tests/zephyr/cc3501e_bridge_transport/testcase.yaml
```yaml
# SPDX-License-Identifier: Apache-2.0
#
# Native-sim unit tests for the cc3501e-bridge SPI-slave transport +
# shared framing/dispatch (firmware/cc3501e/src/), linked against the
# silicon-free stub HAL.  Lives under tests/zephyr/ (not tests/unit/) so
# the pr-twister gate actually runs it -- tests/unit/ is not yet in any
# twister root (issue #90).

tests:
  alp_sdk.cc3501e.bridge_transport:
    platform_allow:
      - native_sim
      - native_sim/native/64
    integration_platforms:
      - native_sim
      - native_sim/native/64
    tags:
      - alp-sdk
      - cc3501e-bridge
      - transport
```

## tests/zephyr/cc3501e_host_events/testcase.yaml
```yaml
# SPDX-License-Identifier: Apache-2.0
#
# Native-sim unit tests for the CC3501E async-event host wrapper
# (chips/cc3501e/cc3501e.c: cc3501e_poll_events), driven against a software
# model of the firmware event-ring slave.  Lives under tests/zephyr/ (not
# tests/unit/) so the pr-twister gate actually runs it.

tests:
  alp_sdk.cc3501e.host_events:
    platform_allow:
      - native_sim
      - native_sim/native/64
    integration_platforms:
      - native_sim
      - native_sim/native/64
    tags:
      - alp-sdk
      - cc3501e
      - events
```

## tests/zephyr/cc3501e_host_ota/testcase.yaml
```yaml
# SPDX-License-Identifier: Apache-2.0
#
# Native-sim unit tests for the CC3501E OTA host wrappers
# (chips/cc3501e/cc3501e.c), driven against a software model of the
# firmware OTA slave.  Lives under tests/zephyr/ (not tests/unit/) so the
# pr-twister gate actually runs it -- tests/unit/ is not yet in any
# twister root (issue #90).

tests:
  alp_sdk.cc3501e.host_ota:
    platform_allow:
      - native_sim
      - native_sim/native/64
    integration_platforms:
      - native_sim
      - native_sim/native/64
    tags:
      - alp-sdk
      - cc3501e
      - ota
```

## tests/zephyr/cc3501e_wifi_backend_security/testcase.yaml
```yaml
# SPDX-License-Identifier: Apache-2.0
#
# Native-sim end-to-end test for issue #742 (CC3501E Wi-Fi security
# selection): drives the real <alp/iot.h> Wi-Fi dispatcher + CC3501E backend
# + chip driver against a software model of the firmware SPI slave.  Lives
# under tests/zephyr/ (not tests/unit/) so the pr-twister gate runs it
# (tests/unit/ is not yet in any twister root -- issue #90).

tests:
  alp_sdk.cc3501e.wifi_backend_security:
    platform_allow:
      - native_sim
      - native_sim/native/64
    integration_platforms:
      - native_sim
      - native_sim/native/64
    tags:
      - alp-sdk
      - cc3501e
      - wifi
```

## tests/zephyr/chips/dts/bindings/alp,fake-lsm6dso.yaml
```yaml
# Copyright 2026 ALP Lab AB
# SPDX-License-Identifier: Apache-2.0
#
# Fake LSM6DSO emul target.  Lives in this test only.

description: |
  Fake STMicro LSM6DSO i2c-emul target used by the alp-sdk chips
  ztest to verify register-protocol behaviour without a real chip.
  Pre-populates WHO_AM_I = 0x6C and echoes register writes back on
  subsequent reads.

compatible: "alp,fake-lsm6dso"

include: i2c-device.yaml
```

## tests/zephyr/chips/dts/bindings/alp,fake-optiga-trust-m.yaml
```yaml
description: Fake Infineon OPTIGA Trust M secure element for i2c-emul chip tests.
compatible: "alp,fake-optiga-trust-m"
include: i2c-device.yaml
```

## tests/zephyr/chips/dts/bindings/alp,fake-ssd1306.yaml
```yaml
# Copyright 2026 Alp Lab AB
# SPDX-License-Identifier: Apache-2.0
#
# Fake SSD1306 emul target.  Lives in this test only.

description: |
  Fake Solomon Systech SSD1306 i2c-emul target used by the alp-sdk
  chips ztest.  Records each I2C write into separate command and
  data byte logs (split by the SSD1306 control byte 0x00 / 0x40)
  so the test can verify the driver's init opcode sequence.

compatible: "alp,fake-ssd1306"

include: i2c-device.yaml
```

## tests/zephyr/chips/dts/bindings/alp,fake-tmp112.yaml
```yaml
description: Fake TI TMP112 temperature sensor for i2c-emul chip tests.
compatible: "alp,fake-tmp112"
include: i2c-device.yaml
```

## tests/zephyr/conformance/testcase.yaml
```yaml
# SPDX-License-Identifier: Apache-2.0

tests:
  # Portable-API conformance gate: one data-driven suite every
  # backend must pass.  See src/main.c for the class x case matrix
  # and docs/porting-new-som.md ("Conformance gate") for how a new
  # SoM port consumes it.
  #
  # CI runs it on native_sim (integration_platforms).  The qualified
  # in-repo real boards are allowed too so `twister -p <board>` can
  # build (and, on the bench / nightly HIL, run) the same gate with
  # the real backend selected -- their boards/<board>.conf pins the
  # CONFIG_ALP_SOC_* capability profile, which switches the suite's
  # per-class expectations from the permissive native_sim fallback to
  # strict alp_has() caps<->backend parity.
  alp_sdk.conformance.portable_api:
    platform_allow:
      - native_sim
      - native_sim/native/64
      - alp_e1m_aen801_m55_he/ae822fa0e5597ls0/rtss_he
      - alp_e1m_aen801_m55_hp/ae822fa0e5597ls0/rtss_hp
      - alp_e1m_v2m101_m33_sm/r9a09g056n48gbg/cm33
    integration_platforms:
      - native_sim/native/64
    tags:
      - alp-sdk
      - conformance
      - peripheral

  # <alp/testing/*> virtual-backend behavioral suite (epic #610: PR1
  # GPIO, PR2 UART -- the first virtual-clock TIMEOUT consumer).
  # native_sim ONLY, deliberately: CONFIG_ALP_SDK_TESTING registers a
  # priority-255 silicon_ref="*" backend per enabled class, which
  # outranks every real backend -- pointing this at a qualified board
  # (the portable_api scenario's platform_allow above) would hijack
  # its peripheral selection instead of exercising the real silicon.
  alp_sdk.conformance.test_doubles:
    extra_configs:
      - CONFIG_ALP_SDK_TESTING=y
    tags:
      - alp-sdk
      - conformance
      - testing
  # Same build, under the Alp-maintainer strict-warning profile + -Werror
  # (issue #634).  native_sim/native/64 only -- this suite's prj.conf pulls
  # in most first-party dispatchers/backends (see CONFIG_* list above), so
  # it's representative first-party Zephyr-module coverage for the profile
  # without forcing every real-SoM board build (whose vendor-driver mix
  # under zephyr/drivers/** is out of this profile's scope -- see
  # zephyr/CMakeLists.txt's per-source COMPILE_OPTIONS restriction) into
  # this gate.  build-only: the point is a clean, error-free compile, not
  # re-running the conformance assertions a second time.
  alp_sdk.conformance.portable_api.strict_warnings:
    extra_configs:
      - CONFIG_ALP_SDK_STRICT_WARNINGS=y
      - CONFIG_ALP_SDK_WERROR=y
    build_only: true
    tags:
      - alp-sdk
      - conformance
      - peripheral
      - strict-warnings
```

## tests/zephyr/display/testcase.yaml
```yaml
# SPDX-License-Identifier: Apache-2.0

tests:
  # Real-backend scenario: the upstream dummy display controller
  # (CONFIG_DUMMY_DISPLAY, zephyr,dummy-dc) backs the alp-display0
  # alias, so open / get_caps / blit / clear / close plus the param-
  # validation edges run against the real zephyr_drv backend.
  alp_sdk.display.zephyr_drv:
    platform_allow:
      - native_sim
      - native_sim/native/64
    integration_platforms:
      - native_sim/native/64
    extra_args:
      - "DTC_OVERLAY_FILE=overlays/dummy_display.overlay"
    tags:
      - alp-sdk
      - display
      - backend

  # No-device scenario: CONFIG_DISPLAY=y so zephyr_drv is compiled
  # and selected, but no alp-displayN alias exists in DT.  Proves
  # the clean degrade on boards without a display node: open returns
  # NULL with ALP_ERR_NOT_READY, nothing crashes at boot.
  alp_sdk.display.no_device:
    platform_allow:
      - native_sim
      - native_sim/native/64
    integration_platforms:
      - native_sim/native/64
    tags:
      - alp-sdk
      - display
      - backend

  # DBI Type C integration scenario: instantiate Zephyr's upstream
  # zephyr,mipi-dbi-spi controller plus an ST7789V child panel and
  # expose the child as both zephyr,display and alp-display0.  This is
  # build-only because native_sim's SPI-emul controller still needs a
  # target emulator for real transfer IO; runtime display semantics are
  # covered by the dummy-dc scenario above.
  alp_sdk.display.mipi_dbi_type_c_build:
    platform_allow:
      - native_sim
      - native_sim/native/64
    integration_platforms:
      - native_sim/native/64
    build_only: true
    extra_args:
      - "DTC_OVERLAY_FILE=overlays/mipi_dbi_type_c_st7789.overlay"
      - "EXTRA_CONF_FILE=prj_mipi_dbi_type_c.conf"
    tags:
      - alp-sdk
      - display
      - mipi-dbi
      - backend

  # Stub-fallback scenario: CONFIG_DISPLAY=n removes the zephyr_drv
  # backend entirely; the wildcard priority-0 stub is selected and
  # open degrades with ALP_ERR_NOT_IMPLEMENTED.
  alp_sdk.display.stub_fallback:
    platform_allow:
      - native_sim
      - native_sim/native/64
    integration_platforms:
      - native_sim/native/64
    extra_args:
      - "EXTRA_CONF_FILE=prj_stub.conf"
    tags:
      - alp-sdk
      - display
      - backend
```

## tests/zephyr/gui_lvgl/testcase.yaml
```yaml
# SPDX-License-Identifier: Apache-2.0

tests:
  # Real bridge scenario: CONFIG_LVGL=y, so alp_gui_lvgl_attach() takes
  # the real LVGL v9 hand-off (src/gui_lvgl.c). A local priority-255
  # test-double display backend (src/main.c) proves the flush_cb path
  # reaches alp_display_blit() when LVGL renders a frame, and that the
  # unsupported-pixel-format (MONO_VLSB) rejection holds.
  alp_sdk.gui.lvgl_attach:
    platform_allow:
      - native_sim
      - native_sim/native/64
    integration_platforms:
      - native_sim/native/64
    tags:
      - alp-sdk
      - gui
      - lvgl

  # NOSUPPORT scenario: CONFIG_LVGL=n, so no build wires LVGL in and
  # alp_gui_lvgl_attach() takes the guard-clause degrade.
  alp_sdk.gui.lvgl_attach_nosupport:
    platform_allow:
      - native_sim
      - native_sim/native/64
    integration_platforms:
      - native_sim/native/64
    extra_args:
      - "EXTRA_CONF_FILE=prj_no_lvgl.conf"
    tags:
      - alp-sdk
      - gui
      - lvgl
```

## tests/zephyr/hw_info/testcase.yaml
```yaml
# SPDX-License-Identifier: Apache-2.0

tests:
  alp_sdk.hw_info.smoke:
    platform_allow:
      - native_sim
      - native_sim/native/64
    integration_platforms:
      - native_sim/native/64
    tags:
      - alp-sdk
      - hw_info
```

## tests/zephyr/i2c_regfile/testcase.yaml
```yaml
# SPDX-License-Identifier: Apache-2.0

tests:
  # Default scenario: CONFIG_I2C_TARGET=y.  native_sim's emulated
  # controller forwards same-bus transfers addressed to the registered
  # target, so the loopback tests exercise the helper's register-file
  # state machine (pointer latch / auto-increment / wraparound / STOP
  # re-arm / write window / stats) for real, plus the param-validation
  # surface.
  alp_sdk.i2c_regfile.default:
    platform_allow:
      - native_sim
      - native_sim/native/64
    integration_platforms:
      - native_sim/native/64
    tags:
      - alp-sdk
      - i2c
      - regfile

  # Degrade-path scenario: CONFIG_I2C_TARGET=n makes the controller
  # driver's target_register NULL (-ENOSYS), so alp_i2c_target_open
  # fails with ALP_ERR_NOSUPPORT -- the helper must propagate exactly
  # that.  The loopback tests compile out; the param-validation tests
  # run in both builds.
  alp_sdk.i2c_regfile.notarget:
    platform_allow:
      - native_sim
      - native_sim/native/64
    integration_platforms:
      - native_sim/native/64
    extra_args:
      - "EXTRA_CONF_FILE=prj_notarget.conf"
    tags:
      - alp-sdk
      - i2c
      - regfile
```

## tests/zephyr/inference/testcase.yaml
```yaml
# SPDX-License-Identifier: Apache-2.0

tests:
  alp_sdk.inference.smoke:
    platform_allow:
      - native_sim
      - native_sim/native/64
    integration_platforms:
      - native_sim/native/64
    tags:
      - alp-sdk
      - inference
```

## tests/zephyr/mproc/testcase.yaml
```yaml
# SPDX-License-Identifier: Apache-2.0

tests:
  alp_sdk.mproc.smoke:
    platform_allow:
      - native_sim
      - native_sim/native/64
    integration_platforms:
      - native_sim/native/64
    tags:
      - alp-sdk
      - mproc

  # v0.4-prep: flips CONFIG_ALP_SDK_MPROC_NANOPB_FRAMING=y to
  # compile-verify the framing-on-send + unframing-on-receive paths
  # in mproc_zephyr.c.  The IPC envelope encode/decode helpers are
  # still exercised by the same ZTESTs (they don't need a real mbox
  # device); this scenario adds the build assertion that the framing
  # branch in alp_mbox_send compiles cleanly.
  alp_sdk.mproc.nanopb_framing:
    platform_allow:
      - native_sim
      - native_sim/native/64
    integration_platforms:
      - native_sim/native/64
    extra_args:
      - "EXTRA_CONF_FILE=prj_nanopb_framing.conf"
    tags:
      - alp-sdk
      - mproc
      - nanopb

  # 2026-05-17: real-backend exercise for shmem + hwsem -- pulls in
  # the native_sim DT overlay declaring alp-shmem0/1 + flips
  # CONFIG_ALP_SDK_MPROC=y so the wrapper takes the DT-alias-lookup
  # path (shmem) + the k_sem fallback (hwsem) instead of the
  # NOSUPPORT shortcircuit.
  alp_sdk.mproc.shmem_hwsem:
    platform_allow:
      - native_sim
      - native_sim/native/64
    integration_platforms:
      - native_sim/native/64
    extra_args:
      - "EXTRA_CONF_FILE=prj_shmem_hwsem.conf"
    tags:
      - alp-sdk
      - mproc
      - shmem
```
