## zephyr/Kconfig.alp-libraries
```kconfig
# SPDX-License-Identifier: Apache-2.0
#
# Per-library + per-backend Kconfig symbols emitted by the
# §D.lib.loader cross-library HW-backend loader hook in
# scripts/alp_project.py.  Each enabled library's
# metadata/library-profiles/<name>/hw-backends.yaml names accelerator
# *classes* (not vendor parts) -- the loader cross-references those
# against the active SoM family and emits the highest-priority
# matching `CONFIG_ALP_<LIB>_<BACKEND>=y` knob.  Every library has a
# pure-SW fallback that is always available.
#
# Sourced under `if ALP_SDK` from zephyr/Kconfig once the loader hook
# is consumed downstream.  This file just declares the symbols.

# v0.5 §D.lib.loader -- per-library HW-accelerator Kconfig knobs.

menu "ALP SDK per-library HW-accelerator wiring"

# ----------------------------------------------------------------------
# tflite_micro
# ----------------------------------------------------------------------

config ALP_TFLM_ETHOS_U85
	bool "TFLite-Micro on Alif Ethos-U85 NPU (E4 / E6 / E8 only)"
	depends on ALP_SOC_ALIF_ENSEMBLE_E4 || ALP_SOC_ALIF_ENSEMBLE_E6 || \
	           ALP_SOC_ALIF_ENSEMBLE_E8
	help
	  Compile TFLite-Micro kernels against the Alif Ethos-U85 NPU
	  back-end (delegated execution).  Only E4 / E6 / E8 populate a
	  U85 alongside the family-standard pair of U55s.  U85 supports
	  Transformers and is the strategic forward path for Generative
	  AI workloads on the Ensemble family.

config ALP_TFLM_ETHOS_U55
	bool "TFLite-Micro on Alif Ethos-U55 NPU"
	depends on ALP_SOC_ALIF_ENSEMBLE_E3 || ALP_SOC_ALIF_ENSEMBLE_E4 || \
	           ALP_SOC_ALIF_ENSEMBLE_E5 || ALP_SOC_ALIF_ENSEMBLE_E6 || \
	           ALP_SOC_ALIF_ENSEMBLE_E7 || ALP_SOC_ALIF_ENSEMBLE_E8
	help
	  Compile TFLite-Micro kernels against an Alif Ethos-U55 NPU
	  back-end (delegated execution).  Every Ensemble SKU carries
	  two U55s (NPU-HE paired with M55-HE, NPU-HP paired with
	  M55-HP); the driver shim is the same for both instances and
	  selects at runtime via base-address + IRQ.  Enabled on every
	  E* SoC -- it's the family-wide primary on E3 / E5 / E7 (no
	  U85) and the secondary on E4 / E6 / E8 (alongside the U85).

config ALP_TFLM_ETHOS_U65
	bool "TFLite-Micro on NXP i.MX 93 Ethos-U65 NPU"
	depends on ALP_SOC_NXP_IMX9_IMX93
	help
	  Compile TFLite-Micro kernels against the Ethos-U65 NPU
	  embedded in i.MX 93.  Same TFLM op-resolver as U55 / U85;
	  Vela's `--accelerator-config ethos-u65-256` target.  The
	  legacy `CONFIG_ALP_SDK_INFERENCE_ETHOS_U_N93=y` knob is the
	  N93-specific driver shim that complements this kernel-level
	  knob.

config ALP_TFLM_DRP_AI
	bool "TFLite-Micro on Renesas DRP-AI NPU"
	depends on ALP_SOC_RENESAS_RZV2N_N44
	help
	  Compile TFLite-Micro kernels against the Renesas DRP-AI3 NPU.

config ALP_TFLM_HELIUM
	bool "TFLite-Micro CMSIS-NN with Helium MVE (Cortex-M55)"
	depends on ALP_SOC_ALIF_ENSEMBLE_E3 || ALP_SOC_ALIF_ENSEMBLE_E4 || \
	           ALP_SOC_ALIF_ENSEMBLE_E5 || ALP_SOC_ALIF_ENSEMBLE_E6 || \
	           ALP_SOC_ALIF_ENSEMBLE_E7 || ALP_SOC_ALIF_ENSEMBLE_E8

config ALP_TFLM_NEON
	bool "TFLite-Micro with Arm Neon SIMD (Cortex-A55)"
	depends on ALP_SOC_RENESAS_RZV2N_N44

config ALP_TFLM_DMA_COPY
	bool "TFLite-Micro input tensor copy via DMA"

config ALP_TFLM_REF_KERNELS
	bool "TFLite-Micro reference kernels (SW fallback)"
	default y

# ----------------------------------------------------------------------
# u8g2
# ----------------------------------------------------------------------

config ALP_U8G2_DMA2D
	bool "u8g2 fast blit via DMA2D"

config ALP_U8G2_TMU
	bool "u8g2 fast blit via GD32 TMU bridge"

config ALP_U8G2_BUS_DMA
	bool "u8g2 I2C/SPI frame push via DMA"

config ALP_U8G2_SW_BLIT
	bool "u8g2 pure-C SW blit (fallback)"
	default y

# ----------------------------------------------------------------------
# gfx_compat (maintainer-written thin shim)
# ----------------------------------------------------------------------

config ALP_GFX_COMPAT_GPU2D
	bool "gfx_compat -> Alif GPU2D backend"
config ALP_GFX_COMPAT_DMA2D
	bool "gfx_compat -> generic DMA2D backend"
config ALP_GFX_COMPAT_SPI_DMA
	bool "gfx_compat SPI push via DMA"
config ALP_GFX_COMPAT_SW
	bool "gfx_compat pure-C SW blit (fallback)"
	default y

# ----------------------------------------------------------------------
# madgwick_ahrs + pid + modbus
# ----------------------------------------------------------------------

config ALP_MADGWICK_FPU
	bool "Madgwick AHRS via FPU"
config ALP_MADGWICK_TMU
	bool "Madgwick AHRS via GD32 TMU CORDIC"
config ALP_MADGWICK_LIBM
	bool "Madgwick AHRS via libm (SW fallback)"
	default y

config ALP_PID_FPU
	bool "PID via FPU"
config ALP_PID_TIMER
	bool "PID with hardware timer-tick"
config ALP_PID_INT_MATH
	bool "PID with integer math (SW fallback)"
	default y

config ALP_MODBUS_UART_DMA
	bool "Modbus over UART with DMA TX/RX"
config ALP_MODBUS_ETH_DMA
	bool "Modbus over Ethernet with DMA"
config ALP_MODBUS_SYNC_IO
	bool "Modbus synchronous I/O (SW fallback)"
	default y

# ----------------------------------------------------------------------
# IoT libs (coremqtt_sn / libcoap / tinygsm / nanopb / libwebsockets /
# jsmn / bearssl)
# ----------------------------------------------------------------------

config ALP_MQTTSN_MBEDTLS
	bool "coreMQTT-SN with mbedTLS"
config ALP_MQTTSN_BEARSSL
	bool "coreMQTT-SN with BearSSL"
config ALP_MQTTSN_NO_TLS
	bool "coreMQTT-SN without TLS (SW fallback)"
	default y

config ALP_COAP_MBEDTLS
	bool "libcoap with mbedTLS DTLS"
config ALP_COAP_OSCORE
	bool "libcoap with OSCORE"
config ALP_COAP_NO_TLS
	bool "libcoap without TLS (SW fallback)"
	default y

config ALP_TINYGSM_UART_DMA
	bool "TinyGSM UART traffic with DMA"
config ALP_TINYGSM_SYNC_IO
	bool "TinyGSM synchronous UART (SW fallback)"
	default y

config ALP_NANOPB_SW
	bool "nanopb (always pure-SW)"
	default y

config ALP_LWS_MBEDTLS
	bool "libwebsockets with mbedTLS"
config ALP_LWS_BEARSSL
	bool "libwebsockets with BearSSL"
config ALP_LWS_TCP_DMA
	bool "libwebsockets TCP TX/RX with DMA"
config ALP_LWS_NO_TLS
	bool "libwebsockets without TLS (SW fallback)"
	default y

config ALP_JSMN_SW
	bool "jsmn (always pure-SW)"
	default y

config ALP_BEARSSL_CAU
	bool "BearSSL backed by GD32 CAU"
config ALP_BEARSSL_CRYPTOCELL
	bool "BearSSL backed by Alif CryptoCell"
config ALP_BEARSSL_INLINE_AES
	bool "BearSSL backed by Alif inline-AES instruction"
config ALP_BEARSSL_OPTIGA
	bool "BearSSL TLS handshake via OPTIGA Trust M"
config ALP_BEARSSL_PURE_C
	bool "BearSSL pure-C (SW fallback)"
	default y

# ----------------------------------------------------------------------
# Audio libs (minimp3 / opus / libhelix)
# ----------------------------------------------------------------------

config ALP_MINIMP3_HELIUM
	bool "minimp3 with Helium MVE SIMD"
config ALP_MINIMP3_NEON
	bool "minimp3 with Arm Neon SIMD"
config ALP_MINIMP3_FPU
	bool "minimp3 with FPU"
config ALP_MINIMP3_I2S_DMA
	bool "minimp3 PCM out via I2S DMA"
config ALP_MINIMP3_PURE_C
	bool "minimp3 pure-C (SW fallback)"
	default y

config ALP_OPUS_HELIUM
	bool "Opus with Helium MVE SIMD"
config ALP_OPUS_NEON
	bool "Opus with Arm Neon SIMD"
config ALP_OPUS_FPU
	bool "Opus with FPU"
config ALP_OPUS_I2S_DMA
	bool "Opus PCM out via I2S DMA"
config ALP_OPUS_PURE_C
	bool "Opus pure-C (SW fallback)"
	default y

config ALP_LIBHELIX_FPU
	bool "libhelix with FPU"
config ALP_LIBHELIX_I2S_DMA
	bool "libhelix PCM out via I2S DMA"
config ALP_LIBHELIX_PURE_C
	bool "libhelix pure-C (SW fallback)"
	default y

# ----------------------------------------------------------------------
# Catch2 (host-only test fixture)
# ----------------------------------------------------------------------

config ALP_CATCH2_SW
	bool "Catch2 (always pure-SW)"
	default y

# ----------------------------------------------------------------------
# Baseline libraries (v0.2-era) -- HW-backend knobs added in §D.lib's
# follow-up audit so the existing 4 libraries with HW bindings now
# match the per-library hw-backends.yaml convention introduced for
# the 17 new libs.
# ----------------------------------------------------------------------

config ALP_LVGL_GPU2D
	bool "LVGL via Alif GPU2D"
	depends on ALP_SOC_ALIF_ENSEMBLE_E3 || ALP_SOC_ALIF_ENSEMBLE_E4 || \
	           ALP_SOC_ALIF_ENSEMBLE_E5 || ALP_SOC_ALIF_ENSEMBLE_E6 || \
	           ALP_SOC_ALIF_ENSEMBLE_E7 || ALP_SOC_ALIF_ENSEMBLE_E8
config ALP_LVGL_DAVE2D
	bool "LVGL via Alif DAVE2D"
	depends on ALP_SOC_ALIF_ENSEMBLE_E3 || ALP_SOC_ALIF_ENSEMBLE_E4 || \
	           ALP_SOC_ALIF_ENSEMBLE_E5 || ALP_SOC_ALIF_ENSEMBLE_E6 || \
	           ALP_SOC_ALIF_ENSEMBLE_E7 || ALP_SOC_ALIF_ENSEMBLE_E8
config ALP_LVGL_TMU
	bool "LVGL via GD32 bridge TMU rotate/scale"
config ALP_LVGL_DMA2D
	bool "LVGL framebuffer push via DMA2D"
config ALP_LVGL_SW_BLIT
	bool "LVGL pure-C SW blit (fallback)"
	default y

config ALP_MBEDTLS_CRYPTOCELL
	bool "mbedTLS AES/RSA/ECDSA via Alif CryptoCell"
	depends on ALP_SOC_ALIF_ENSEMBLE_E3 || ALP_SOC_ALIF_ENSEMBLE_E4 || \
	           ALP_SOC_ALIF_ENSEMBLE_E5 || ALP_SOC_ALIF_ENSEMBLE_E6 || \
	           ALP_SOC_ALIF_ENSEMBLE_E7 || ALP_SOC_ALIF_ENSEMBLE_E8
config ALP_MBEDTLS_INLINE_AES
	bool "mbedTLS AES via Alif M55 inline-AES instruction"
	depends on ALP_SOC_ALIF_ENSEMBLE_E3 || ALP_SOC_ALIF_ENSEMBLE_E4 || \
	           ALP_SOC_ALIF_ENSEMBLE_E5 || ALP_SOC_ALIF_ENSEMBLE_E6 || \
	           ALP_SOC_ALIF_ENSEMBLE_E7 || ALP_SOC_ALIF_ENSEMBLE_E8
config ALP_MBEDTLS_CAU
	bool "mbedTLS AES via GD32 bridge CAU"
config ALP_MBEDTLS_OPTIGA
	bool "mbedTLS TLS handshake via OPTIGA Trust M"
config ALP_MBEDTLS_PURE_C
	bool "mbedTLS pure-C (SW fallback)"
	default y

config ALP_CMSIS_DSP_HELIUM
	bool "CMSIS-DSP via Helium MVE (Cortex-M55)"
	depends on ALP_SOC_ALIF_ENSEMBLE_E3 || ALP_SOC_ALIF_ENSEMBLE_E4 || \
	           ALP_SOC_ALIF_ENSEMBLE_E5 || ALP_SOC_ALIF_ENSEMBLE_E6 || \
	           ALP_SOC_ALIF_ENSEMBLE_E7 || ALP_SOC_ALIF_ENSEMBLE_E8
config ALP_CMSIS_DSP_NEON
	bool "CMSIS-DSP via Arm Neon (Cortex-A55)"
	depends on ALP_SOC_RENESAS_RZV2N_N44
config ALP_CMSIS_DSP_TMU_CORDIC
	bool "CMSIS-DSP CORDIC via GD32 bridge TMU"
config ALP_CMSIS_DSP_TMU_FFT
	bool "CMSIS-DSP FFT via GD32 bridge TMU"
config ALP_CMSIS_DSP_ADC_DMA
	bool "CMSIS-DSP ADC-stream chaining via DMA"
config ALP_CMSIS_DSP_SCALAR
	bool "CMSIS-DSP scalar kernels (SW fallback)"
	default y

config ALP_LITTLEFS_XSPI_DMA
	bool "littlefs over xSPI DMA (Alif on-die flash)"
	depends on ALP_SOC_ALIF_ENSEMBLE_E3 || ALP_SOC_ALIF_ENSEMBLE_E4 || \
	           ALP_SOC_ALIF_ENSEMBLE_E5 || ALP_SOC_ALIF_ENSEMBLE_E6 || \
	           ALP_SOC_ALIF_ENSEMBLE_E7 || ALP_SOC_ALIF_ENSEMBLE_E8
config ALP_LITTLEFS_EMMC_DMA
	bool "littlefs over eMMC DMA (V2N + V2N-M1)"
	depends on ALP_SOC_RENESAS_RZV2N_N44
config ALP_LITTLEFS_QSPI_DMA
	bool "littlefs over QuadSPI DMA (GD32 bridge)"
config ALP_LITTLEFS_SYNC_IO
	bool "littlefs sync I/O (SW fallback)"
	default y

endmenu  # "ALP SDK per-library HW-accelerator wiring"

# ----------------------------------------------------------------------
# .alpmodel package reader (<alp/model.h>)
# ----------------------------------------------------------------------

config ALP_SDK_MODEL_READER
	bool "Read-side .alpmodel package parser (<alp/model.h>)"
	default n
	select ZCBOR
	help
	  Compile src/common/alp_model.c, the OS-agnostic read-side parser
	  for the .alpmodel package (24-byte header + CBOR manifest + blob
	  table).  alp_model_parse() decodes an in-memory package into a
	  bounded, stack-friendly alp_model_t view (model identity, the
	  per-backend target table, and blob slices) with no heap.

	  Selects ZCBOR for the manifest-map decode.  Off by default; the
	  runtime model loader (and any hand-written firmware that consumes
	  .alpmodel packages directly) opts in.
```

## zephyr/boards/alp/e1m_aen401_m55_hp/Kconfig.alp_e1m_aen401_m55_hp
```kconfig
# Copyright (c) 2026 Alp Lab AB
# SPDX-License-Identifier: Apache-2.0

config BOARD_ALP_E1M_AEN401_M55_HP
	select SOC_AE402FA0E5597LE0_RTSS_HP
```

## zephyr/boards/alp/e1m_aen401_m55_hp/board.yml
```yaml
# Copyright (c) 2026 Alp Lab AB
# SPDX-License-Identifier: Apache-2.0
board:
  name: alp_e1m_aen401_m55_hp
  full_name: E1M-AEN401 (Alif Ensemble E4) Cortex-M55 HP carrier
  vendor: alp
  socs:
    - name: ae402fa0e5597le0
```
