## tests/zephyr/peripheral/testcase.yaml
```yaml
# SPDX-License-Identifier: Apache-2.0

tests:
  alp_sdk.peripheral.smoke:
    platform_allow:
      - native_sim
      - native_sim/native/64
    integration_platforms:
      - native_sim/native/64
    tags:
      - alp-sdk
      - peripheral

  # v0.2 capability-validation scenario: pin the SoC choice to Alif
  # Ensemble E3 (24-bit max ADC, 12 PWMs, etc.) and verify that the
  # SoC-capability checks in alp_*_open reject configs that exceed
  # the documented hardware caps.
  alp_sdk.peripheral.caps_e3:
    platform_allow:
      - native_sim
      - native_sim/native/64
    integration_platforms:
      - native_sim/native/64
    extra_args:
      - "EXTRA_CONF_FILE=prj_caps_e3.conf"
    tags:
      - alp-sdk
      - peripheral
      - caps

  # Interim scenario (LwRB upstream swap deferred, no committed
  # version): flips CONFIG_ALP_SDK_UART_RX_RINGBUF=y so the
  # LwRB-backed RX ring buffer code path in peripheral_uart.c is
  # compile-verified.  The failure-path tests in this suite run
  # against both this overlay (feature on) and the default config
  # (feature off) -- the assertions are scoped to "any refusal is
  # acceptable" rather than a specific status code, so the same
  # ZTESTs cover both builds.  Real-IRQ attach gates on HIL.
  alp_sdk.peripheral.uart_rx_ringbuf:
    platform_allow:
      - native_sim
      - native_sim/native/64
    integration_platforms:
      - native_sim/native/64
    extra_args:
      - "EXTRA_CONF_FILE=prj_uart_ringbuf.conf"
    tags:
      - alp-sdk
      - peripheral
      - uart
      - lwrb

  # V2N-supervisor scenario: force CONFIG_ALP_SDK_V2N_SUPERVISOR=y
  # so the GD32-bridge dispatch branches in peripheral_pwm.c /
  # peripheral_adc.c / peripheral_qenc.c / peripheral_counter.c /
  # peripheral_dac.c get compiled and tested under native_sim.  No
  # bus IDs configured (Kconfig defaults to -1), so the supervisor
  # surfaces ALP_ERR_NOT_READY for every open() and the V2N-only
  # tests assert that propagates back through the portable surface.
  alp_sdk.peripheral.v2n_supervisor:
    platform_allow:
      - native_sim
      - native_sim/native/64
    integration_platforms:
      - native_sim/native/64
    extra_args:
      - "EXTRA_CONF_FILE=prj_v2n_supervisor.conf"
    tags:
      - alp-sdk
      - peripheral
      - v2n
      - bridge

  # alp_sdk.peripheral.evk_aen — HW-in-loop variant for the E1M EVK
  # populated with an E1M-AEN801 SoM. The real board target,
  # alp_e1m_aen801_m55_he/ae822fa0e5597ls0/rtss_he, ships in-tree
  # under zephyr/boards/alp/ -- this scenario stays parked pending
  # HW-in-loop CI wiring, not a missing board file. The overlay at
  # boards/alp_e1m_aen801_m55_he.overlay is already in place and
  # compiles against the in-tree board file without further changes.
```

## tests/zephyr/security_mbedtls/testcase.yaml
```yaml
# SPDX-License-Identifier: Apache-2.0
#
# Real MbedTLS-PSA backend coverage for <alp/security.h> AEAD --
# GHSA-7xh2-9pcg-r824 regression test (a real opened AEAD handle,
# round-tripped from a 4 KiB CONFIG_MAIN_STACK_SIZE thread).

tests:
  alp_sdk.security.mbedtls_aead:
    platform_allow:
      - native_sim
      - native_sim/native/64
    integration_platforms:
      - native_sim/native/64
    tags:
      - alp-sdk
      - security
```

## yocto/meta-alp/conf/distro/include/mender.inc
```bitbake
# SPDX-License-Identifier: Apache-2.0
#
# Mender OTA distro config for meta-alp targets.
#
# Opt-in.  Pull in from a machine .conf via:
#
#     require conf/distro/include/mender.inc
#
# Or from local.conf for one-off builds:
#
#     INHERIT += "mender-full"
#     require conf/distro/include/mender.inc
#
# Requires the `meta-mender-core` layer in bblayers.conf:
#
#     git clone -b scarthgap https://github.com/mendersoftware/meta-mender
#     bitbake-layers add-layer ../meta-mender/meta-mender-core
#
# Status: v0.4 prep scaffolding.  HIL roundtrip (mock-update +
# rollback simulation) parked behind docs/ci/HW-IN-LOOP.md.

# Mender's core image-generation class.  Adds the .mender artefact
# next to the standard image outputs and configures the rootfs for
# A/B updates.
INHERIT += "mender-full"

# Storage layout.  meta-mender-core supports several patterns; the
# v0.4 reference path uses block-device-backed A/B rootfs
# partitions.  Override in machine .conf or local.conf when the SoM
# uses raw NAND, eMMC RPMB, or partition-table-free SD media.
MENDER_STORAGE_DEVICE_BASE ?= "/dev/mmcblk0p"
MENDER_BOOT_PART ?= "${MENDER_STORAGE_DEVICE_BASE}1"
MENDER_ROOTFS_PART_A ?= "${MENDER_STORAGE_DEVICE_BASE}2"
MENDER_ROOTFS_PART_B ?= "${MENDER_STORAGE_DEVICE_BASE}3"
MENDER_DATA_PART ?= "${MENDER_STORAGE_DEVICE_BASE}4"

# Rootfs sizing.  256 MiB per A/B slot covers the v0.4 reference
# image (alp-sdk-runtime + alp-chips + alp-edgeai + a TensorFlow
# Lite Micro runtime + a representative model).  Bump in
# local.conf for fatter app payloads.
MENDER_STORAGE_TOTAL_SIZE_MB ?= "1024"
MENDER_BOOT_PART_SIZE_MB ?= "32"
MENDER_DATA_PART_SIZE_MB ?= "256"

# Server URL placeholder.  Override in local.conf for production
# fleets.  The default points at Mender's hosted demo so
# image builds don't fail on missing required vars; production
# fleets always override.
MENDER_SERVER_URL ?= "https://hosted.mender.io"
MENDER_TENANT_TOKEN ?= ""

# Artefact naming.  Mender uses ARTIFACTNAME to detect upgrades vs
# downgrades; bake the SDK version into the default so OTA history
# tells you what shipped.
MENDER_ARTIFACT_NAME ?= "alp-${DISTRO_VERSION}-${MACHINE}-${PV}"

# U-Boot is the standard bootloader integration point for Mender
# on i.MX + Renesas.  Each machine .conf picks the matching
# `u-boot-mender` provider when this include is used.
PREFERRED_PROVIDER_virtual/bootloader ?= "u-boot"

# Image features.  Mender requires the rootfs include the mender
# client + ssh (for first-boot enrollment); apps can opt out of
# ssh once their bootstrap flow is in place.
IMAGE_FEATURES:append = " ssh-server-openssh"
IMAGE_INSTALL:append = " mender-client mender-connect"
```

## yocto/meta-alp/conf/layer.conf
```bitbake
# Layer configuration for meta-alp.
# v0.3 -- machine configs + recipe fleshout in place; build glue
# lands in v0.4.  README.md documents the surrounding layer setup
# for the Renesas V2N AI SDK 7.10 BSP + NXP i.MX 93 (v0.4) flows.

BBPATH .= ":${LAYERDIR}"

BBFILES += "${LAYERDIR}/recipes-*/*/*.bb \
            ${LAYERDIR}/recipes-*/*/*.bbappend"

BBFILE_COLLECTIONS += "alp"
BBFILE_PATTERN_alp  = "^${LAYERDIR}/"
BBFILE_PRIORITY_alp = "10"

LAYERVERSION_alp    = "3"
LAYERSERIES_COMPAT_alp = "kirkstone scarthgap"

# Hard layer deps.  Both ship with poky / meta-openembedded so
# every Yocto build pulls them in regardless of SoM family.
LAYERDEPENDS_alp = " \
    core \
    openembedded-layer \
"

# Soft recommends -- the SoM-specific BSP layers.  Builds that
# only target one family can drop the others from bblayers.conf.
#
# Renesas RZ/V2N (covers e1m-x-v2n + e1m-x-v2n-m1):
#   `meta-renesas` is the canonical RZ base BSP.  The four
#   `meta-rz-features/*` sublayers come bundled together inside
#   the RZ/V2N AI SDK 7.10 BSP tarball
#   (RTK0EF0045Z94001AZJ-v1.0.3.zip on My Renesas) -- see
#   yocto/meta-alp/README.md for the extract-and-add-layer recipe.
#
# DEEPX DX-M1 (covers e1m-x-v2n-m1 only):
#   `meta-deepx-m1` carries the DX-M1 kernel module + userspace
#   runtime recipes.  Source at github.com/DEEPX-AI/meta-deepx-m1.
#
# NXP i.MX 93 (covers e1m-n93):
#   `meta-imx` is the canonical i.MX BSP; v0.4 bring-up wires
#   the full layer list.
#
# Mender OTA (covers every machine when OTA is opted in):
#   `meta-mender-core` provides the .mender artefact generator
#   + A/B rootfs partitioning + the on-target Mender client.
#   Builds that don't ship OTA can drop it from bblayers.conf;
#   the meta-alp recipes parse cleanly without it.  See
#   conf/distro/include/mender.inc + yocto/meta-alp/README.md
#   for the wiring.
LAYERRECOMMENDS_alp = " \
    meta-renesas \
    meta-rz-graphics \
    meta-rz-drpai \
    meta-rz-opencva \
    meta-rz-codecs \
    meta-econsys \
    meta-deepx-m1 \
    meta-imx \
    meta-mender-core \
"
```

## yocto/meta-alp/conf/machine/e1m-n93.conf
```bitbake
# SPDX-License-Identifier: Apache-2.0
#
# Machine configuration for the E1M-N93 module on the E1M EVK.
# NXP i.MX 93 (Cortex-A55 dual + Cortex-M33 RT-domain +
# Ethos-U65 micro-NPU).
#
# Layers on top of `meta-imx`'s `imx93evk` base; see
# https://github.com/nxp-imx/meta-imx for the upstream.
#
# Usage:
#
#     MACHINE = "e1m-n93"

#@TYPE: Machine
#@NAME: ALP E1M-N93 module (on 35x35 E1M EVK)
#@DESCRIPTION: Machine configuration for the E1M-N93 SoM (NXP i.MX 93)
#@SOC: imx93

require conf/machine/include/imx93-base.inc

MACHINEOVERRIDES =. "e1m-n93:e1m:"
MACHINE_FEATURES += "alp-sdk e1m n93 ethos-u65"

# i.MX 93 has a Cortex-M33 real-time domain alongside the A55s.
# alp-sdk builds the same <alp/...> surface for both -- Linux
# user-space on the A55s + RTOS-side (Zephyr) on the M33.  The
# M33 firmware is loaded by the A55s at boot via remoteproc.
ALP_BOOT_RTCORE_DEFAULT ?= "1"

# Ethos-U65 micro-NPU.  Same Vela toolchain as AEN's U55, just a
# different command-stream variant.  The alp-inference Ethos-U
# backend (src/zephyr/inference_ethosu.c) targets both -- see
# task #14.
PREFERRED_PROVIDER_virtual/ethosu-firmware ?= "ethosu-fw-imx93"
PREFERRED_PROVIDER_ethosu-driver-library ?= "ethosu-driver-library"

# E1M-N93 carrier wiring (vs NXP's generic imx93evk).
KERNEL_DEVICETREE = "freescale/imx93-e1m-evk.dtb"

# Boot media: SD card by default, eMMC populated on production
# images.  The carrier's microSD slot is multiplexed via 74LVC157
# with the M.2 E-key SDIO -- see <alp/boards/alp_e1m_evk.h>.
ALP_BOOT_DEVICE ?= "sdcard"
```

## yocto/meta-alp/conf/machine/e1m-x-v2n-m1.conf
```bitbake
# SPDX-License-Identifier: Apache-2.0
#
# Machine configuration for the E1M-X V2N-M1 module on the E1M-X
# EVK.  Renesas RZ/V2N (Cortex-A55 quad + DRP-AI3) PLUS an external
# DEEPX DX-M1 NPU sitting behind the SoM's PCIe x4 lane group.
#
# Inherits everything from e1m-x-v2n.conf and adds the DEEPX
# runtime to the default image features.

#@TYPE: Machine
#@NAME: ALP E1M-X V2N-M1 module
#@DESCRIPTION: V2N base + DEEPX DX-M1 external NPU
#@SOC: r9a09g056

require conf/machine/e1m-x-v2n.conf

MACHINEOVERRIDES =. "e1m-x-v2n-m1:"
MACHINE_FEATURES += "deepx-dxm1"

# Pull in the DEEPX user-space runtime + kernel PCIe driver from the
# upstream `meta-deepx-m1` Yocto layer.  Add the layer to bblayers.conf
# (`git clone -b scarthgap https://github.com/DEEPX-AI/meta-deepx-m1.git`,
# then `bitbake-layers add-layer ../meta-deepx-m1`).  Upstream recipe
# names per the layer's README:
#   - `dx-driver` -- M1 PCIe kernel module
#   - `dx-rt`     -- userspace DXRT inference runtime
# Both must be installed; userspace has no path to the silicon
# without the kernel module.  See vendors/deepx-dxm1/README.md for
# the licensing posture (DEEPX repos are source-visible but not
# openly licensed -- authorised for DEEPX NPU customers only).
IMAGE_INSTALL:append = " dx-driver dx-rt"

# DEEPX inference backend selected as the alp-inference default
# for this machine; DRP-AI remains available as a fallback for
# models the M1 doesn't support.
ALP_INFERENCE_DEFAULT_BACKEND ?= "deepx"

# The V2N-M1 carrier shares the E1M-X form factor and uses the
# same base DTB; the DEEPX module is enumerated via PCIe at
# runtime, no DTB delta required.
```

## yocto/meta-alp/conf/machine/e1m-x-v2n.conf
```bitbake
# SPDX-License-Identifier: Apache-2.0
#
# Machine configuration for the E1M-X V2N module on the E1M-X EVK.
# Renesas RZ/V2N (Cortex-A55 quad + DRP-AI3 accelerator).
#
# This machine config inherits from Renesas's canonical `rzv2n-evk`
# MACHINE (defined in meta-renesas, distributed via the RZ/V2N AI
# SDK 7.10 BSP -- see yocto/meta-alp/README.md for the setup recipe).
# The E1M-X carrier shares the Renesas EVK's SoC config; only the
# carrier-specific peripherals + boot media differ.
#
# Usage (in conf/local.conf):
#
#     MACHINE = "e1m-x-v2n"

#@TYPE: Machine
#@NAME: ALP E1M-X V2N module
#@DESCRIPTION: Machine configuration for the E1M-X V2N SoM (Renesas RZ/V2N)
#@SOC: r9a09g056

require conf/machine/rzv2n-evk.conf

# E1M-X carrier wiring (vs Renesas' generic RZ/V2N EVK).
MACHINEOVERRIDES =. "e1m-x-v2n:"
MACHINE_FEATURES += "alp-sdk e1m-x v2n"

# Boot media on the E1M-X V2N is eMMC by default; SD-card boot via
# the EVK's microSD slot is supported but not the default.
ALP_BOOT_DEVICE ?= "emmc"

# DRP-AI3 firmware blob is provided by meta-rz-drpai; the alp-sdk
# build only needs the runtime when an inference backend is wired.
PREFERRED_PROVIDER_virtual/drpai-firmware ?= "drpai-fw"

# Carrier-specific DTB.  The exact device-tree filename is TBD --
# the authoritative pin assignment + per-carrier overlay live in
# the user-supplied HW config writeup (per the project memory note
# "pending exact hardware configurations").  Default falls back to
# Renesas's stock V2N-EVK DTB so the build is reproducible without
# a carrier DTB; override when the E1M-X carrier DTB lands:
#     KERNEL_DEVICETREE = "renesas/r9a09g056n4?-e1m-x-evk.dtb"
# The "n4?" stem maps to the exact V2N silicon variant the SoM
# ships with (V2N has multiple orderable SKUs differing in
# package + temperature grade); user HW config supplies that too.
KERNEL_DEVICETREE ?= "renesas/r9a09g056n44-rzv2n-evk.dtb"

# OTA via Mender (opt-in).  Uncomment the line below to inherit
# Mender image generation + A/B rootfs partitioning.  Requires
# meta-mender-core in bblayers.conf; reference flow in
# docs/ota.md.  Production fleets MUST also override
# MENDER_SERVER_URL + MENDER_TENANT_TOKEN in local.conf.
#
#     require conf/distro/include/mender.inc
```
