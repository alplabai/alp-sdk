## CMakeLists.txt
```
# SPDX-License-Identifier: Apache-2.0

cmake_minimum_required(VERSION 3.20)

find_package(Zephyr REQUIRED HINTS $ENV{ZEPHYR_BASE})
project(alp_sdk_iot_test LANGUAGES C)

target_sources(app PRIVATE src/main.c)
```

## prj.conf
```kconfig
# SPDX-License-Identifier: Apache-2.0
#
# IoT smoke tests -- exercise the <alp/iot.h> wrapper's public-API
# contract.  Runs under native_sim, which has no Wi-Fi radio nor
# MQTT-capable network stack; the test verifies that the wrapper
# falls back cleanly to the v0.1 NULL-with-NOSUPPORT contract when
# CONFIG_ALP_SDK_IOT_WIFI / CONFIG_ALP_SDK_IOT_MQTT are off.
#
# The "real Wi-Fi + MQTT" path is exercised on real AEN-Zephyr
# silicon via an explicitly-invoked bench run (no CI runner drives
# this bench) -- see docs/ci/HW-IN-LOOP.md.

CONFIG_ZTEST=y
CONFIG_ALP_SDK=y

CONFIG_LOG=y
CONFIG_PRINTK=y
CONFIG_THREAD_LOCAL_STORAGE=y
CONFIG_MAIN_STACK_SIZE=4096
```

## prj_mqtt.conf
```kconfig
# SPDX-License-Identifier: Apache-2.0
#
# Build-only overlay for alp_sdk.iot.mqtt_build (issue #1938 item 2).
# Layers on top of prj.conf via EXTRA_CONF_FILE.  CONFIG_ALP_SDK_IOT_MQTT
# defaults y once CONFIG_MQTT_LIB + CONFIG_NET_TCP are both on (see
# zephyr/kconfigs/iot-audio-inference.kconfig) -- spelling it out below
# makes the intent visible to a reader who comes in cold, same as
# examples/connectivity/iot-connected-camera/overlay-aen.conf does.
#
# Deliberately omits that overlay's CONFIG_WIFI / wpa_supplicant stack --
# this scenario only needs to compile src/backends/mqtt/zephyr_drv.c's
# CONFIG_ALP_SDK_IOT_MQTT arm, which depends on the MQTT/TCP Kconfig
# symbols alone, not on a Wi-Fi driver.

CONFIG_NETWORKING=y
CONFIG_NET_TCP=y
CONFIG_NET_IPV4=y
CONFIG_NET_SOCKETS=y
CONFIG_MQTT_LIB=y

CONFIG_ALP_SDK_IOT_MQTT=y
```

## src/main.c
```c
/*
 * Copyright 2026 Alp Lab AB
 * SPDX-License-Identifier: Apache-2.0
 *
 * Smoke tests for the <alp/iot.h> wrapper under native_sim.
 *
 * native_sim has no Wi-Fi radio and no MQTT-capable network stack,
 * so this suite verifies the wrapper's "no networking subsystem
 * present" branch.  The contract under that condition is identical
 * to the v0.1 stub: alp_*_open() returns NULL with
 * alp_last_error() == ALP_ERR_NOSUPPORT (or precisely-stamped
 * ALP_ERR_INVAL for malformed inputs).
 *
 * Real Wi-Fi + MQTT round-trips happen on real AEN-Zephyr silicon via
 * an explicitly-invoked bench run (no CI runner drives this bench) --
 * see docs/ci/HW-IN-LOOP.md.
 */

#include <zephyr/ztest.h>

#include "alp/peripheral.h"
#include "alp/iot.h"

ZTEST_SUITE(alp_iot, NULL, NULL, NULL, NULL, NULL);

/* ------------------------------------------------------------------ */
/* Wi-Fi station                                                       */
/* ------------------------------------------------------------------ */

ZTEST(alp_iot, test_wifi_open_no_radio_returns_null)
{
	/* native_sim build does not enable CONFIG_ALP_SDK_IOT_WIFI -- the
     * wrapper's "no Wi-Fi subsystem" branch should stamp NOSUPPORT
     * before returning NULL, matching the v0.1 contract. */
	alp_wifi_t *w = alp_wifi_open();
	zassert_is_null(w, "alp_wifi_open without WIFI must yield NULL");
	zassert_equal(
	    alp_last_error(), ALP_ERR_NOSUPPORT, "expected NOSUPPORT, got %d", (int)alp_last_error());
}

ZTEST(alp_iot, test_wifi_connect_null_handle_errors)
{
	alp_status_t s =
	    alp_wifi_connect(NULL, &(alp_wifi_credentials_t){ .ssid = "alp-lab", .psk = NULL }, 1000);
	zassert_equal(s, ALP_ERR_INVAL, "got %d", (int)s);
}

ZTEST(alp_iot, test_wifi_disconnect_null_handle_errors)
{
	zassert_equal(alp_wifi_disconnect(NULL), ALP_ERR_NOT_READY);
}

ZTEST(alp_iot, test_wifi_close_null_is_safe)
{
	/* Idempotent close on NULL must not crash -- mirrors every
     * peripheral wrapper's lifecycle contract. */
	alp_wifi_close(NULL);
}

/* ------------------------------------------------------------------ */
/* MQTT client                                                         */
/* ------------------------------------------------------------------ */

ZTEST(alp_iot, test_mqtt_open_no_stack_returns_null)
{
	/* Same NOSUPPORT fall-through as Wi-Fi when the underlying
     * MQTT stack is absent. */
	alp_mqtt_t *m = alp_mqtt_open(&(alp_mqtt_config_t){
	    .broker_uri    = "mqtt://broker.local:1883",
	    .client_id     = "alp-iot-smoke",
	    .keepalive_s   = 30,
	    .clean_session = true,
	});
	zassert_is_null(m, "alp_mqtt_open without MQTT_LIB must yield NULL");
	zassert_equal(
	    alp_last_error(), ALP_ERR_NOSUPPORT, "expected NOSUPPORT, got %d", (int)alp_last_error());
}

ZTEST(alp_iot, test_mqtt_open_null_cfg_invalid)
{
	alp_mqtt_t *m = alp_mqtt_open(NULL);
	zassert_is_null(m);
	zassert_equal(alp_last_error(),
	              ALP_ERR_INVAL,
	              "NULL cfg must stamp INVAL, got %d",
	              (int)alp_last_error());
}

ZTEST(alp_iot, test_mqtt_open_missing_uri_invalid)
{
	alp_mqtt_t *m = alp_mqtt_open(&(alp_mqtt_config_t){
	    .broker_uri = NULL,
	    .client_id  = "x",
	});
	zassert_is_null(m);
	zassert_equal(alp_last_error(), ALP_ERR_INVAL);
}

ZTEST(alp_iot, test_mqtt_open_missing_client_id_invalid)
{
	alp_mqtt_t *m = alp_mqtt_open(&(alp_mqtt_config_t){
	    .broker_uri = "mqtt://broker.local:1883",
	    .client_id  = NULL,
	});
	zassert_is_null(m);
	zassert_equal(alp_last_error(), ALP_ERR_INVAL);
}

ZTEST(alp_iot, test_mqtt_connect_null_handle_errors)
{
	zassert_equal(alp_mqtt_connect(NULL, 1000), ALP_ERR_NOT_READY);
}

ZTEST(alp_iot, test_mqtt_publish_null_handle_errors)
{
	zassert_equal(alp_mqtt_publish(NULL, "topic", (uint8_t[]){ 0xaa }, 1, ALP_MQTT_QOS_0, false),
	              ALP_ERR_NOT_READY);
}

ZTEST(alp_iot, test_mqtt_subscribe_null_handle_errors)
{
	zassert_equal(alp_mqtt_subscribe(NULL, "topic", ALP_MQTT_QOS_0, NULL, NULL), ALP_ERR_NOT_READY);
}

ZTEST(alp_iot, test_mqtt_loop_null_handle_errors)
{
	zassert_equal(alp_mqtt_loop(NULL, 100), ALP_ERR_NOT_READY);
}

ZTEST(alp_iot, test_mqtt_close_null_is_safe)
{
	alp_mqtt_close(NULL);
}
```
