## tests/unit/tsl2591_init_enable_fail/testcase.yaml
```yaml
# SPDX-License-Identifier: Apache-2.0
tests:
  alp.unit.tsl2591_init_enable_fail:
    platform_allow:
      - native_sim
      - native_sim/native/64
    integration_platforms:
      - native_sim/native/64
    tags:
      - alp
      - unit
```

## tests/zephyr/cc3501e_ble_cancel/testcase.yaml
```yaml
# SPDX-License-Identifier: Apache-2.0
tests:
  alp_sdk.cc3501e.ble_cancel:
    platform_allow:
      - native_sim
      - native_sim/native/64
    integration_platforms:
      - native_sim
      - native_sim/native/64
    tags:
      - alp-sdk
      - cc3501e
```

## tests/zephyr/chips/dts/bindings/alp,fake-da9292.yaml
```yaml
# Copyright 2026 Alp Lab AB
# SPDX-License-Identifier: Apache-2.0
#
# Fake DA9292 emul target.  Lives in this test only.

description: |
  Fake Renesas DA9292 i2c-emul target used by the alp-sdk chips ztest.
  Stateful: CH2_PG asserts a configurable number of STATUS_00 reads
  after CH2_EN rises, CHx_VSTEP writes are ignored while CHx_EN=1, and
  EVENT_00/01 are write-1-to-clear.

compatible: "alp,fake-da9292"

include: i2c-device.yaml
```

## tests/zephyr/chips/dts/bindings/alp,fake-gd32bridge.yaml
```yaml
# Copyright 2026 Alp Lab AB
# SPDX-License-Identifier: Apache-2.0
#
# Fake GD32G553 supervisor-MCU bridge i2c-emul target.  Lives in this
# test only.

description: |
  Fake GD32 bridge i2c-emul target used by the alp-sdk chips ztest.
  Models PING/GET_VERSION over the wire framing in
  docs/gd32-bridge-protocol.md §5, including the short error-envelope
  shape a real bridge answers with while it is BUSY -- used to drive
  gd32g553_init()'s post-OTA-trial retry ladder (chips/gd32g553/gd32g553.c).

compatible: "alp,fake-gd32bridge"

include: i2c-device.yaml
```

## tests/zephyr/chips/dts/bindings/alp,fake-icm42670.yaml
```yaml
# Copyright 2026 Alp Lab AB
# SPDX-License-Identifier: Apache-2.0
#
# Fake ICM-42670-P emul target.  Lives in this test only.

description: |
  Fake TDK ICM-42670-P i2c-emul target used by the alp-sdk chips
  ztest.  Pre-populates WHO_AM_I = 0x67 so icm42670_init() succeeds,
  and echoes register writes back on subsequent reads.

compatible: "alp,fake-icm42670"

include: i2c-device.yaml
```

## tests/zephyr/chips/dts/bindings/alp,fake-ina228.yaml
```yaml
# Copyright 2026 Alp Lab AB
# SPDX-License-Identifier: Apache-2.0
#
# Fake INA228 emul target.  Lives in this test only.

description: |
  Fake TI INA228 i2c-emul target used by the alp-sdk chips ztest.
  Models the part's big-endian 16 / 24 / 40-bit register wire protocol;
  pre-populates MANUFACTURER_ID (register 0x3E) = 0x5449 ("TI") and
  DEVICE_ID (0x3F) = 0x2281 so ina228_init()'s identity probe succeeds.

compatible: "alp,fake-ina228"

include: i2c-device.yaml
```

## tests/zephyr/chips/dts/bindings/alp,fake-ina236.yaml
```yaml
# Copyright 2026 Alp Lab AB
# SPDX-License-Identifier: Apache-2.0
#
# Fake INA236 emul target.  Lives in this test only.

description: |
  Fake TI INA236 i2c-emul target used by the alp-sdk chips ztest.
  Models the part's 16-bit big-endian register wire protocol;
  pre-populates MFG_ID (register 0x3E) = 0x5449 ("TI") so
  ina236_init()'s identity probe succeeds.

compatible: "alp,fake-ina236"

include: i2c-device.yaml
```

## tests/zephyr/chips/dts/bindings/alp,fake-optiga.yaml
```yaml
# Copyright 2026 Alp Lab AB
# SPDX-License-Identifier: Apache-2.0
#
# Fake OPTIGA Trust M emul target.  Lives in this test only.

description: |
  Fake Infineon OPTIGA Trust M i2c-emul target used by the alp-sdk chips
  ztest.  Answers the I2C_STATE (0x82) probe with 4 bytes and can be armed
  to NACK its next N accesses, the way the part does while it wakes.

compatible: "alp,fake-optiga"

include: i2c-device.yaml
```

## tests/zephyr/chips/dts/bindings/alp,fake-rv3028c7.yaml
```yaml
# Copyright 2026 Alp Lab AB
# SPDX-License-Identifier: Apache-2.0
#
# Fake RV-3028-C7 emul target.  Lives in this test only.

description: |
  Fake Micro Crystal RV-3028-C7 i2c-emul target used by the alp-sdk
  chips ztest to verify the EEADDR/EEDATA/EECMD EEPROM-commit
  protocol and its ordered write log without a real chip.

compatible: "alp,fake-rv3028c7"

include: i2c-device.yaml
```

## tests/zephyr/chips/dts/bindings/alp,fake-tas2563.yaml
```yaml
# Copyright 2026 Alp Lab AB
# SPDX-License-Identifier: Apache-2.0
#
# Fake TAS2563 emul target.  Lives in this test only.

description: |
  Fake TI TAS2563 i2c-emul target used by the alp-sdk chips ztest.
  Models the part's book/page-paged register map (SLASET3D §7.3.10,
  p.34) with datasheet POR values seeded on book 0 / page 0, the
  self-clearing CLR_INTP_LTCH bit, and an ordered write log so a test
  can assert write SEQUENCE as well as final register state.

compatible: "alp,fake-tas2563"

include: i2c-device.yaml
```

## tests/zephyr/chips/dts/bindings/alp,fake-tcal9538.yaml
```yaml
# Copyright 2026 Alp Lab AB
# SPDX-License-Identifier: Apache-2.0
#
# Fake TCAL9538 / TCA6408A emul target.  Lives in this test only.

description: |
  Fake TI TCAL9538 (and register-compatible TCA6408A alt-part) i2c-
  emul target used by the alp-sdk chips ztest.  Two instances are
  wired in the overlay, at the TCAL9538 strap (0x73) and the TCA6408A
  alt-strap (0x20), so the ztest can exercise both `has_latched_irq`
  branches of tcal9538_init() against a live target.

compatible: "alp,fake-tcal9538"

include: i2c-device.yaml
```

## tests/zephyr/chips/dts/bindings/alp,fake-tps628640.yaml
```yaml
# Copyright 2026 Alp Lab AB
# SPDX-License-Identifier: Apache-2.0
#
# Fake TPS628640 emul target.  Lives in this test only.

description: |
  Fake TI TPS628640 i2c-emul target used by the alp-sdk chips ztest.
  One instance per V2N-M1 buck address (0x44, 0x48, 0x4F); STATUS
  read-clears and the CONTROL reset bit self-clears.

compatible: "alp,fake-tps628640"

include: i2c-device.yaml
```
