## CMakeLists.txt
```
# SPDX-License-Identifier: Apache-2.0
cmake_minimum_required(VERSION 3.20.0)
find_package(Zephyr REQUIRED HINTS $ENV{ZEPHYR_BASE})
project(test_update_log)
# REQUIRE_HW_ENFORCED builds forbid the software tier, which every case in
# test_update_log.c relies on, so that scenario gets its own source (#111 P1).
if(CONFIG_ALP_SDK_UPDATE_LOG_REQUIRE_HW_ENFORCED)
  target_sources(app PRIVATE src/test_require_hw_enforced.c)
else()
  target_sources(app PRIVATE src/test_update_log.c)
endif()
# The anchor suite drives the engine directly, so it runs in every scenario.
target_sources(app PRIVATE src/test_update_log_anchor.c)
# The test drives the engine directly via its module-private header, which
# resolves its own siblings (update_log/store.h, update_log/sha256.h)
# relative to the SDK's src/ root -- put that on the test's include path.
target_include_directories(app PRIVATE ${CMAKE_CURRENT_SOURCE_DIR}/../../../src)
```

## prj.conf
```kconfig
CONFIG_ZTEST=y
CONFIG_ALP_SDK=y
CONFIG_ALP_SDK_UPDATE_LOG=y
CONFIG_ALP_SOC_ALIF_ENSEMBLE_E7=y
```

## boards/native_sim.overlay
```dts
/*
 * Copyright 2026 Alp Lab AB
 * SPDX-License-Identifier: Apache-2.0
 *
 * Dedicated update-log NVS partition for the alp.unit.update_log
 * scenarios.  native_sim's stock flash0 is 2 MiB with its standard
 * partitions ending at 0x100000 (boards/native/native_sim/native_sim.dts),
 * so the upper half is free -- carve 16 KiB (4 x 4096-byte erase blocks;
 * NVS needs >= 2 sectors, one of which is reserved for garbage
 * collection) right after them.
 *
 * Real boards opt in the same way: add an `alp_ulog_partition` fixed
 * partition to a writable flash device (offsets are board-specific and
 * bench-verified -- see the CONFIG_ALP_SDK_UPDATE_LOG_PERSIST help).
 * Without the partition the software tier falls back to the RAM store.
 */

&flash0 {
    partitions {
        alp_ulog_partition: partition@100000 {
            label = "alp-ulog";
            reg = <0x00100000 0x00004000>;
        };
    };
};
```

## src/test_require_hw_enforced.c
```c
/* SPDX-License-Identifier: Apache-2.0 */
#include <zephyr/ztest.h>

#include <alp/peripheral.h>
#include <alp/update_log.h>

#include "../../../../src/backends/update_log/update_log_ops.h"

/*
 * CONFIG_ALP_SDK_UPDATE_LOG_REQUIRE_HW_ENFORCED=y (issue #111, phase P1).
 *
 * This build keeps the software tamper-evident tier registered (priority 10)
 * but forbids the dispatcher from ever binding it. A stand-in HW_ENFORCED
 * backend (priority 20) plays the trusted owner; its ready() verdict models
 * the three real states: owner answers (ALP_OK), owner absent
 * (ALP_ERR_NOSUPPORT), and a hard fault. The firewall is not modelled: it is
 * asserted by the build, not checked at runtime.
 *
 * The property under test: with the requirement set, an absent
 * owner makes alp_update_log_open() return NULL with ALP_ERR_NOSUPPORT --
 * it never silently hands the caller the software tier.
 */

static alp_status_t g_owner_ready = ALP_ERR_NOSUPPORT;

static void require_hw_after(void *fixture)
{
	(void)fixture;
	g_owner_ready = ALP_ERR_NOSUPPORT;
}

ZTEST_SUITE(alp_update_log_require_hw, NULL, NULL, NULL, require_hw_after, NULL);

static alp_status_t owner_ready(void)
{
	return g_owner_ready;
}
static alp_status_t owner_append(const alp_update_log_entry_t *e)
{
	(void)e;
	return ALP_OK;
}
static alp_status_t owner_verify(alp_update_log_verdict_t *v, uint64_t *bad)
{
	(void)bad;
	if (v) *v = ALP_UPDATE_LOG_VERIFY_OK;
	return ALP_OK;
}
static alp_status_t owner_count(uint64_t *out)
{
	if (out) *out = 0;
	return ALP_OK;
}
static alp_status_t owner_get(uint64_t seq, alp_update_log_entry_t *out)
{
	(void)seq;
	(void)out;
	return ALP_ERR_NOT_FOUND;
}
static const alp_update_log_ops_t _owner_ops = {
	.assurance = ALP_UPDATE_LOG_HW_ENFORCED,
	.ready     = owner_ready,
	.append    = owner_append,
	.verify    = owner_verify,
	.count     = owner_count,
	.get       = owner_get,
};
ALP_BACKEND_REGISTER(update_log,
                     require_hw_owner,
                     {
                         .silicon_ref = "*",
                         .vendor      = "require_hw_owner",
                         .base_caps   = 0u,
                         .priority    = 20,
                         .ops         = &_owner_ops,
                         .probe       = NULL,
                     });

/* Owner absent: open() fails closed, no SW fallback. */
ZTEST(alp_update_log_require_hw, test_open_fails_when_owner_absent)
{
	g_owner_ready         = ALP_ERR_NOSUPPORT;
	alp_update_log_t *log = alp_update_log_open();
	zassert_is_null(log);
	zassert_equal(alp_last_error(), ALP_ERR_NOSUPPORT);
}

/* A hard owner fault is still surfaced as itself, not masked as NOSUPPORT. */
ZTEST(alp_update_log_require_hw, test_open_surfaces_owner_hard_error)
{
	g_owner_ready         = ALP_ERR_IO;
	alp_update_log_t *log = alp_update_log_open();
	zassert_is_null(log);
	zassert_equal(alp_last_error(), ALP_ERR_IO);
}

/* Owner answers: open() binds it, and a failed open earlier did not wedge
 * the singleton. */
ZTEST(alp_update_log_require_hw, test_open_succeeds_when_owner_ready)
{
	zassert_is_null(alp_update_log_open());
	g_owner_ready         = ALP_OK;
	alp_update_log_t *log = alp_update_log_open();
	zassert_not_null(log);
	zassert_equal(alp_update_log_assurance(log), ALP_UPDATE_LOG_HW_ENFORCED);
	alp_update_log_close(log);
}
```

## src/test_update_log_anchor.c
```c
/* SPDX-License-Identifier: Apache-2.0
 * Issue #111 P2: the optional external counter-anchor seam. Host-only; the
 * "anchor" is a fake floor that, unlike the store, survives a store reset --
 * exactly the property a hardware anchor (SE NV counter / OTP floor) adds. */
#include <string.h>
#include <zephyr/ztest.h>

#include <alp/update_log.h>

#include "../../../../src/update_log/engine.h"
#include "../../../../src/update_log/store.h"

ZTEST_SUITE(alp_update_log_anchor, NULL, NULL, NULL, NULL, NULL);

#define FS_SLOTS 16
struct fake {
	struct {
		bool    used;
		char    key[24];
		uint8_t buf[128];
		size_t  len;
	} s[FS_SLOTS];
	uint64_t counter;
	bool     fail_meta_put; /* inject: crash after the entry commit, before meta */
};
struct fake_anchor {
	uint64_t floor;
	bool     fail_advance; /* inject: crash after the counter, before the anchor */
	bool     fail_read;
};

static int fs_find(struct fake *f, const char *key)
{
	for (int i = 0; i < FS_SLOTS; i++) {
		if (f->s[i].used && strcmp(f->s[i].key, key) == 0) return i;
	}
	return -1;
}
static alp_status_t fs_put(void *c, const char *key, const uint8_t *b, size_t n)
{
	struct fake *f = c;
	if (f->fail_meta_put && strcmp(key, "ulog.meta") == 0) return ALP_ERR_IO;
	int i = fs_find(f, key);
	for (int k = 0; i < 0 && k < FS_SLOTS; k++) {
		if (!f->s[k].used) i = k;
	}
	if (i < 0 || n > sizeof(f->s[i].buf)) return ALP_ERR_NOMEM;
	f->s[i].used = true;
	strncpy(f->s[i].key, key, sizeof(f->s[i].key) - 1);
	memcpy(f->s[i].buf, b, n);
	f->s[i].len = n;
	return ALP_OK;
}
static alp_status_t fs_get(void *c, const char *key, uint8_t *b, size_t cap, size_t *out)
{
	struct fake *f = c;
	int          i = fs_find(f, key);
	if (i < 0) return ALP_ERR_NOT_FOUND;
	if (f->s[i].len > cap) return ALP_ERR_NOMEM;
	memcpy(b, f->s[i].buf, f->s[i].len);
	if (out) *out = f->s[i].len;
	return ALP_OK;
}
static alp_status_t fs_erase(void *c, const char *key)
{
	struct fake *f = c;
	int          i = fs_find(f, key);
	if (i < 0) return ALP_ERR_NOT_FOUND;
	f->s[i].used = false;
	return ALP_OK;
}
static alp_status_t fc_read(void *c, uint32_t id, uint64_t *v)
{
	(void)id;
	*v = ((struct fake *)c)->counter;
	return ALP_OK;
}
static alp_status_t fc_inc(void *c, uint32_t id, uint64_t *v)
{
	(void)id;
	*v = ++((struct fake *)c)->counter;
	return ALP_OK;
}
static alp_status_t fa_read(void *c, uint64_t *floor)
{
	if (((struct fake_anchor *)c)->fail_read) return ALP_ERR_NOT_READY;
	*floor = ((struct fake_anchor *)c)->floor;
	return ALP_OK;
}
static alp_status_t fa_advance(void *c, uint64_t count)
{
	struct fake_anchor *a = c;
	if (a->fail_advance) return ALP_ERR_IO;
	if (count > a->floor) a->floor = count;
	return ALP_OK;
}

struct rig {
	struct fake              f;
	struct fake_anchor       a;
	alp_secure_store_if      s;
	alp_monotonic_counter_if c;
	alp_counter_anchor_if    an;
};
static void rig_init(struct rig *r)
{
	memset(r, 0, sizeof(*r));
	r->s  = (alp_secure_store_if){ fs_put, fs_get, fs_erase, &r->f };
	r->c  = (alp_monotonic_counter_if){ fc_read, fc_inc, &r->f };
	r->an = (alp_counter_anchor_if){ fa_read, fa_advance, &r->a };
}
static alp_status_t add(struct rig *r, int i)
{
	alp_update_log_entry_t e = { 0 };
	e.timestamp              = (uint64_t)i;
	e.status                 = ALP_UPDATE_STATUS_CONFIRMED;
	strcpy(e.fw_version, "1.0.0");
	return ulog_engine_append_anchored(&r->s, &r->c, &r->an, &e);
}
static alp_update_log_verdict_t vfy(struct rig *r, bool use_anchor)
{
	alp_update_log_verdict_t v   = ALP_UPDATE_LOG_VERIFY_OK;
	uint64_t                 bad = 0;
	zassert_equal(ulog_engine_verify_anchored(&r->s, &r->c, use_anchor ? &r->an : NULL, &v, &bad),
	              ALP_OK);
	return v;
}

ZTEST(alp_update_log_anchor, test_normal_appends_ok_and_anchor_tracks_count)
{
	struct rig r;
	rig_init(&r);
	for (int i = 0; i < 3; i++)
		zassert_equal(add(&r, i), ALP_OK);
	zassert_equal(r.a.floor, 3);
	zassert_equal(vfy(&r, true), ALP_UPDATE_LOG_VERIFY_OK);
}

ZTEST(alp_update_log_anchor, test_reflash_rolls_back)
{
	struct rig r;
	rig_init(&r);
	for (int i = 0; i < 3; i++)
		zassert_equal(add(&r, i), ALP_OK);
	/* Full reflash: store and its counter rewind together, anchor survives. */
	memset(&r.f, 0, sizeof(r.f));
	zassert_equal(vfy(&r, true), ALP_UPDATE_LOG_VERIFY_ROLLED_BACK);
	/* Without the anchor the rewound store is indistinguishable from fresh. */
	zassert_equal(vfy(&r, false), ALP_UPDATE_LOG_VERIFY_OK);
}

ZTEST(alp_update_log_anchor, test_tail_truncation_rolls_back)
{
	struct rig r;
	rig_init(&r);
	for (int i = 0; i < 2; i++)
		zassert_equal(add(&r, i), ALP_OK);
	struct fake snap = r.f; /* self-consistent 2-entry image */
	zassert_equal(add(&r, 2), ALP_OK);
	r.f = snap; /* attacker restores the older image: tail entry gone */
	zassert_equal(vfy(&r, true), ALP_UPDATE_LOG_VERIFY_ROLLED_BACK);
	zassert_equal(vfy(&r, false), ALP_UPDATE_LOG_VERIFY_OK);
}

/* Crash order 1: entry committed, meta/counter/anchor never ran. The anchor
 * is still at n, recovery adopts the orphan, no false ROLLED_BACK. */
ZTEST(alp_update_log_anchor, test_torn_append_entry_only_no_false_rollback)
{
	struct rig r;
	rig_init(&r);
	for (int i = 0; i < 2; i++)
		zassert_equal(add(&r, i), ALP_OK);
	r.f.fail_meta_put = true; /* entry put lands, meta put "crashes" */
	zassert_equal(add(&r, 2), ALP_ERR_IO);
	r.f.fail_meta_put = false;
	zassert_equal(r.a.floor, 2, "anchor must not lead the store");
	zassert_equal(vfy(&r, true), ALP_UPDATE_LOG_VERIFY_OK);
	zassert_equal(r.a.floor, 3, "recovery adopts the orphan and raises the floor");
	zassert_equal(add(&r, 3), ALP_OK);
	zassert_equal(vfy(&r, true), ALP_UPDATE_LOG_VERIFY_OK);
}

/* Crash order 2: entry, meta and counter committed, anchor advance lost. The
 * anchor lags by one; verify must be OK and the next append catches it up. */
ZTEST(alp_update_log_anchor, test_torn_append_anchor_lag_no_false_rollback)
{
	struct rig r;
	rig_init(&r);
	for (int i = 0; i < 2; i++)
		zassert_equal(add(&r, i), ALP_OK);
	r.a.fail_advance = true;
	zassert_equal(add(&r, 2), ALP_ERR_IO);
	r.a.fail_advance = false;
	zassert_equal(r.f.counter, 3);
	zassert_equal(r.a.floor, 2);
	zassert_equal(vfy(&r, true), ALP_UPDATE_LOG_VERIFY_OK);
	zassert_equal(add(&r, 3), ALP_OK);
	zassert_equal(r.a.floor, 4);
	zassert_equal(vfy(&r, true), ALP_UPDATE_LOG_VERIFY_OK);
}

ZTEST(alp_update_log_anchor, test_no_anchor_behaviour_unchanged)
{
	struct rig r;
	rig_init(&r);
	alp_update_log_entry_t e = { 0 };
	strcpy(e.fw_version, "1.0.0");
	for (int i = 0; i < 3; i++)
		zassert_equal(ulog_engine_append(&r.s, &r.c, &e), ALP_OK);
	zassert_equal(r.a.floor, 0, "plain append never touches an anchor");
	alp_update_log_verdict_t v   = ALP_UPDATE_LOG_VERIFY_CHAIN_BROKEN;
	uint64_t                 bad = 0;
	zassert_equal(ulog_engine_verify(&r.s, &r.c, &v, &bad), ALP_OK);
	zassert_equal(v, ALP_UPDATE_LOG_VERIFY_OK);
	/* Reflash is invisible without an anchor (pre-P2 behaviour). */
	memset(&r.f, 0, sizeof(r.f));
	zassert_equal(ulog_engine_verify(&r.s, &r.c, &v, &bad), ALP_OK);
	zassert_equal(v, ALP_UPDATE_LOG_VERIFY_OK);
}

/* Review item 1: a rewound store must not accept appends (seq reuse), or a
 * later count climbing past the floor would erase the rollback evidence. */
ZTEST(alp_update_log_anchor, test_append_refused_on_rewound_store)
{
	struct rig r;
	rig_init(&r);
	for (int i = 0; i < 4; i++)
		zassert_equal(add(&r, i), ALP_OK);
	memset(&r.f, 0, sizeof(r.f)); /* reflash: floor 4, store 0 */
	for (int i = 0; i < 6; i++)
		zassert_equal(add(&r, i), ALP_ERR_IO, "append must refuse, not reuse seqs");
	zassert_equal(r.f.counter, 0);
	zassert_equal(r.a.floor, 4);
	zassert_equal(vfy(&r, true), ALP_UPDATE_LOG_VERIFY_ROLLED_BACK);
}

ZTEST(alp_update_log_anchor, test_anchor_read_failure_propagates_status)
{
	struct rig r;
	rig_init(&r);
	zassert_equal(add(&r, 0), ALP_OK);
	r.a.fail_read = true;
	alp_update_log_verdict_t v;
	uint64_t                 bad;
	zassert_equal(ulog_engine_verify_anchored(&r.s, &r.c, &r.an, &v, &bad), ALP_ERR_NOT_READY);
	zassert_equal(add(&r, 1), ALP_ERR_NOT_READY);
	zassert_equal(r.f.counter, 1, "failed anchor read must not commit");
}

ZTEST(alp_update_log_anchor, test_null_callbacks_rejected_before_commit)
{
	struct rig r;
	rig_init(&r);
	alp_update_log_verdict_t v;
	uint64_t                 bad;
	r.an.advance = NULL;
	zassert_equal(add(&r, 0), ALP_ERR_INVAL);
	zassert_equal(ulog_engine_verify_anchored(&r.s, &r.c, &r.an, &v, &bad), ALP_ERR_INVAL);
	zassert_equal(r.f.counter, 0);
	zassert_equal(fs_find(&r.f, "ulog.0"), -1, "nothing committed");
	r.an.advance = fa_advance;
	r.an.read    = NULL;
	zassert_equal(add(&r, 0), ALP_ERR_INVAL);
	zassert_equal(r.f.counter, 0);
}

ZTEST(alp_update_log_anchor, test_advance_is_max_only)
{
	struct fake_anchor a = { .floor = 5 };
	zassert_equal(fa_advance(&a, 3), ALP_OK);
	zassert_equal(a.floor, 5, "a lower advance must not lower the floor");
	zassert_equal(fa_advance(&a, 7), ALP_OK);
	zassert_equal(a.floor, 7);
}

/* Double failed advance (two crashes in a row): the second append is refused
 * while the floor cannot be levelled, so the lag stays one entry. */
ZTEST(alp_update_log_anchor, test_double_lag_bounded_and_healed)
{
	struct rig r;
	rig_init(&r);
	zassert_equal(add(&r, 0), ALP_OK);
	r.a.fail_advance = true;
	zassert_equal(add(&r, 1), ALP_ERR_IO); /* committed, floor 1, count 2 */
	zassert_equal(add(&r, 2), ALP_ERR_IO); /* recover's sync fails: refused pre-commit */
	zassert_equal(r.f.counter, 2, "no entry may be appended while the lag is unhealed");
	zassert_equal(r.a.floor, 1);
	/* verify also tries to heal; failure is reported, not swallowed. */
	alp_update_log_verdict_t v;
	uint64_t                 bad;
	zassert_equal(ulog_engine_verify_anchored(&r.s, &r.c, &r.an, &v, &bad), ALP_ERR_IO);
	r.a.fail_advance = false;
	zassert_equal(vfy(&r, true), ALP_UPDATE_LOG_VERIFY_OK); /* no-op-path recover heals */
	zassert_equal(r.a.floor, 2);
	zassert_equal(add(&r, 3), ALP_OK);
	zassert_equal(r.a.floor, 3);
}

/* Failed advance inside recover on the orphan-adoption path. */
ZTEST(alp_update_log_anchor, test_failed_advance_in_recover_after_orphan)
{
	struct rig r;
	rig_init(&r);
	zassert_equal(add(&r, 0), ALP_OK);
	r.f.fail_meta_put = true;
	zassert_equal(add(&r, 1), ALP_ERR_IO); /* orphan entry 1 */
	r.f.fail_meta_put = false;
	r.a.fail_advance  = true;
	alp_update_log_verdict_t v;
	uint64_t                 bad;
	zassert_equal(ulog_engine_verify_anchored(&r.s, &r.c, &r.an, &v, &bad), ALP_ERR_IO);
	zassert_equal(r.f.counter, 2, "orphan adopted even though the floor could not follow");
	zassert_equal(r.a.floor, 1);
	r.a.fail_advance = false;
	zassert_equal(vfy(&r, true), ALP_UPDATE_LOG_VERIFY_OK);
	zassert_equal(r.a.floor, 2);
}
```
