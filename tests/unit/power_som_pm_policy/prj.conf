## CMakeLists.txt
```
# SPDX-License-Identifier: Apache-2.0
#
# The SoM power-domain runtime through the REAL SDK library (#2784, U5): the
# pm_policy power backend's vtable branch, the public domain API, and the real
# pinctrl application (som_power_pinctrl.c).  power_som_domains covers the
# behaviour against fakes without the library; this suite proves the wiring.
#
# It reuses that suite's devicetree (app.overlay + the vnd,som-* bindings) and
# its register-file I2C emulator.  src/pinctrl_soc.h is a minimal stand-in for
# the SoC pinctrl so CONFIG_PINCTRL builds on native_sim.
cmake_minimum_required(VERSION 3.20.0)

get_filename_component(ALP_SDK_ROOT ${CMAKE_CURRENT_SOURCE_DIR}/../../.. ABSOLUTE)
set(SIBLING ${CMAKE_CURRENT_SOURCE_DIR}/../power_som_domains)
set(DTC_OVERLAY_FILE ${SIBLING}/app.overlay)
list(APPEND DTS_ROOT ${SIBLING})

find_package(Zephyr REQUIRED HINTS $ENV{ZEPHYR_BASE})
project(test_power_som_pm_policy)

zephyr_include_directories(src)
target_include_directories(app PRIVATE ${ALP_SDK_ROOT}/src/backends/power)

target_sources(app PRIVATE
    src/test_power_som_pm_policy.c
    ${SIBLING}/src/fake_i2c_emul.c
)
```

## Kconfig
```
# SPDX-License-Identifier: Apache-2.0
mainmenu "SoM power domains through the pm_policy backend"

# native_sim has no power-management support of its own, so CONFIG_PM cannot be
# selected there and the pm_policy power backend is never built by any other
# native_sim suite.  Declare the capability here so this suite compiles it (and
# its SoM domain-op vtable entries).
config HAS_PM
	bool
	default y

source "Kconfig.zephyr"
```

## prj.conf
```kconfig
CONFIG_ZTEST=y
CONFIG_ALP_SDK=y
CONFIG_ALP_SOC_ALIF_ENSEMBLE_E7=y

# The real Zephyr power backend: its vtable carries the SoM domain ops.
CONFIG_PM=y
CONFIG_ALP_SDK_POWER_PM_POLICY=y

# CONFIG_ALP_SDK_SOM_POWER follows from the alp,som-power node + these.
CONFIG_GPIO=y
CONFIG_GPIO_EMUL=y
CONFIG_I2C=y
CONFIG_I2C_EMUL=y
CONFIG_EMUL=y
CONFIG_PINCTRL=y
CONFIG_CRC=y

# Keep the runtime restore short.
CONFIG_ALP_SDK_SOM_PD_WIFI_SETTLE_MS=10
```

## src/pinctrl_soc.h
```c
/* SPDX-License-Identifier: Apache-2.0 */
/*
 * Minimal pinctrl_soc.h so CONFIG_PINCTRL builds on native_sim (pattern of
 * Zephyr's tests/drivers/pinctrl/api).  A pin is just the `pins` cell.
 */
#ifndef POWER_SOM_PM_POLICY_PINCTRL_SOC_H_
#define POWER_SOM_PM_POLICY_PINCTRL_SOC_H_

#include <zephyr/devicetree.h>
#include <zephyr/types.h>

typedef uint32_t pinctrl_soc_pin_t;

#define Z_PINCTRL_STATE_PIN_INIT(node_id, prop, idx) DT_PROP_BY_IDX(node_id, prop, idx),

#define Z_PINCTRL_STATE_PINS_INIT(node_id, prop) \
	{ DT_FOREACH_CHILD_VARGS( \
		DT_PROP_BY_IDX(node_id, prop, 0), DT_FOREACH_PROP_ELEM, pins, Z_PINCTRL_STATE_PIN_INIT) }

#endif
```

## src/test_power_som_pm_policy.c
```c
/* SPDX-License-Identifier: Apache-2.0 */
/*
 * SoM power-domain runtime through the real library (#2784, U5): the three
 * public domain calls answer through zephyr_pm_policy.c's vtable, and the pad
 * state is applied through the real pinctrl API before the first drive.
 */

#include <stdint.h>

#include <zephyr/drivers/gpio.h>
#include <zephyr/drivers/gpio/gpio_emul.h>
#include <zephyr/drivers/pinctrl.h>
#include <zephyr/pm/state.h>
#include <zephyr/ztest.h>

#include <alp/power.h>

#include "som_power.h"

/* The STOP_MODE register window of the test devicetree is a made-up address.  The
 * cold-boot restore reads it on every boot that has no record, so stand in for it:
 * this image is a plain power-on reset (STOP_MODE_STAT clear). */
uint32_t alp_som_power_stop_mode_read(void)
{
	return 0u;
}

/* The emulator keeps a driven output apart from its input side; read the output
 * latch the way a pad with an input buffer reads back on silicon. */
int alp_som_power_pad_read(const struct gpio_dt_spec *s)
{
	int phys = gpio_emul_output_get(s->port, s->pin);

	return (phys < 0) ? phys : (((s->dt_flags & GPIO_ACTIVE_LOW) != 0U) ? !phys : phys);
}

static unsigned int g_mux_calls;
static unsigned int g_mux_pins;

int pinctrl_configure_pins(const pinctrl_soc_pin_t *pins, uint8_t pin_cnt, uintptr_t reg)
{
	(void)pins;
	(void)reg;
	g_mux_calls++;
	g_mux_pins = pin_cnt;
	return 0;
}

static void before(void *unused)
{
	(void)unused;
	alp_som_power_reset_for_test();
	g_mux_calls = 0;
	g_mux_pins  = 0;
}

ZTEST_SUITE(power_som_pm_policy, NULL, NULL, before, NULL, NULL);

ZTEST(power_som_pm_policy, test_public_domain_api_answers_through_the_vtable)
{
	alp_power_domain_info_t i;
	alp_power_boot_info_t   b;
	alp_power_t            *h = alp_power_open();

	zassert_not_null(h);

	zassert_ok(alp_power_domain_info(ALP_POWER_DOMAIN_WIFI_BLE, &i));
	zassert_true(i.present);
	zassert_equal(i.default_action, ALP_POWER_ACTION_HOLD_RESET);
	zassert_equal(i.dependents, ALP_POWER_DEP_CAM_LDO);

	zassert_ok(alp_power_domain_info(ALP_POWER_DOMAIN_EXT_RAM, &i));
	zassert_false(i.present, "the test SoM carries no HyperRAM");

	zassert_equal(alp_power_domain_policy_set(
	                  h, ALP_POWER_DOMAIN_EXT_RAM, ALP_POWER_DOMAIN_POLICY_KEEP_ALIVE),
	              ALP_ERR_NOT_PRESENT_ON_THIS_SOC);
	zassert_equal(
	    alp_power_domain_policy_set(h, ALP_POWER_DOMAIN_WIFI_BLE, ALP_POWER_DOMAIN_POLICY_RAIL_OFF),
	    ALP_ERR_NOSUPPORT,
	    "CONFIG_ALP_SDK_SOM_PD_WIFI_RAIL_OFF is off");
	zassert_ok(alp_power_domain_policy_set(
	    h, ALP_POWER_DOMAIN_BACKLIGHT, ALP_POWER_DOMAIN_POLICY_KEEP_ALIVE));
	zassert_equal(alp_som_power_policy(ALP_POWER_DOMAIN_BACKLIGHT),
	              ALP_POWER_DOMAIN_POLICY_KEEP_ALIVE);

	zassert_ok(alp_power_boot_wake_info(&b));
	zassert_false(b.valid, "no record at POR");

	alp_power_close(h);
}

ZTEST(power_som_pm_policy, test_pinctrl_state_is_applied_once_before_the_first_drive)
{
	const struct device *lpgpio = DEVICE_DT_GET(DT_NODELABEL(lpgpio));

	zassert_ok(gpio_pin_configure(lpgpio, 1, GPIO_OUTPUT_HIGH));
	zassert_equal(g_mux_calls, 0u, "nothing is muxed until a pad is driven");

	zassert_ok(alp_som_power_quiesce(ALP_POWER_MODE_RUN, NULL));
	zassert_equal(g_mux_calls, 1u);
	zassert_equal(g_mux_pins, 5u, "the whole pad group, not one pad");
	zassert_equal(gpio_emul_output_get(lpgpio, 1), 0, "nRESET held low");

	zassert_ok(alp_som_power_restore(NULL));
	zassert_equal(g_mux_calls, 1u, "applied once, not per drive");
}

/* The SoC power hooks native_sim does not have (the kernel idle path references
 * them once CONFIG_PM is on); the suite never sleeps. */
void pm_state_set(enum pm_state state, uint8_t substate_id)
{
	(void)state;
	(void)substate_id;
}

void pm_state_exit_post_ops(enum pm_state state, uint8_t substate_id)
{
	(void)state;
	(void)substate_id;
}
```
