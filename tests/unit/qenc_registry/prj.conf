## CMakeLists.txt
```
# SPDX-License-Identifier: Apache-2.0
cmake_minimum_required(VERSION 3.20.0)
find_package(Zephyr REQUIRED HINTS $ENV{ZEPHYR_BASE})
project(test_qenc_registry)
target_sources(app PRIVATE src/test_qenc_registry.c)
```

## prj.conf
```kconfig
CONFIG_ZTEST=y
CONFIG_ALP_SDK=y
CONFIG_ALP_SOC_ALIF_ENSEMBLE_E7=y
CONFIG_ALP_SDK_QENC_SW_FALLBACK=y
CONFIG_GPIO=y
```

## src/test_qenc_registry.c
```c
/* SPDX-License-Identifier: Apache-2.0
 *
 * Unit tests for the qenc registry dispatcher.  Mirrors the Slice
 * 4a counter_registry / wdt_registry / rtc_registry harnesses; no
 * vendor extensions, so the test surface is the bare selector +
 * capability-getter + public-API edges.
 *
 * Backends visible on this test build:
 *   zephyr_drv      (priority 100, "*" wildcard)
 *   sw_fallback     (priority 0,   "*" wildcard)
 *
 * The gd32_bridge backend is NOT linked here: this prj.conf
 * deliberately omits CONFIG_ALP_SDK_V2N_SUPERVISOR=y so the bridge
 * TU is excluded by the CMake gate added in commit 8.  A separate
 * test build that flips that Kconfig on would exercise the
 * "renesas:rzv2n:n44" silicon_ref path; see TODO at the bottom of
 * this file.
 *
 * The test build pins CONFIG_ALP_SOC_ALIF_ENSEMBLE_E7=y so the
 * dispatcher's `alp_backend_select("qenc", ALP_SOC_REF_STR)`
 * exercises the same selector code path real customer builds hit.
 * Tests that need a different silicon_ref call alp_backend_select
 * directly.
 */

#include <stdbool.h>
#include <stddef.h>
#include <stdint.h>
#include <string.h>

#include <zephyr/ztest.h>

#include <alp/backend.h>
#include <alp/cap_instance.h>
#include <alp/counter.h>
#include <alp/peripheral.h>

#include "../../../../src/backends/qenc/qenc_ops.h"

ZTEST_SUITE(alp_qenc_registry, NULL, NULL, NULL, NULL, NULL);

/* ---------- Selector / priority tests ------------------------------- */

ZTEST(alp_qenc_registry, test_zephyr_drv_picked_over_sw_on_alif_e7)
{
	const alp_backend_t *be = alp_backend_select("qenc", "alif:ensemble:e7");
	zassert_not_null(be);
	zassert_equal(strcmp(be->vendor, "zephyr"), 0);
	zassert_equal(be->priority, 100);
}

ZTEST(alp_qenc_registry, test_sw_fallback_picked_for_unknown_silicon)
{
	/* Both registered backends are wildcards; the higher-priority
     * zephyr_drv would normally win.  This case still exercises the
     * selector and asserts the sw_fallback is reachable on the test
     * build -- if the selector preference ever changes to "exact
     * match beats wildcard", this assertion documents the expected
     * behaviour. */
	const alp_backend_t *be = alp_backend_select("qenc", "fictional:soc:zz");
	zassert_not_null(be);
	/* On the current selector (priority-only) zephyr_drv wins for
     * fictional silicon too; we still assert reachability of the
     * sw_fallback via the registry's count below. */
	(void)be;
	zassert_true(alp_backend_count("qenc") >= 2u);
}

ZTEST(alp_qenc_registry, test_select_returns_null_for_null_class)
{
	zassert_is_null(alp_backend_select(NULL, "alif:ensemble:e7"));
}

ZTEST(alp_qenc_registry, test_select_returns_null_for_null_silicon_ref)
{
	/* Regression for the NULL silicon_ref fix in src/backend.c.
     * NULL must NOT silently match the "*" wildcard. */
	zassert_is_null(alp_backend_select("qenc", NULL));
}

/* ---------- Public-API behaviour tests ------------------------------ */

ZTEST(alp_qenc_registry, test_open_returns_null_on_null_config)
{
	/* The dispatcher rejects NULL cfg with ALP_ERR_INVAL before
     * consulting the registry; alp_qenc_open returns NULL. */
	alp_qenc_t *h = alp_qenc_open(NULL);
	zassert_is_null(h);
}

ZTEST(alp_qenc_registry, test_capabilities_returns_null_for_null_handle)
{
	zassert_is_null(alp_qenc_capabilities(NULL));
}

/* ---------- Registry inventory test -------------------------------- */

ZTEST(alp_qenc_registry, test_backend_count_for_qenc)
{
	/* zephyr_drv + sw_fallback registered on this build.
     * gd32_bridge is gated behind CONFIG_ALP_SDK_V2N_SUPERVISOR=y
     * which this prj.conf deliberately omits. */
	zassert_equal(alp_backend_count("qenc"), 2u);
}

/* TODO(slice-4a-followup): bridge backend selection test.
 * When CONFIG_ALP_SDK_V2N_SUPERVISOR=y, alp_backend_select("qenc",
 * "renesas:rzv2n:n44") should return vendor "renesas" priority 100
 * (gd32_bridge wins via specific silicon_ref match).  Mirrors the
 * counter_registry TODO. */
```
