## CMakeLists.txt
```
# SPDX-License-Identifier: Apache-2.0
cmake_minimum_required(VERSION 3.20.0)
find_package(Zephyr REQUIRED HINTS $ENV{ZEPHYR_BASE})
project(test_inference_registry)
target_sources(app PRIVATE src/test_inference_registry.c)
```

## prj.conf
```kconfig
CONFIG_ZTEST=y
CONFIG_ALP_SDK=y
CONFIG_ALP_SOC_ALIF_ENSEMBLE_E7=y
CONFIG_ALP_SDK_INFERENCE_SW_FALLBACK=y
```

## src/test_inference_registry.c
```c
/* SPDX-License-Identifier: Apache-2.0
 *
 * Unit tests for the inference registry dispatcher.
 *
 * Backends visible on this test build:
 *   sw_fallback     (priority 0,   "*" wildcard, vendor "sw_fallback")
 *
 * Real bodies (tflm, ethos_u_aen) do NOT link into
 * this native_sim test build -- they all depend on either TFLM
 * (not on native_sim) or vendor silicon-specific Kconfigs.  The
 * A55/Linux-only DRP-AI / DEEPX DX-M1 engines never register on
 * Zephyr at all (#58/#59).  The dispatcher, vendor-ext gating
 * (renesas / deepx surfaces), and selector code paths are
 * exercised against the SW fallback + fabricated handles pinned
 * to specific vendor strings.
 *
 * The test build pins CONFIG_ALP_SOC_ALIF_ENSEMBLE_E7=y so the
 * dispatcher's `alp_backend_select("inference", ALP_SOC_REF_STR)`
 * exercises the same selector code path real customer builds hit.
 * Tests that need a different silicon_ref call alp_backend_select
 * directly.
 */

#include <stdbool.h>
#include <stddef.h>
#include <stdint.h>
#include <string.h>

#include <zephyr/ztest.h>

#include <alp/backend.h>
#include <alp/cap_instance.h>
#include <alp/ext/deepx/inference.h>
#include <alp/ext/renesas/inference.h>
#include <alp/inference.h>
#include <alp/peripheral.h>

#include "../../../../src/backends/inference/inference_ops.h"
/* ALP_HANDLE_LC_OPEN -- reachable unqualified because
 * zephyr/CMakeLists.txt puts src/common/ on every Zephyr TU's include
 * path (zephyr_include_directories), same as inference_dispatch.c's
 * own #include "alp_slot_claim.h". */
#include "alp_slot_claim.h"

ZTEST_SUITE(alp_inference_registry, NULL, NULL, NULL, NULL, NULL);

/* ---------- Selector / priority tests ------------------------------- */

ZTEST(alp_inference_registry, test_sw_fallback_picked_for_alif_e7)
{
	/* sw_fallback is the only inference backend linked on this
     * test build.  Any silicon_ref resolves to it. */
	const alp_backend_t *be = alp_backend_select("inference", "alif:ensemble:e7");
	zassert_not_null(be);
	zassert_equal(strcmp(be->vendor, "sw_fallback"), 0);
	zassert_equal(be->priority, 0);
}

ZTEST(alp_inference_registry, test_sw_fallback_picked_for_unknown_silicon)
{
	const alp_backend_t *be = alp_backend_select("inference", "fictional:soc:zz");
	zassert_not_null(be);
	zassert_equal(strcmp(be->vendor, "sw_fallback"), 0);
}

ZTEST(alp_inference_registry, test_select_returns_null_for_null_class)
{
	zassert_is_null(alp_backend_select(NULL, "alif:ensemble:e7"));
}

ZTEST(alp_inference_registry, test_select_returns_null_for_null_silicon_ref)
{
	/* Regression for the NULL silicon_ref fix in src/backend.c.
     * NULL must NOT silently match the "*" wildcard. */
	zassert_is_null(alp_backend_select("inference", NULL));
}

ZTEST(alp_inference_registry, test_backend_count_includes_sw_fallback)
{
	/* sw_fallback is the only inference backend in this build;
     * count must be at least 1. */
	zassert_true(alp_backend_count("inference") >= 1u);
}

/* ---------- Public-API behaviour tests ------------------------------ */

ZTEST(alp_inference_registry, test_open_returns_null_on_null_cfg)
{
	alp_inference_t *inf = alp_inference_open(NULL);
	zassert_is_null(inf);
	zassert_equal(alp_last_error(), ALP_ERR_INVAL);
}

ZTEST(alp_inference_registry, test_open_returns_null_on_zero_model_size)
{
	uint8_t                dummy_model[4] = { 0 };
	alp_inference_config_t cfg            = {
		.model_data  = dummy_model,
		.model_size  = 0u,
		.format      = ALP_INFERENCE_MODEL_TFLITE,
		.backend     = ALP_INFERENCE_BACKEND_AUTO,
		.arena_bytes = 0u,
		.arena       = NULL,
	};
	alp_inference_t *inf = alp_inference_open(&cfg);
	zassert_is_null(inf);
	zassert_equal(alp_last_error(), ALP_ERR_INVAL);
}

ZTEST(alp_inference_registry, test_open_returns_null_on_null_model_data)
{
	alp_inference_config_t cfg = {
		.model_data  = NULL,
		.model_size  = 16u,
		.format      = ALP_INFERENCE_MODEL_TFLITE,
		.backend     = ALP_INFERENCE_BACKEND_AUTO,
		.arena_bytes = 0u,
		.arena       = NULL,
	};
	alp_inference_t *inf = alp_inference_open(&cfg);
	zassert_is_null(inf);
	zassert_equal(alp_last_error(), ALP_ERR_INVAL);
}

ZTEST(alp_inference_registry, test_open_via_sw_fallback_returns_nosupport)
{
	/* sw_fallback is a NOSUPPORT stub on native_sim (no inference
     * engine linked): open reports unsupported and the dispatcher
     * relays it as a NULL handle + last_error = NOSUPPORT.  Mirrors
     * the inference.smoke zephyr contract. */
	uint8_t                dummy_model[16] = { 0 };
	alp_inference_config_t cfg             = {
		.model_data  = dummy_model,
		.model_size  = sizeof(dummy_model),
		.format      = ALP_INFERENCE_MODEL_TFLITE,
		.backend     = ALP_INFERENCE_BACKEND_AUTO,
		.arena_bytes = 0u,
		.arena       = NULL,
	};
	zassert_is_null(alp_inference_open(&cfg));
	zassert_equal(alp_last_error(), ALP_ERR_NOSUPPORT);
}

ZTEST(alp_inference_registry, test_capabilities_returns_null_for_null_handle)
{
	zassert_is_null(alp_inference_capabilities(NULL));
}

ZTEST(alp_inference_registry, test_close_on_null_is_noop)
{
	/* Close on NULL must not crash; mirrors the camera + storage
     * dispatcher contract. */
	alp_inference_close(NULL);
}

ZTEST(alp_inference_registry, test_invoke_on_null_returns_not_ready)
{
	zassert_equal(alp_inference_invoke(NULL), ALP_ERR_NOT_READY);
}

ZTEST(alp_inference_registry, test_get_input_on_null_returns_not_ready)
{
	alp_inference_tensor_t t = { 0 };
	zassert_equal(alp_inference_get_input(NULL, 0u, &t), ALP_ERR_NOT_READY);
}

/* The former open-success tests -- handle-based NULL-out INVAL and
 * pool exhaustion -- are removed: sw_fallback's open is a NOSUPPORT
 * stub on native_sim, so no live handle is ever returned.  NULL-handle
 * arg validation is covered by test_{invoke,get_input}_on_null above. */

/* ---------- alp_inference_last_invoke_latency_us() ------------------ */

/* sw_fallback's open() is a NOSUPPORT stub on native_sim, so
 * alp_inference_open() never hands back a live handle here -- exactly
 * like the "former open-success tests" note above.  Drive the real
 * dispatcher (src/inference_dispatch.c) through its public
 * alp_inference_invoke() / alp_inference_last_invoke_latency_us() entry
 * points against a FABRICATED handle carrying a fake ops->invoke, the
 * same technique the vendor-ext tests below use for backend->vendor --
 * lifecycle=OPEN is what lets alp_handle_op_enter() accept it. */

static alp_status_t fake_invoke_ok(alp_inference_backend_state_t *state)
{
	(void)state;
	/* Real measurable work -- borrows the Yocto twin's shape
	 * (tests/yocto/inference_latency.c's fake DEEPX invoke, which
	 * sleeps 2ms and asserts >= 1000us). Before this, fake_invoke_ok()
	 * did no work and test_last_invoke_latency_populated_after_
	 * successful_invoke()'s only assertion was "us < 1000000u", which
	 * an implementation returning a hardcoded 0 would also pass. */
	k_sleep(K_MSEC(2));
	return ALP_OK;
}

static alp_status_t fake_invoke_io_error(alp_inference_backend_state_t *state)
{
	(void)state;
	return ALP_ERR_IO;
}

static const alp_inference_ops_t k_fake_ops_ok       = { .invoke = fake_invoke_ok };
static const alp_inference_ops_t k_fake_ops_io_error = { .invoke = fake_invoke_io_error };

ZTEST(alp_inference_registry, test_last_invoke_latency_null_handle_returns_not_ready)
{
	uint64_t us = 12345u;
	zassert_equal(alp_inference_last_invoke_latency_us(NULL, &us), ALP_ERR_NOT_READY);
	/* NOT_READY must not touch the out-param. */
	zassert_equal(us, 12345u);
}

ZTEST(alp_inference_registry, test_last_invoke_latency_null_out_returns_inval)
{
	struct alp_inference fake = {
		.state     = { .ops = &k_fake_ops_ok },
		.lifecycle = ALP_HANDLE_LC_OPEN,
		.in_use    = true,
	};
	zassert_equal(alp_inference_last_invoke_latency_us(&fake, NULL), ALP_ERR_INVAL);
}

/* MAJOR 2 (PR #1541 review): out_us-NULL is checked BEFORE the handle,
 * matching every other op in this file ("param check before enter") and
 * <alp/inference.h>'s documented order (ALP_ERR_INVAL listed before
 * ALP_ERR_NOT_READY) -- so (NULL, NULL) is ALP_ERR_INVAL, not
 * ALP_ERR_NOT_READY. See tests/yocto/inference_latency.c for the
 * matching case on the Yocto dispatcher. */
ZTEST(alp_inference_registry, test_last_invoke_latency_null_handle_and_null_out_returns_inval)
{
	zassert_equal(alp_inference_last_invoke_latency_us(NULL, NULL), ALP_ERR_INVAL);
}

/* Same MAJOR 2 fix, exercised against a closed (never-opened) handle --
 * out_us-NULL must win over the handle's non-OPEN lifecycle too. */
ZTEST(alp_inference_registry, test_last_invoke_latency_closed_handle_null_out_returns_inval)
{
	struct alp_inference fake = {
		.state     = { .ops = &k_fake_ops_ok },
		.lifecycle = ALP_HANDLE_LC_UNOPENED,
		.in_use    = true,
	};
	zassert_equal(alp_inference_last_invoke_latency_us(&fake, NULL), ALP_ERR_INVAL);
}

ZTEST(alp_inference_registry, test_last_invoke_latency_before_any_invoke_returns_not_ready)
{
	/* A fabricated handle skips alp_inference_open() -- the only place
	 * that sets the UINT32_MAX "no sample yet" sentinel -- so set it
	 * by hand to stand in for a freshly-opened, never-invoked real
	 * handle. UINT32_MAX, not UINT64_MAX: last_invoke_latency_us is a
	 * uint32_t (no libatomic on Cortex-M -- see the struct's field
	 * comment in src/backends/inference/inference_ops.h). */
	struct alp_inference fake = {
		.state                  = { .ops = &k_fake_ops_ok },
		.lifecycle              = ALP_HANDLE_LC_OPEN,
		.last_invoke_latency_us = UINT32_MAX,
		.in_use                 = true,
	};
	uint64_t us = 0u;
	zassert_equal(alp_inference_last_invoke_latency_us(&fake, &us), ALP_ERR_NOT_READY);
}

ZTEST(alp_inference_registry, test_last_invoke_latency_populated_after_successful_invoke)
{
	struct alp_inference fake = {
		.state                  = { .ops = &k_fake_ops_ok },
		.lifecycle              = ALP_HANDLE_LC_OPEN,
		.last_invoke_latency_us = UINT32_MAX,
		.in_use                 = true,
	};
	zassert_equal(alp_inference_invoke(&fake), ALP_OK);

	uint64_t us = UINT64_MAX;
	zassert_equal(alp_inference_last_invoke_latency_us(&fake, &us), ALP_OK);
	/* fake_invoke_ok() now sleeps 2ms (see its definition above) --
	 * assert BOTH a lower and an upper bound, not just an upper one:
	 * "us < 1000000u" alone also passes against a hardcoded-0
	 * implementation, which is exactly the gap this test used to have
	 * (PR #1541 review). The lower bound proves a REAL measurement was
	 * taken, matching tests/yocto/inference_latency.c's
	 * test_populated_after_successful_invoke shape. */
	zassert_true(us >= 1000u, "suspiciously small latency sample: %llu us", (unsigned long long)us);
	zassert_true(us < 1000000u, "implausible latency sample: %llu us", (unsigned long long)us);
}

ZTEST(alp_inference_registry, test_last_invoke_latency_unchanged_after_failed_invoke)
{
	struct alp_inference fake = {
		.state                  = { .ops = &k_fake_ops_ok },
		.lifecycle              = ALP_HANDLE_LC_OPEN,
		.last_invoke_latency_us = UINT32_MAX,
		.in_use                 = true,
	};
	zassert_equal(alp_inference_invoke(&fake), ALP_OK);
	uint64_t first_us = 0u;
	zassert_equal(alp_inference_last_invoke_latency_us(&fake, &first_us), ALP_OK);

	/* Switch to a failing backend without re-opening -- a failed
	 * invoke must leave the last SUCCESSFUL sample in place. */
	fake.state.ops = &k_fake_ops_io_error;
	zassert_equal(alp_inference_invoke(&fake), ALP_ERR_IO);

	uint64_t second_us = 0u;
	zassert_equal(alp_inference_last_invoke_latency_us(&fake, &second_us), ALP_OK);
	zassert_equal(second_us, first_us);
}

/* ---------- Vendor-ext gate tests (Renesas) ------------------------- */

ZTEST(alp_inference_registry, test_renesas_ext_null_handle_returns_inval)
{
	uint32_t status = 0u;
	zassert_equal(
	    alp_renesas_inference_pipeline_stage_pin(NULL, 0u, ALP_RENESAS_INFERENCE_STAGE_DRP),
	    ALP_ERR_INVAL);
	zassert_equal(alp_renesas_inference_ai_sram_reserve(NULL, 1024u), ALP_ERR_INVAL);
	zassert_equal(alp_renesas_inference_get_status(NULL, &status), ALP_ERR_INVAL);
}

ZTEST(alp_inference_registry, test_renesas_ext_non_renesas_returns_not_present)
{
	/* Fabricate a handle pinned to a non-Renesas backend.  Using
     * the in_use flag + a synthesised alp_backend_t lets the test
     * exercise the vendor-string gate without needing a live
     * Renesas SoC in the build. */
	const alp_backend_t fake_be = {
		.silicon_ref = "alif:ensemble:e7",
		.vendor      = "alif",
		.base_caps   = 0u,
		.priority    = 0,
		.ops         = NULL,
		.probe       = NULL,
	};
	struct alp_inference fake = {
		.state       = { 0 },
		.backend     = &fake_be,
		.cached_caps = { 0 },
		.in_use      = true,
	};
	uint32_t status = 0u;
	zassert_equal(
	    alp_renesas_inference_pipeline_stage_pin(&fake, 0u, ALP_RENESAS_INFERENCE_STAGE_DRP),
	    ALP_ERR_NOT_PRESENT_ON_THIS_SOC);
	zassert_equal(alp_renesas_inference_ai_sram_reserve(&fake, 1024u),
	              ALP_ERR_NOT_PRESENT_ON_THIS_SOC);
	zassert_equal(alp_renesas_inference_get_status(&fake, &status),
	              ALP_ERR_NOT_PRESENT_ON_THIS_SOC);
}

ZTEST(alp_inference_registry, test_renesas_ext_get_status_inval_on_null_status)
{
	const alp_backend_t fake_be = {
		.silicon_ref = "renesas:rzv2n:n44",
		.vendor      = "renesas",
		.base_caps   = 0u,
		.priority    = 0,
		.ops         = NULL,
		.probe       = NULL,
	};
	struct alp_inference fake = {
		.state       = { 0 },
		.backend     = &fake_be,
		.cached_caps = { 0 },
		.in_use      = true,
	};
	zassert_equal(alp_renesas_inference_get_status(&fake, NULL), ALP_ERR_INVAL);
}

ZTEST(alp_inference_registry, test_renesas_ext_invalid_stage_returns_inval)
{
	const alp_backend_t fake_be = {
		.silicon_ref = "renesas:rzv2n:n44",
		.vendor      = "renesas",
		.base_caps   = 0u,
		.priority    = 0,
		.ops         = NULL,
		.probe       = NULL,
	};
	struct alp_inference fake = {
		.state       = { 0 },
		.backend     = &fake_be,
		.cached_caps = { 0 },
		.in_use      = true,
	};
	/* Stage value past the documented enum tail. */
	zassert_equal(
	    alp_renesas_inference_pipeline_stage_pin(&fake, 0u, (alp_renesas_inference_stage_t)99u),
	    ALP_ERR_INVAL);
}

ZTEST(alp_inference_registry, test_renesas_ext_zero_reserve_returns_oor)
{
	const alp_backend_t fake_be = {
		.silicon_ref = "renesas:rzv2n:n44",
		.vendor      = "renesas",
		.base_caps   = 0u,
		.priority    = 0,
		.ops         = NULL,
		.probe       = NULL,
	};
	struct alp_inference fake = {
		.state       = { 0 },
		.backend     = &fake_be,
		.cached_caps = { 0 },
		.in_use      = true,
	};
	zassert_equal(alp_renesas_inference_ai_sram_reserve(&fake, 0u), ALP_ERR_OUT_OF_RANGE);
	/* > AI-SRAM physical size (1.5 MB) -> OUT_OF_RANGE. */
	zassert_equal(alp_renesas_inference_ai_sram_reserve(&fake, 4u * 1024u * 1024u),
	              ALP_ERR_OUT_OF_RANGE);
}

/* ---------- Vendor-ext gate tests (DEEPX) --------------------------- */

ZTEST(alp_inference_registry, test_deepx_ext_null_handle_returns_inval)
{
	alp_deepx_device_status_t status;
	zassert_equal(alp_deepx_inference_bind_cores(NULL, 0x1u), ALP_ERR_INVAL);
	zassert_equal(alp_deepx_inference_get_status(NULL, &status), ALP_ERR_INVAL);
}

ZTEST(alp_inference_registry, test_deepx_ext_non_deepx_returns_not_present)
{
	const alp_backend_t fake_be = {
		.silicon_ref = "alif:ensemble:e7",
		.vendor      = "alif",
		.base_caps   = 0u,
		.priority    = 0,
		.ops         = NULL,
		.probe       = NULL,
	};
	struct alp_inference fake = {
		.state       = { 0 },
		.backend     = &fake_be,
		.cached_caps = { 0 },
		.in_use      = true,
	};
	alp_deepx_device_status_t status;
	zassert_equal(alp_deepx_inference_bind_cores(&fake, 0x1u), ALP_ERR_NOT_PRESENT_ON_THIS_SOC);
	zassert_equal(alp_deepx_inference_get_status(&fake, &status), ALP_ERR_NOT_PRESENT_ON_THIS_SOC);
}

ZTEST(alp_inference_registry, test_deepx_ext_bad_args_and_no_libdxrt_on_zephyr)
{
	const alp_backend_t fake_be = {
		.silicon_ref = "deepx:dx:m1",
		.vendor      = "deepx",
		.base_caps   = 0u,
		.priority    = 0,
		.ops         = NULL,
		.probe       = NULL,
	};
	struct alp_inference fake = {
		.state       = { 0 },
		.backend     = &fake_be,
		.cached_caps = { 0 },
		.in_use      = true,
	};
	/* A mask bit past NPU core 2 is unsupported. */
	zassert_equal(alp_deepx_inference_bind_cores(&fake, 0x8u), ALP_ERR_NOSUPPORT);
	zassert_equal(alp_deepx_inference_get_status(&fake, NULL), ALP_ERR_INVAL);
	/* A DEEPX-vendor handle on an M-class core has no libdxrt behind it. */
	alp_deepx_device_status_t status;
	zassert_equal(alp_deepx_inference_bind_cores(&fake, 0x7u), ALP_ERR_NOSUPPORT);
	zassert_equal(alp_deepx_inference_get_status(&fake, &status), ALP_ERR_NOSUPPORT);
}
```
