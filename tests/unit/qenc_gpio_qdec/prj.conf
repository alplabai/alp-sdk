## CMakeLists.txt
```
# SPDX-License-Identifier: Apache-2.0
cmake_minimum_required(VERSION 3.20.0)
find_package(Zephyr REQUIRED HINTS $ENV{ZEPHYR_BASE})
project(test_qenc_gpio_qdec)
target_sources(app PRIVATE src/test_qenc_gpio_qdec.c)
target_include_directories(app PRIVATE ${CMAKE_CURRENT_SOURCE_DIR}/../../../src)
```

## prj.conf
```kconfig
CONFIG_ZTEST=y
CONFIG_ALP_SDK=y
CONFIG_ALP_SOC_ALIF_ENSEMBLE_E7=y
CONFIG_GPIO=y
CONFIG_GPIO_EMUL=y
CONFIG_INPUT=y
# Runs input_process() inline on the reporting thread instead of the
# input subsystem's own worker thread -- lets the test observe the
# accumulator immediately after input_report_rel() returns, with no
# k_msleep() needed to wait for a separate thread to drain the queue.
CONFIG_INPUT_MODE_SYNCHRONOUS=y
# native_sim is not an Ensemble part: the test supplies alp_z_gpio_pad_input().
CONFIG_ALP_GPIO_PAD_INPUT=y
```

## app.overlay
```dts
/*
 * Copyright 2026 Alp Lab AB
 * SPDX-License-Identifier: Apache-2.0
 *
 * app.overlay (not boards/<board>.overlay) so one file covers every
 * platform_allow entry in testcase.yaml -- native_sim and
 * native_sim/native/64 needed byte-identical content, which is a
 * copy/paste trap for the two to drift silently.
 *
 * alp-qenc0: a gpio-qdec node (issue #2095), backed by native_sim's
 * `gpio0` (zephyr,gpio-emul) controller.  The test injects
 * INPUT_EV_REL events directly via input_report_rel() rather than
 * toggling gpio0's pins -- see src/test_qenc_gpio_qdec.c -- so the
 * two ab-gpio pins below exist only to satisfy the gpio-qdec
 * binding's required properties; the sampling state machine they
 * would normally drive is never exercised here.
 *
 * alp-qenc1: aliases the board's own gpio0 controller node directly
 * -- any ready device that is NOT compatible "gpio-qdec" -- so the
 * dispatcher's open-time fall-through has a real non-gpio-qdec
 * candidate to prove it reaches zephyr_drv on.
 */

#include <zephyr/dt-bindings/gpio/gpio.h>
#include <zephyr/dt-bindings/input/input-event-codes.h>

/ {
	aliases {
		alp-qenc0 = &qdec0;
		alp-qenc1 = &gpio0;
	};

	qdec0: qdec0 {
		compatible = "gpio-qdec";
		gpios = <&gpio0 10 GPIO_ACTIVE_HIGH>, <&gpio0 11 GPIO_ACTIVE_HIGH>;
		steps-per-period = <4>;
		zephyr,axis = <INPUT_REL_WHEEL>;
		sample-time-us = <2000>;
		idle-timeout-ms = <200>;
	};
};
```

## boards/native_sim.overlay
```dts
/*
 * Copyright 2026 Alp Lab AB
 * SPDX-License-Identifier: Apache-2.0
 *
 * gpio-qdec node for the alp-qenc0 alias (issue #2095), backed by
 * native_sim's `gpio0` (zephyr,gpio-emul) controller.  The test
 * injects INPUT_EV_REL events directly via input_report_rel() rather
 * than toggling gpio0's pins -- see src/test_qenc_gpio_qdec.c -- so
 * the two ab-gpio pins below exist only to satisfy the gpio-qdec
 * binding's required properties; the sampling state machine they
 * would normally drive is never exercised here.
 */

#include <zephyr/dt-bindings/gpio/gpio.h>
#include <zephyr/dt-bindings/input/input-event-codes.h>

/ {
	aliases {
		alp-qenc0 = &qdec0;
	};

	qdec0: qdec0 {
		compatible = "gpio-qdec";
		gpios = <&gpio0 10 GPIO_ACTIVE_HIGH>, <&gpio0 11 GPIO_ACTIVE_HIGH>;
		steps-per-period = <4>;
		zephyr,axis = <INPUT_REL_WHEEL>;
		sample-time-us = <2000>;
		idle-timeout-ms = <200>;
	};
};
```

## src/test_qenc_gpio_qdec.c
```c
/* SPDX-License-Identifier: Apache-2.0
 *
 * Unit tests for the gpio-qdec input-subsystem QEnc backend (issue
 * #2095).  alp-qenc0 is aliased to a `gpio-qdec` node (see
 * boards/native_sim*.overlay) backed by native_sim's `gpio0` emul
 * controller.  Rather than toggling the emulated GPIO pins and
 * relying on the real gpio-qdec sampling state machine (a Gray-code
 * decode with its own idle/poll timing, not what this backend's
 * accumulation logic is being tested for), the test injects
 * INPUT_EV_REL events directly with input_report_rel() -- the exact
 * event shape the real driver posts once steps-per-period real phase
 * transitions accumulate (see zephyr/drivers/input/
 * input_gpio_qdec.c's gpio_qdec_event_worker()).  With
 * CONFIG_INPUT_MODE_SYNCHRONOUS=y the callback runs inline, so the
 * backend's accumulator is up to date the instant input_report_rel()
 * returns -- no k_msleep() needed.
 */

#include <zephyr/device.h>
#include <zephyr/drivers/gpio.h>
#include <zephyr/dt-bindings/input/input-event-codes.h>
#include <zephyr/input/input.h>
#include <zephyr/ztest.h>

#include <alp/counter.h>
#include <alp/peripheral.h>

#include "backends/gpio/gpio_pad.h"

#define QDEC_NODE DT_ALIAS(alp_qenc0)

/* Stand-in for the Alif pad input-buffer hook (not built on native_sim):
 * records which pins the backend asked to make readable (issue #2808). */
static int     pad_calls;
static uint8_t pad_pins[4];

int alp_z_gpio_pad_input(const struct gpio_dt_spec *spec, alp_gpio_pull_t pull)
{
	zassert_equal(pull, ALP_GPIO_PULL_NONE);
	if (pad_calls < (int)ARRAY_SIZE(pad_pins)) pad_pins[pad_calls] = spec->pin;
	pad_calls++;
	return 0;
}

ZTEST_SUITE(alp_qenc_gpio_qdec, NULL, NULL, NULL, NULL, NULL);

ZTEST(alp_qenc_gpio_qdec, test_open_get_position_uses_gpio_qdec_backend_not_zephyr_drv)
{
	const struct device *dev = DEVICE_DT_GET(QDEC_NODE);
	zassert_true(device_is_ready(dev), "gpio-qdec device not ready");

	alp_qenc_config_t cfg = ALP_QENC_CONFIG_DEFAULT(0);
	alp_qenc_t       *h   = alp_qenc_open(&cfg);
	zassert_not_null(h, "expected gpio_qdec backend to accept alp-qenc0");

	/* zephyr_drv (priority 100) would ALSO accept this node's open()
	 * -- it only checks device_is_ready(), not the compatible string
	 * -- but its get_position() calls sensor_sample_fetch(), which the
	 * gpio-qdec input driver does not implement.  A gpio_qdec-backend
	 * open must win priority (110 > 100) and this call must succeed,
	 * proving the higher-priority gpio_qdec ops -- not zephyr_drv's --
	 * are the ones wired into this handle. */
	int32_t pos = -1;
	zassert_equal(alp_qenc_get_position(h, &pos), ALP_OK);

	alp_qenc_close(h);
}

ZTEST(alp_qenc_gpio_qdec, test_open_enables_both_phase_pads)
{
	pad_calls             = 0;
	alp_qenc_config_t cfg = ALP_QENC_CONFIG_DEFAULT(0);
	alp_qenc_t       *h   = alp_qenc_open(&cfg);
	zassert_not_null(h);
	/* qdec0 in app.overlay: gpios = <&gpio0 10>, <&gpio0 11>. */
	zassert_equal(pad_calls, 2);
	zassert_equal(pad_pins[0], 10);
	zassert_equal(pad_pins[1], 11);
	alp_qenc_close(h);
}

ZTEST(alp_qenc_gpio_qdec, test_open_falls_through_past_non_gpio_qdec_alias)
{
	/* alp-qenc1 aliases gpio0 directly -- a real, ready device that
	 * is NOT compatible "gpio-qdec".  The gpio_qdec backend's open()
	 * must decline it with ALP_ERR_NOSUPPORT, and the dispatcher must
	 * walk down to zephyr_drv (priority 100) instead of failing the
	 * whole open -- issue #2095's open-time fall-through. */
	alp_qenc_config_t cfg = ALP_QENC_CONFIG_DEFAULT(1);
	alp_qenc_t       *h   = alp_qenc_open(&cfg);
	zassert_not_null(h, "expected fall-through to zephyr_drv for a non-gpio-qdec alias");
	alp_qenc_close(h);
}

ZTEST(alp_qenc_gpio_qdec, test_position_accumulates_injected_rel_events)
{
	const struct device *dev = DEVICE_DT_GET(QDEC_NODE);

	alp_qenc_config_t cfg = ALP_QENC_CONFIG_DEFAULT(0);
	alp_qenc_t       *h   = alp_qenc_open(&cfg);
	zassert_not_null(h);

	/* Baseline: earlier tests in this suite may have already ticked
	 * the shared accumulator, so measure the delta rather than an
	 * absolute value. */
	int32_t before = 0;
	zassert_equal(alp_qenc_get_position(h, &before), ALP_OK);

	/* Three real gpio-qdec event postings: +1, +1, -1 detent (see
	 * gpio_qdec_event_worker() -- the value is the already-divided
	 * steps-per-period count, signed by direction). */
	zassert_equal(input_report_rel(dev, INPUT_REL_WHEEL, 1, true, K_NO_WAIT), 0);
	zassert_equal(input_report_rel(dev, INPUT_REL_WHEEL, 1, true, K_NO_WAIT), 0);
	zassert_equal(input_report_rel(dev, INPUT_REL_WHEEL, -1, true, K_NO_WAIT), 0);

	int32_t after = 0;
	zassert_equal(alp_qenc_get_position(h, &after), ALP_OK);
	zassert_equal(after - before, 1, "expected net +1 tick, got %d", (int)(after - before));

	alp_qenc_close(h);
}

ZTEST(alp_qenc_gpio_qdec, test_reset_position_zeroes_accumulator)
{
	const struct device *dev = DEVICE_DT_GET(QDEC_NODE);

	alp_qenc_config_t cfg = ALP_QENC_CONFIG_DEFAULT(0);
	alp_qenc_t       *h   = alp_qenc_open(&cfg);
	zassert_not_null(h);

	zassert_equal(input_report_rel(dev, INPUT_REL_WHEEL, 5, true, K_NO_WAIT), 0);

	zassert_equal(alp_qenc_reset_position(h), ALP_OK);

	int32_t pos = -1;
	zassert_equal(alp_qenc_get_position(h, &pos), ALP_OK);
	zassert_equal(pos, 0, "expected 0 after reset, got %d", (int)pos);

	alp_qenc_close(h);
}

ZTEST(alp_qenc_gpio_qdec, test_unrelated_event_type_ignored)
{
	const struct device *dev = DEVICE_DT_GET(QDEC_NODE);

	alp_qenc_config_t cfg = ALP_QENC_CONFIG_DEFAULT(0);
	alp_qenc_t       *h   = alp_qenc_open(&cfg);
	zassert_not_null(h);
	zassert_equal(alp_qenc_reset_position(h), ALP_OK);

	/* An INPUT_EV_KEY (or any non-REL) event on the same device must
	 * not move the position -- the callback filters on evt->type. */
	zassert_equal(input_report_key(dev, INPUT_KEY_0, 1, true, K_NO_WAIT), 0);

	int32_t pos = -1;
	zassert_equal(alp_qenc_get_position(h, &pos), ALP_OK);
	zassert_equal(pos, 0, "non-REL event must not move position, got %d", (int)pos);

	alp_qenc_close(h);
}
```
