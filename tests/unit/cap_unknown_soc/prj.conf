## CMakeLists.txt
```
# SPDX-License-Identifier: Apache-2.0

cmake_minimum_required(VERSION 3.20)

find_package(Zephyr REQUIRED HINTS $ENV{ZEPHYR_BASE})
project(alp_sdk_cap_unknown_soc_test LANGUAGES C)

target_sources(app PRIVATE src/test_cap_unknown_soc.c)
```

## prj.conf
```kconfig
CONFIG_ZTEST=y
CONFIG_ALP_SDK=y
```

## src/test_cap_unknown_soc.c
```c
/*
 * SPDX-License-Identifier: Apache-2.0
 *
 * With no CONFIG_ALP_SOC_* selected, every ALP_SOC_* macro defaults to
 * UINT16_MAX.  soc_caps.h promises that ALP_CAP_* collapse to exactly
 * 0 or 1, so the flag caps must not pass that raw value through.
 */

#include <zephyr/ztest.h>

#include <alp/soc_caps.h>

/* The test only proves anything on the unknown-SoC path: fail the build if a
 * CONFIG_ALP_SOC_* got selected (every ALP_SOC_* is UINT16_MAX only there). */
BUILD_ASSERT(ALP_SOC_NPU_ARENA_SRAM_KIB == UINT16_MAX, "cap_unknown_soc needs no ALP_SOC selected");

ZTEST_SUITE(alp_cap_unknown_soc, NULL, NULL, NULL, NULL, NULL);

#define CAP_IS_BOOL(cap) ((ALP_CAP_##cap) == 0 || (ALP_CAP_##cap) == 1)

ZTEST(alp_cap_unknown_soc, test_every_cap_is_exactly_0_or_1)
{
	zassert_true(CAP_IS_BOOL(HW_I2C));
	zassert_true(CAP_IS_BOOL(HW_CAN_FD));
	zassert_true(CAP_IS_BOOL(XSPI_DMA));
	zassert_true(CAP_IS_BOOL(HEXSPI_DMA));
	zassert_true(CAP_IS_BOOL(EMMC_DMA));
	zassert_true(CAP_IS_BOOL(QUADSPI_DMA));
	zassert_true(CAP_IS_BOOL(NPU_DRPAI));
	zassert_true(CAP_IS_BOOL(HELIUM_MVE));
	zassert_true(CAP_IS_BOOL(NEON));
	zassert_true(CAP_IS_BOOL(GPU2D));
	zassert_true(CAP_IS_BOOL(DAVE2D));
	zassert_true(CAP_IS_BOOL(CRYPTOCELL));
	zassert_true(CAP_IS_BOOL(INLINE_AES));
	zassert_true(CAP_IS_BOOL(CAU));
	zassert_true(CAP_IS_BOOL(DMA2D));
}
```
