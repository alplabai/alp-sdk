## CMakeLists.txt
```
# SPDX-License-Identifier: Apache-2.0
cmake_minimum_required(VERSION 3.20.0)
find_package(Zephyr REQUIRED HINTS $ENV{ZEPHYR_BASE})
project(test_audio_in_close_cancel)
target_sources(app PRIVATE
    src/fake_dmic.c
    src/test_audio_in_close_cancel.c)
```

## prj.conf
```kconfig
CONFIG_ZTEST=y
CONFIG_ALP_SDK=y
CONFIG_ALP_SOC_ALIF_ENSEMBLE_E7=y
CONFIG_AUDIO=y
CONFIG_AUDIO_DMIC=y
CONFIG_HEAP_MEM_POOL_SIZE=4096
```

## boards/native_sim_native_64.overlay
```dts
/*
 * Copyright 2026 Alp Lab AB
 * SPDX-License-Identifier: Apache-2.0
 *
 * native_sim ships no DMIC emulation, so this overlay instantiates the
 * test-local alp,test-dmic fake controller (../dts/bindings/
 * alp,test-dmic.yaml, ../src/fake_dmic.c) and aliases alp-pdm0 to it --
 * the alias src/backends/audio/zephyr_drv.c resolves via
 * DT_ALIAS(alp_pdm0) in z_in_open(). Lets this test drive the real
 * zephyr_drv read path instead of sw_fallback.c, which never calls
 * dmic_read() at all.
 */
/ {
	aliases {
		alp-pdm0 = &test_dmic0;
	};

	test_dmic0: dmic {
		compatible = "alp,test-dmic";
		status = "okay";
	};
};
```

## dts/bindings/alp,test-dmic.yaml
```yaml
# Copyright 2026 Alp Lab AB
# SPDX-License-Identifier: Apache-2.0
#
# Fake DMIC controller used only by the audio_in_close_cancel ztest.
# native_sim ships no DMIC emulation, so this test supplies its own minimal
# `struct device` behind the standard Zephyr dmic_* driver API -- enough
# for src/backends/audio/zephyr_drv.c's z_in_open()/z_in_read() to run for
# real instead of falling back to sw_fallback.c.

description: |
  Fake DMIC controller for the alp-sdk audio_in_close_cancel unit test.
  configure() and trigger() always succeed; read() sleeps for its timeout
  and returns -EAGAIN (nothing queued).

compatible: "alp,test-dmic"

include: base.yaml
```

## src/fake_dmic.c
```c
/*
 * Copyright 2026 Alp Lab AB
 * SPDX-License-Identifier: Apache-2.0
 *
 * Fake DMIC controller backing the alp,test-dmic DT node (see
 * ../dts/bindings/alp,test-dmic.yaml and ../boards/native_sim*.overlay).
 * The only job here is to give src/backends/audio/zephyr_drv.c's z_in_open()
 * a device that resolves and configures cleanly, so this test drives the
 * real backend's read path instead of sw_fallback.c (which never calls
 * dmic_read()).
 *
 * configure() / trigger() always succeed.  read() models a driver with no
 * data queued: it sleeps for the requested timeout (a real driver parks in
 * k_msgq_get(timeout)) and returns -EAGAIN, which is what lets the test
 * hold alp_audio_in_read() blocked in the real zephyr_drv.c backend.
 */

#define DT_DRV_COMPAT alp_test_dmic

#include <errno.h>

#include <zephyr/audio/dmic.h>
#include <zephyr/device.h>
#include <zephyr/kernel.h>

static int fake_dmic_configure(const struct device *dev, struct dmic_cfg *config)
{
	ARG_UNUSED(dev);
	ARG_UNUSED(config);
	return 0;
}

static int fake_dmic_trigger(const struct device *dev, enum dmic_trigger cmd)
{
	ARG_UNUSED(dev);
	ARG_UNUSED(cmd);
	return 0;
}

static int fake_dmic_read(const struct device *dev,
                          uint8_t              stream,
                          void               **buffer,
                          size_t              *size,
                          int32_t              timeout)
{
	ARG_UNUSED(dev);
	ARG_UNUSED(stream);
	ARG_UNUSED(buffer);
	ARG_UNUSED(size);
	if (timeout > 0) {
		k_msleep(timeout);
	}
	return -EAGAIN;
}

#ifdef _dmic_ops
static DEVICE_API(dmic, fake_dmic_api) = {
	.configure = fake_dmic_configure,
	.trigger   = fake_dmic_trigger,
	.read      = fake_dmic_read,
};
#else
static const struct _dmic_ops fake_dmic_api = {
	.configure = fake_dmic_configure,
	.trigger   = fake_dmic_trigger,
	.read      = fake_dmic_read,
};
#endif

static int fake_dmic_init(const struct device *dev)
{
	ARG_UNUSED(dev);
	return 0;
}

#define FAKE_DMIC_INIT(n) \
	DEVICE_DT_INST_DEFINE(n, \
	                      fake_dmic_init, \
	                      NULL, \
	                      NULL, \
	                      NULL, \
	                      POST_KERNEL, \
	                      CONFIG_AUDIO_DMIC_INIT_PRIORITY, \
	                      &fake_dmic_api);

DT_INST_FOREACH_STATUS_OKAY(FAKE_DMIC_INIT)
```

## src/test_audio_in_close_cancel.c
```c
/*
 * Copyright 2026 Alp Lab AB
 * SPDX-License-Identifier: Apache-2.0
 *
 * The real Zephyr audio backend (src/backends/audio/zephyr_drv.c): an
 * alp_audio_in_read() blocked in dmic_read() must be woken by a concurrent
 * alp_audio_in_close() with ALP_ERR_NOT_READY (issue #2977 item 3).
 * dmic_read() has no cancel API, so the backend waits in short slices and
 * re-checks the handle's closing flag (src/common/alp_sliced_wait.h); the
 * fake DMIC (src/fake_dmic.c) honours each slice's timeout and never
 * delivers data.
 *
 * Before the fix the read below (UINT32_MAX = wait forever) never returned
 * and alp_audio_in_close() waited for it forever, so the close runs in its
 * own thread and the test joins it with a bound.
 */
#include <zephyr/kernel.h>
#include <zephyr/ztest.h>

#include <alp/audio.h>

#define STACK_SZ 2048
static K_THREAD_STACK_DEFINE(waiter_stack, STACK_SZ);
static K_THREAD_STACK_DEFINE(closer_stack, STACK_SZ);
static struct k_thread waiter_thr, closer_thr;

static alp_status_t g_read_rc;

static void waiter(void *in, void *timeout, void *p3)
{
	ARG_UNUSED(p3);
	int16_t b[64];
	size_t  got = 0;
	g_read_rc   = alp_audio_in_read(in, b, ARRAY_SIZE(b), &got, (uint32_t)(uintptr_t)timeout);
}

static void closer(void *in, void *p2, void *p3)
{
	ARG_UNUSED(p2);
	ARG_UNUSED(p3);
	alp_audio_in_close(in);
}

static void close_wakes_read(uint32_t timeout_ms)
{
	alp_audio_config_t cfg = ALP_AUDIO_CONFIG_DEFAULT(0);
	alp_audio_in_t    *in  = alp_audio_in_open(&cfg);
	zassert_not_null(in, "open must resolve the fake alp-pdm0 device");

	g_read_rc = ALP_ERR_BUSY; /* sentinel */
	k_thread_create(&waiter_thr,
	                waiter_stack,
	                STACK_SZ,
	                waiter,
	                in,
	                (void *)(uintptr_t)timeout_ms,
	                NULL,
	                K_PRIO_PREEMPT(1),
	                0,
	                K_NO_WAIT);
	k_msleep(100); /* let it block in dmic_read() */
	k_thread_create(&closer_thr,
	                closer_stack,
	                STACK_SZ,
	                closer,
	                in,
	                NULL,
	                NULL,
	                K_PRIO_PREEMPT(1),
	                0,
	                K_NO_WAIT);

	int64_t t0 = k_uptime_get();
	zassert_equal(k_thread_join(&closer_thr, K_SECONDS(2)), 0, "close() hung on a blocked read");
	zassert_equal(k_thread_join(&waiter_thr, K_SECONDS(2)), 0, "blocked read was not woken");
	zassert_true(k_uptime_get() - t0 < 500, "wake took longer than a couple of slices");
	zassert_equal(g_read_rc, ALP_ERR_NOT_READY);
}

ZTEST(alp_audio_in_close_cancel, test_close_wakes_forever_read)
{
	close_wakes_read(UINT32_MAX);
}

ZTEST(alp_audio_in_close_cancel, test_close_wakes_long_timeout_read)
{
	close_wakes_read(30000u);
}

ZTEST(alp_audio_in_close_cancel, test_timeout_still_reported)
{
	alp_audio_config_t cfg = ALP_AUDIO_CONFIG_DEFAULT(0);
	alp_audio_in_t    *in  = alp_audio_in_open(&cfg);
	zassert_not_null(in);
	int16_t b[64];
	size_t  got = 0;

	int64_t t0 = k_uptime_get();
	zassert_equal(alp_audio_in_read(in, b, ARRAY_SIZE(b), &got, 120), ALP_ERR_TIMEOUT);
	int64_t dt = k_uptime_get() - t0;
	zassert_true(dt >= 120 && dt < 400, "timeout %d ms off the requested 120", (int)dt);

	/* timeout_ms=0 stays a single non-blocking attempt. */
	zassert_equal(alp_audio_in_read(in, b, ARRAY_SIZE(b), &got, 0), ALP_ERR_TIMEOUT);
	alp_audio_in_close(in);
}

ZTEST_SUITE(alp_audio_in_close_cancel, NULL, NULL, NULL, NULL, NULL);
```
