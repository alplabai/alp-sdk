## CMakeLists.txt
```
# SPDX-License-Identifier: Apache-2.0
cmake_minimum_required(VERSION 3.20.0)
find_package(Zephyr REQUIRED HINTS $ENV{ZEPHYR_BASE})
project(test_gpio_cc3501e_unrouted)
target_sources(app PRIVATE src/test_gpio_cc3501e_unrouted.c)
```

## prj.conf
```kconfig
CONFIG_ZTEST=y
CONFIG_ALP_SDK=y
CONFIG_ALP_SDK_CONSOLE=n
CONFIG_ALP_SOC_ALIF_ENSEMBLE_E7=y
CONFIG_SPI=y
CONFIG_GPIO=y
CONFIG_ALP_SDK_CHIP_CC3501E=y
CONFIG_ALP_SDK_GPIO_CC3501E_PROXY=y

# Required for this suite's strong overrides of the WEAK
# cc3501e_gpio_unrouted[]/cc3501e_gpio_routes[] arrays to actually take
# effect: at CONFIG_SIZE_OPTIMIZATIONS (-Os, the default), GCC constant-
# folds a `const` weak array's OWN in-TU initializer into every read
# inside that same TU (cc3501e_proxy.c) before the linker ever resolves
# which definition wins -- so px_open() saw route_count/unrouted_count
# hard-folded to the WEAK default's 0, not this suite's override, and
# is_unrouted() disappeared entirely. Verified: this test's
# test_unrouted_pin_refused_nosupport case genuinely fails without this
# line (proving the fold, not a logic bug -- issue #1854 known-bad
# validation). Pre-existing in the codebase's only other user of this
# weak-array-override pattern (cc3501e_gpio_routes[]); out of this
# issue's scope to redesign.
CONFIG_NO_OPTIMIZATIONS=y
```

## boards/native_sim_native_64.overlay
```dts
/*
 * Copyright 2026 Alp Lab AB
 * SPDX-License-Identifier: Apache-2.0
 *
 * Host-emulated alp,pin-array for gpio_cc3501e_unrouted under native_sim, so
 * the platform-delegate path (alp_z_gpio_open_owned) has a real DT node to
 * resolve against.  That matters for the test's "before" premise (issue
 * #1854's known-bad validation): without this node, delegating a pin_id on
 * bare native_sim returns ALP_ERR_INVAL (no alp,pin-array at all), which
 * would make a pre-fix build's alp_gpio_open(IO21) fail for the WRONG
 * reason and mask whether the new unrouted check is what's firing.  With a
 * real 22-entry array (covering ALP_E1M_GPIO_IO0..IO21), the pre-fix open
 * genuinely succeeds (ALP_OK) and the post-fix open is refused with
 * ALP_ERR_NOSUPPORT before delegation is even attempted.
 */

#include <zephyr/dt-bindings/gpio/gpio.h>

/ {
	gpio_emul0: gpio_emul0 {
		compatible = "zephyr,gpio-emul";
		status = "okay";
		gpio-controller;
		rising-edge;
		falling-edge;
		#gpio-cells = <2>;
		ngpios = <22>;
	};

	alp_pins: alp-pins {
		compatible = "alp,pin-array";
		gpios = <&gpio_emul0 0 GPIO_ACTIVE_HIGH>,
			<&gpio_emul0 1 GPIO_ACTIVE_HIGH>,
			<&gpio_emul0 2 GPIO_ACTIVE_HIGH>,
			<&gpio_emul0 3 GPIO_ACTIVE_HIGH>,
			<&gpio_emul0 4 GPIO_ACTIVE_HIGH>,
			<&gpio_emul0 5 GPIO_ACTIVE_HIGH>,
			<&gpio_emul0 6 GPIO_ACTIVE_HIGH>,
			<&gpio_emul0 7 GPIO_ACTIVE_HIGH>,
			<&gpio_emul0 8 GPIO_ACTIVE_HIGH>,
			<&gpio_emul0 9 GPIO_ACTIVE_HIGH>,
			<&gpio_emul0 10 GPIO_ACTIVE_HIGH>,
			<&gpio_emul0 11 GPIO_ACTIVE_HIGH>,
			<&gpio_emul0 12 GPIO_ACTIVE_HIGH>,
			<&gpio_emul0 13 GPIO_ACTIVE_HIGH>,
			<&gpio_emul0 14 GPIO_ACTIVE_HIGH>,
			<&gpio_emul0 15 GPIO_ACTIVE_HIGH>,
			<&gpio_emul0 16 GPIO_ACTIVE_HIGH>,
			<&gpio_emul0 17 GPIO_ACTIVE_HIGH>,
			<&gpio_emul0 18 GPIO_ACTIVE_HIGH>,
			<&gpio_emul0 19 GPIO_ACTIVE_HIGH>,
			<&gpio_emul0 20 GPIO_ACTIVE_HIGH>,
			<&gpio_emul0 21 GPIO_ACTIVE_HIGH>;
	};
};
```

## src/test_gpio_cc3501e_unrouted.c
```c
/* SPDX-License-Identifier: Apache-2.0
 *
 * Regression test for issue #1854: an E1M pad the SoM preset marks
 * `dispatch: unrouted` (physically open on this hardware revision --
 * reaches neither the CC3501E mediator nor the Alif SoC) must refuse
 * alp_gpio_open() with ALP_ERR_NOSUPPORT instead of silently delegating
 * to the platform GPIO driver and opening a pin that goes nowhere.
 *
 * Strong override of the WEAK cc3501e_gpio_unrouted[] /
 * cc3501e_gpio_unrouted_count in src/backends/gpio/cc3501e_proxy.c --
 * mirrors AEN r2's real IO21 fact (metadata/e1m_modules/E1M-AEN801.yaml
 * pad_routes: `{ e1m: E1M_GPIO_IO21, dispatch: unrouted }`).
 *
 * boards/native_sim*.overlay provides a real alp,pin-array node so the
 * platform-delegate path can genuinely succeed -- without it, native_sim's
 * missing DT node would make delegation fail with ALP_ERR_INVAL regardless
 * of this fix, masking whether the new check is what actually refused the
 * open (known-bad-validation trap for issue #1854).
 *
 * Backends visible on this test build:
 *   cc3501e_proxy (priority 200, "*" wildcard -- wins the selector)
 *   zephyr_drv     (priority 100, "*" wildcard, reached via delegation)
 */

#include <stddef.h>
#include <stdint.h>
#include <string.h>

#include <zephyr/ztest.h>

#include <alp/backend.h>
#include <alp/chips/cc3501e.h>
#include <alp/e1m_pinout.h>
#include <alp/peripheral.h>
#include <alp/soc_caps.h>

ZTEST_SUITE(alp_gpio_cc3501e_unrouted, NULL, NULL, NULL, NULL, NULL);

/* Board-provided unrouted list (this test build's SoM pad map): IO21 is
 * open on AEN r2.  cc3501e_gpio_routes[] stays the WEAK empty default, so
 * every OTHER pin_id falls through to the platform delegate unchanged. */
const uint32_t cc3501e_gpio_unrouted[]     = { ALP_E1M_GPIO_IO21 };
const size_t   cc3501e_gpio_unrouted_count = 1u;

ZTEST(alp_gpio_cc3501e_unrouted, test_selector_picks_cc3501e_proxy)
{
	/* The proxy (priority 200) must be the single backend every
     * alp_gpio_open() call on this target funnels through -- otherwise
     * the check below wouldn't be exercising the shared chokepoint. */
	const alp_backend_t *be = alp_backend_select("gpio", ALP_SOC_REF_STR);
	zassert_not_null(be);
	zassert_equal(strcmp(be->vendor, "ti-cc3501e"), 0);
	zassert_equal(be->priority, 200);
}

ZTEST(alp_gpio_cc3501e_unrouted, test_unrouted_pin_refused_nosupport)
{
	alp_gpio_t *h = alp_gpio_open(ALP_E1M_GPIO_IO21);
	zassert_is_null(h);
	zassert_equal(alp_last_error(), ALP_ERR_NOSUPPORT);
}

ZTEST(alp_gpio_cc3501e_unrouted, test_pin_not_in_unrouted_list_still_opens)
{
	/* IO20 is not in cc3501e_gpio_unrouted[] above, so it must fall
     * through to the platform delegate exactly as before this fix --
     * proving the new check doesn't shadow an ordinary pin. */
	alp_gpio_t *h = alp_gpio_open(ALP_E1M_GPIO_IO20);
	zassert_not_null(h);
	alp_gpio_close(h);
}
```
