## CMakeLists.txt
```
# SPDX-License-Identifier: Apache-2.0
cmake_minimum_required(VERSION 3.20.0)
find_package(Zephyr REQUIRED HINTS $ENV{ZEPHYR_BASE})
project(test_camera_zephyr_video_formats)
target_sources(app PRIVATE src/test_camera_zephyr_video_formats.c)
```

## prj.conf
```kconfig
CONFIG_ZTEST=y
CONFIG_ALP_SDK=y
CONFIG_ALP_SOC_ALIF_ENSEMBLE_E7=y
CONFIG_VIDEO=y
CONFIG_ALP_SDK_CAMERA_ZEPHYR_VIDEO=y
```

## src/test_camera_zephyr_video_formats.c
```c
/* SPDX-License-Identifier: Apache-2.0
 *
 * #2924: the zephyr_video camera backend must REFUSE a pixel format it cannot
 * negotiate with ALP_ERR_NOSUPPORT (include/alp/camera.h) instead of keeping the
 * sensor's default layout and returning ALP_OK. The format check runs before the
 * devicetree lookup, so no camera node is needed on this build.
 */
#include <zephyr/ztest.h>

#include <alp/camera.h>
#include <alp/peripheral.h>

ZTEST_SUITE(camera_zephyr_video_formats, NULL, NULL, NULL, NULL, NULL);

static void expect_nosupport(alp_pixfmt_t fmt)
{
	alp_camera_config_t cfg = {
		.camera_id = 0,
		.width     = 640,
		.height    = 480,
		.fps       = 30,
		.format    = fmt,
	};

	zassert_is_null(alp_camera_open(&cfg), "format %d must not open", (int)fmt);
	zassert_equal(alp_last_error(),
	              ALP_ERR_NOSUPPORT,
	              "format %d: want NOSUPPORT, got %d",
	              (int)fmt,
	              (int)alp_last_error());
}

ZTEST(camera_zephyr_video_formats, test_mono_vlsb_refused)
{
	expect_nosupport(ALP_PIXFMT_MONO_VLSB);
}

ZTEST(camera_zephyr_video_formats, test_yuv420_planar_refused)
{
	expect_nosupport(ALP_PIXFMT_YUV420_PLANAR);
}

ZTEST(camera_zephyr_video_formats, test_nv12_refused)
{
	expect_nosupport(ALP_PIXFMT_NV12);
}
```
