## CMakeLists.txt
```
# SPDX-License-Identifier: Apache-2.0
cmake_minimum_required(VERSION 3.20.0)
find_package(Zephyr REQUIRED HINTS $ENV{ZEPHYR_BASE})
project(test_i2s_dw_underrun)
# alp-sdk issue #2149 (round 2 review finding 4): native_sim ships no
# <pinctrl_soc.h>, which <zephyr/drivers/pinctrl.h> -- pulled in
# unconditionally by i2s_dw.c -- requires; include/pinctrl_soc.h is a
# minimal test-local stub, see its own header comment.
target_include_directories(app PRIVATE include)
target_sources(app PRIVATE
    src/test_i2s_dw_underrun.c)
```

## prj.conf
```kconfig
# SPDX-License-Identifier: Apache-2.0
#
# alp-sdk issue #2149 (round 2 review finding 4): this test #includes
# zephyr/drivers/i2s/i2s_dw.c directly (see src/test_i2s_dw_underrun.c) to
# compile and exercise the real ISR/clock-keep-alive logic under test,
# instead of a fake device that only models the Zephyr I2S trigger
# contract. It does not go through CONFIG_I2S_DW (which depends on
# DT_HAS_SNPS_DESIGNWARE_I2S_ENABLED -- deliberately absent here, so
# DT_INST_FOREACH_STATUS_OKAY(I2S_DW_INIT) at the bottom of i2s_dw.c
# expands to nothing) or any alp-sdk backend, so this needs neither
# CONFIG_ALP_SDK nor a pinned SoC ref, unlike tests/unit/i2s_start_defer.
# CONFIG_PM_DEVICE is needed to compile and call i2s_suspend()/i2s_resume(),
# which the real driver only compiles under #if defined(CONFIG_PM_DEVICE).
CONFIG_ZTEST=y
CONFIG_I2S=y
CONFIG_PM=y
CONFIG_PM_DEVICE=y
```

## include/pinctrl_soc.h
```c
/* SPDX-License-Identifier: Apache-2.0 */
/*
 * alp-sdk issue #2149 (round 2 review finding 4): native_sim ships no
 * <pinctrl_soc.h> (that only exists for boards that actually enable
 * CONFIG_PINCTRL, e.g. nrf_bsim) -- but <zephyr/drivers/pinctrl.h>
 * #includes it UNCONDITIONALLY, with no CONFIG_PINCTRL guard, and
 * zephyr/drivers/i2s/i2s_dw.c #includes <zephyr/drivers/pinctrl.h>
 * unconditionally too. This test never calls any PINCTRL_DT_*() macro
 * (they only appear inside the I2S_DW_INIT() device-instantiation macro,
 * which this test's zero DT instances never expand), so all this stub
 * needs to satisfy is pinctrl.h's own reference to `pinctrl_soc_pin_t`.
 */
#ifndef PINCTRL_SOC_H_
#define PINCTRL_SOC_H_

typedef int pinctrl_soc_pin_t;

#endif /* PINCTRL_SOC_H_ */
```
