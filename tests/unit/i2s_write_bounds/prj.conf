## CMakeLists.txt
```
# SPDX-License-Identifier: Apache-2.0
cmake_minimum_required(VERSION 3.20.0)
find_package(Zephyr REQUIRED HINTS $ENV{ZEPHYR_BASE})
project(test_i2s_write_bounds)
target_sources(app PRIVATE
    src/fake_i2s.c
    src/test_i2s_write_bounds.c)
```

## prj.conf
```kconfig
CONFIG_ZTEST=y
CONFIG_ALP_SDK=y
CONFIG_ALP_SOC_ALIF_ENSEMBLE_E7=y
CONFIG_I2S=y
CONFIG_HEAP_MEM_POOL_SIZE=4096
```

## boards/native_sim_native_64.overlay
```dts
/*
 * Copyright 2026 Alp Lab AB
 * SPDX-License-Identifier: Apache-2.0
 *
 * native_sim ships no built-in I2S emulation (unlike CAN's
 * can_loopback0), so this overlay instantiates the test-local
 * alp,test-i2s fake controller (../dts/bindings/alp,test-i2s.yaml,
 * ../src/fake_i2s.c) and aliases alp-i2s0 to it -- the alias
 * src/backends/i2s/zephyr_drv.c resolves via DT_ALIAS(alp_i2s0) in
 * z_open().  Lets this test drive the real zephyr_drv write path
 * instead of a NULL device (#1619's original ztest always skipped
 * for exactly this reason).
 */
/ {
	aliases {
		alp-i2s0 = &test_i2s0;
	};

	test_i2s0: i2s {
		compatible = "alp,test-i2s";
		status = "okay";
		#address-cells = <1>;
		#size-cells = <0>;
	};
};
```

## dts/bindings/alp,test-i2s.yaml
```yaml
# Copyright 2026 Alp Lab AB
# SPDX-License-Identifier: Apache-2.0
#
# Fake I2S controller used only by the i2s_write_bounds ztest.  native_sim
# ships no built-in I2S emulation (unlike CAN's can_loopback0), so this test
# supplies its own minimal `struct device` behind the standard Zephyr i2s_*
# driver API -- enough for src/backends/i2s/zephyr_drv.c's z_open() /
# z_write() to run for real instead of falling back to a NULL device.

description: |
  Fake I2S controller for the alp-sdk i2s_write_bounds unit test.
  configure() and trigger() always succeed; write() accepts any block
  (the alp-sdk oversize guard under test runs before this driver ever
  sees a write); read() is unsupported.

compatible: "alp,test-i2s"

include: i2s-controller.yaml
```

## src/fake_i2s.c
```c
/*
 * Copyright 2026 Alp Lab AB
 * SPDX-License-Identifier: Apache-2.0
 *
 * Fake I2S controller backing the alp,test-i2s DT node (see
 * ../dts/bindings/alp,test-i2s.yaml and ../boards/native_sim.overlay).
 * The only job here is to give src/backends/i2s/zephyr_drv.c's z_open()
 * a device that resolves and configures cleanly, so the write-bounds
 * ztest exercises the real backend instead of tripping ALP_ERR_NOT_READY
 * on a NULL device (which is what happens on plain native_sim, and is
 * why the original #1619 regression test always skipped).
 *
 * configure() / trigger() always succeed.  write() accepts any block --
 * the alp-sdk guard under test (zephyr_drv.c:221) runs before a write
 * ever reaches this driver, so there is nothing left for the fake to
 * reject.  read() is unsupported; this test only exercises the TX path.
 */

#define DT_DRV_COMPAT alp_test_i2s

#include <errno.h>

#include <zephyr/device.h>
#include <zephyr/drivers/i2s.h>

static int
fake_i2s_configure(const struct device *dev, enum i2s_dir dir, const struct i2s_config *cfg)
{
	ARG_UNUSED(dev);
	ARG_UNUSED(dir);
	ARG_UNUSED(cfg);
	return 0;
}

static const struct i2s_config *fake_i2s_config_get(const struct device *dev, enum i2s_dir dir)
{
	ARG_UNUSED(dev);
	ARG_UNUSED(dir);
	return NULL;
}

static int fake_i2s_trigger(const struct device *dev, enum i2s_dir dir, enum i2s_trigger_cmd cmd)
{
	ARG_UNUSED(dev);
	ARG_UNUSED(dir);
	ARG_UNUSED(cmd);
	return 0;
}

static int fake_i2s_read(const struct device *dev, void **mem_block, size_t *size)
{
	ARG_UNUSED(dev);
	ARG_UNUSED(mem_block);
	ARG_UNUSED(size);
	return -ENOTSUP;
}

static int fake_i2s_write(const struct device *dev, void *mem_block, size_t size)
{
	/* The alp-sdk backend under test owns the slab and its bounds
	 * check; this fake never inspects mem_block/size, it only proves
	 * the write reached the real zephyr_drv path. */
	ARG_UNUSED(dev);
	ARG_UNUSED(mem_block);
	ARG_UNUSED(size);
	return 0;
}

static DEVICE_API(i2s, fake_i2s_driver_api) = {
	.configure  = fake_i2s_configure,
	.config_get = fake_i2s_config_get,
	.trigger    = fake_i2s_trigger,
	.read       = fake_i2s_read,
	.write      = fake_i2s_write,
};

static int fake_i2s_init(const struct device *dev)
{
	ARG_UNUSED(dev);
	return 0;
}

#define FAKE_I2S_INIT(n) \
	DEVICE_DT_INST_DEFINE(n, \
	                      fake_i2s_init, \
	                      NULL, \
	                      NULL, \
	                      NULL, \
	                      POST_KERNEL, \
	                      CONFIG_I2S_INIT_PRIORITY, \
	                      &fake_i2s_driver_api);

DT_INST_FOREACH_STATUS_OKAY(FAKE_I2S_INIT)
```

## src/test_i2s_write_bounds.c
```c
/* SPDX-License-Identifier: Apache-2.0
 *
 * Regression test for issue #1619: src/backends/i2s/zephyr_drv.c's
 * z_write() must refuse a caller-supplied length larger than the slab
 * block negotiated at open(), and it must do so BEFORE the memcpy that
 * used to corrupt the neighbouring slab block and the k_malloc heap
 * behind it.
 *
 * The original regression test (tests/zephyr/peripheral/src/i2s.c,
 * removed alongside this file) always reported `skipped` on
 * native_sim: alp_i2s_open() resolves its device via
 * DT_ALIAS(alp_i2s0), native_sim ships no I2S device, so the Zephyr
 * backend bailed with ALP_ERR_NOT_READY on a NULL device before ever
 * reaching z_write() -- a skip proves nothing about the fix.
 *
 * This test supplies its own fake I2S controller (src/fake_i2s.c,
 * bound via ../dts/bindings/alp,test-i2s.yaml and the boards
 * overlays) so
 * alp_i2s_open() resolves a real device, i2s_configure() succeeds, and
 * alp_i2s_write() genuinely runs through zephyr_drv.c's z_write() --
 * not src/backends/i2s/sw_fallback.c, which would reject every write
 * with ALP_ERR_NOSUPPORT regardless of length and prove nothing about
 * the bound either.  zephyr_drv (priority 100) always wins backend
 * selection over sw_fallback (priority 0) once a real device is
 * present, so an exact-size write reaching ALP_OK (not NOSUPPORT)
 * confirms this test exercised the fixed code path.
 */

#include <stdint.h>
#include <string.h>

#include <zephyr/ztest.h>

#include <alp/i2s.h>

ZTEST_SUITE(alp_i2s_write_bounds, NULL, NULL, NULL, NULL, NULL);

/* block_frames=256 * channels=2 * (word_bits=16 / 8) = 1024 bytes --
 * matches the config open()s below and the arithmetic in
 * src/backends/i2s/zephyr_drv.c:161. */
#define BLOCK_BYTES 1024u

static alp_i2s_t *open_i2s(void)
{
	alp_i2s_config_t cfg = {
		.bus_id         = 0u,
		.sample_rate_hz = 48000u,
		.word_bits      = 16u,
		.channels       = 2u,
		.format         = ALP_I2S_FMT_I2S,
		.direction      = ALP_I2S_DIR_TX,
		.block_frames   = 256u,
	};
	alp_i2s_t *h = alp_i2s_open(&cfg);
	/* A NULL handle here means the test regressed back to opening
	 * against a NULL device (the original skip) -- fail loudly
	 * instead of silently skipping. */
	zassert_not_null(h, "alp_i2s_open() must succeed against the fake alp-i2s0 device");
	return h;
}

ZTEST(alp_i2s_write_bounds, test_write_rejects_oversize_block)
{
	alp_i2s_t *h = open_i2s();

	static uint8_t oversize[2u * BLOCK_BYTES];
	memset(oversize, 0xAA, sizeof(oversize));

	/* Larger than the negotiated 1024-byte block: must be refused
	 * before the memcpy that used to corrupt the neighbouring slab
	 * block (#1619). */
	zassert_equal(alp_i2s_write(h, oversize, sizeof(oversize), 100u), ALP_ERR_OUT_OF_RANGE);

	alp_i2s_close(h);
}

ZTEST(alp_i2s_write_bounds, test_write_exact_block_reaches_zephyr_backend)
{
	alp_i2s_t *h = open_i2s();

	static uint8_t exact[BLOCK_BYTES];
	memset(exact, 0x55, sizeof(exact));

	alp_status_t rc = alp_i2s_write(h, exact, sizeof(exact), 100u);

	/* Must not be rejected as oversize ... */
	zassert_not_equal(rc, ALP_ERR_OUT_OF_RANGE);
	/* ... and must not be sw_fallback's blanket NOSUPPORT, which would
	 * mean this test never reached zephyr_drv's z_write() at all. */
	zassert_not_equal(rc, ALP_ERR_NOSUPPORT);
	zassert_equal(rc, ALP_OK);

	alp_i2s_close(h);
}
```
