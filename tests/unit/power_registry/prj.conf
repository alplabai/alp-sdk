## CMakeLists.txt
```
# SPDX-License-Identifier: Apache-2.0
cmake_minimum_required(VERSION 3.20.0)
find_package(Zephyr REQUIRED HINTS $ENV{ZEPHYR_BASE})
project(test_power_registry)
target_sources(app PRIVATE src/test_power_registry.c)
```

## prj.conf
```kconfig
CONFIG_ZTEST=y
CONFIG_ALP_SDK=y
CONFIG_ALP_SOC_ALIF_ENSEMBLE_E7=y

# Pulls in Zephyr's power-management subsystem so
# pm_policy_state_lock_get / pm_policy_state_lock_put + enum pm_state
# resolve at link time and the real ALP power backend
# (src/backends/power/zephyr_pm_policy.c) compiles in.
CONFIG_PM=y
CONFIG_ALP_SDK_POWER_PM_POLICY=y

# Compile the Renesas vendor-extension body so the dispatcher /
# vendor-check path is exercised end-to-end.  The body references
# gd32g553_power_mode_set (from the chip driver) + the V2N
# supervisor singleton's acquire / release helpers; pulling in
# the chip driver + supervisor lets the body link cleanly even
# though the active SoC is alif (the body's vendor-check gate
# returns NOT_PRESENT_ON_THIS_SOC well before reaching the
# supervisor on this build).
CONFIG_ALP_SDK_CHIP_GD32G553=y
CONFIG_ALP_SDK_V2N_SUPERVISOR=y
CONFIG_ALP_SDK_POWER_EXT_RENESAS=y

# Subsystems the GD32G553 chip driver depends on via
# <alp/peripheral.h>.
CONFIG_GPIO=y
CONFIG_I2C=y
CONFIG_SPI=y
```

## src/test_power_registry.c
```c
/* SPDX-License-Identifier: Apache-2.0
 *
 * Unit tests for the Power registry dispatcher.  Mirrors the
 * Slice 5 camera_registry / Slice 4a rtc_registry harnesses.
 *
 * Backends visible on this test build (the prj.conf compiles in
 * the real Zephyr pm_policy backend on top of the wildcard stub):
 *   zephyr_pm_policy (priority 100, "*" wildcard, vendor "zephyr")
 *   zephyr_stub      (priority   0, "*" wildcard, vendor "stub"  )
 *
 * The pm_policy backend wins selection for every silicon_ref since
 * both are wildcards and 100 > 0.  The Renesas vendor-ext body
 * (src/backends/ext/renesas/power.c) IS linked in this build
 * (CONFIG_ALP_SDK_POWER_EXT_RENESAS=y in prj.conf) so the
 * vendor-check gate runs against the *real* body -- not just the
 * header.  The body's NOT_PRESENT_ON_THIS_SOC gate fires ahead of
 * any GD32 supervisor traffic because the active backend on this
 * build is vendor "zephyr", not "renesas".
 *
 * The test build pins CONFIG_ALP_SOC_ALIF_ENSEMBLE_E7=y so the
 * dispatcher's `alp_backend_select("power", ALP_SOC_REF_STR)`
 * exercises the same selector code path real customer builds hit.
 */

#include <stdbool.h>
#include <stddef.h>
#include <stdint.h>
#include <string.h>

#include <zephyr/ztest.h>

#include <alp/backend.h>
#include <alp/cap_instance.h>
#include <alp/ext/renesas/power.h>
#include <alp/peripheral.h>
#include <alp/power.h>

ZTEST_SUITE(alp_power_registry, NULL, NULL, NULL, NULL, NULL);

#ifdef CONFIG_ALP_SDK_POWER_PM_POLICY
/* Test seam exported by src/backends/power/zephyr_pm_policy.c under CONFIG_ZTEST;
 * the backend (and so the seam) only exists on builds that link Zephyr PM. */
void alp_power_pm_policy_test_stop_wake_timer(void);
#endif

static void _cancel_wake_timer_cb(struct k_timer *t)
{
	(void)t;
#ifdef CONFIG_ALP_SDK_POWER_PM_POLICY
	alp_power_pm_policy_test_stop_wake_timer();
#endif
}

/* ---------- Selector / priority tests ------------------------------- */

ZTEST(alp_power_registry, test_pm_policy_picked_for_alif_e7)
{
	/* Real Zephyr pm_policy backend (priority 100) wins over the
     * wildcard stub (priority 0) on every silicon -- when the build
     * has CONFIG_PM available (the pm_policy backend's compile gate).
     * On boards without HAS_PM (e.g. native_sim) only the stub
     * registers; assert the stub-only contract instead. */
	const alp_backend_t *be = alp_backend_select("power", "alif:ensemble:e7");
	zassert_not_null(be);
	if (IS_ENABLED(CONFIG_ALP_SDK_POWER_PM_POLICY)) {
		zassert_equal(strcmp(be->vendor, "zephyr"), 0);
		zassert_equal(be->priority, 100);
	} else {
		zassert_equal(strcmp(be->vendor, "stub"), 0);
		zassert_equal(be->priority, 0);
	}
}

ZTEST(alp_power_registry, test_pm_policy_picked_for_unknown_silicon)
{
	const alp_backend_t *be = alp_backend_select("power", "fictional:soc:zz");
	zassert_not_null(be);
	if (IS_ENABLED(CONFIG_ALP_SDK_POWER_PM_POLICY)) {
		zassert_equal(strcmp(be->vendor, "zephyr"), 0);
		zassert_equal(be->priority, 100);
	} else {
		zassert_equal(strcmp(be->vendor, "stub"), 0);
		zassert_equal(be->priority, 0);
	}
}

ZTEST(alp_power_registry, test_select_returns_null_for_null_class)
{
	zassert_is_null(alp_backend_select(NULL, "alif:ensemble:e7"));
}

ZTEST(alp_power_registry, test_select_returns_null_for_null_silicon_ref)
{
	/* Regression for the NULL silicon_ref fix in src/backend.c.
     * NULL must NOT silently match the "*" wildcard. */
	zassert_is_null(alp_backend_select("power", NULL));
}

/* ---------- Public-API behaviour tests ------------------------------ */

ZTEST(alp_power_registry, test_power_open_and_close)
{
	/* The pm_policy backend's open() returns ALP_OK and a real
     * handle; close() releases the pm_policy lock-pool slot
     * cleanly.  Smoke-tests the open/close path without an actual
     * sleep (which would block native_sim indefinitely on K_FOREVER). */
	alp_power_t *h = alp_power_open();
	zassert_not_null(h);
	alp_power_close(h);
}

ZTEST(alp_power_registry, test_power_configure_wake_source)
{
	/* configure_wake_source mirrors the bitmap into the dispatcher
     * state without touching hardware on the pm_policy backend.  On a
     * build without CONFIG_ALP_SDK_POWER_PM_POLICY (e.g. native_sim,
     * which selects no HAS_PM) the wildcard zephyr_stub backend wins
     * instead; either way, per #1812/#1813 the ONLY bit either
     * backend actually reports is ALP_POWER_WAKE_TIMER -- pm_policy's
     * _wake_sem has exactly one giver (its own k_timer expiry), so
     * RTC/GPIO/UART_RX are refused there too (review caught #1812
     * reincarnated on this backend: it cannot wake on them despite an
     * earlier draft advertising them). */
	alp_power_t *h = alp_power_open();
	zassert_not_null(h);
	if (IS_ENABLED(CONFIG_ALP_SDK_POWER_PM_POLICY)) {
		zassert_equal(alp_power_configure_wake_source(h, ALP_POWER_WAKE_TIMER), ALP_OK);
		zassert_equal(alp_power_configure_wake_source(h, ALP_POWER_WAKE_RTC), ALP_ERR_NOSUPPORT);
	} else {
		zassert_equal(alp_power_configure_wake_source(h, ALP_POWER_WAKE_RTC), ALP_ERR_NOSUPPORT);
		zassert_equal(alp_power_configure_wake_source(h, ALP_POWER_WAKE_RTC | ALP_POWER_WAKE_GPIO),
		              ALP_ERR_NOSUPPORT);
	}
	/* The empty bitmap is legal at the configure call on every backend
     * -- the INVAL guard fires only at request_sleep() time. */
	zassert_equal(alp_power_configure_wake_source(h, ALP_POWER_WAKE_NONE), ALP_OK);
	alp_power_close(h);
}

ZTEST(alp_power_registry, test_power_request_sleep_inval_guards)
{
	/* Exercise the dispatcher's INVAL pre-checks against a real
     * handle:
     *   - RUN mode is rejected outright.
     *   - Invalid enum (cast from out-of-range int) likewise.
     *   - No wake source AND zero wake_after_ms is rejected too.
     * All three return BEFORE the backend's request_sleep op runs
     * (which would otherwise block on the wake semaphore). */
	alp_power_t *h = alp_power_open();
	zassert_not_null(h);

	zassert_equal(alp_power_request_sleep(h, ALP_POWER_MODE_RUN, 1000u, NULL), ALP_ERR_INVAL);
	zassert_equal(alp_power_request_sleep(h, (alp_power_mode_t)99, 1000u, NULL), ALP_ERR_INVAL);
	zassert_equal(alp_power_request_sleep(h, ALP_POWER_MODE_SLEEP, 0u, NULL), ALP_ERR_INVAL);

	alp_power_close(h);
}

ZTEST(alp_power_registry, test_power_request_sleep_with_timer_wakes)
{
	/* End-to-end exercise of the pm_policy backend's request_sleep:
     * non-zero wake_after_ms registers the k_timer wake, the call
     * parks on the semaphore, the timer fires, the locks rebalance
     * around the descent + ascent, and the call returns ALP_OK with
     * info filled.  Uses a tiny 10 ms wake so the test stays fast.
     * ALP_POWER_WAKE_TIMER, not _RTC -- this backend's only real wake
     * source is its own k_timer (#1812 review). */
	if (!IS_ENABLED(CONFIG_ALP_SDK_POWER_PM_POLICY)) {
		ztest_test_skip();
	}
	alp_power_t *h = alp_power_open();
	zassert_not_null(h);
	zassert_equal(alp_power_configure_wake_source(h, ALP_POWER_WAKE_TIMER), ALP_OK);

	alp_power_wake_info_t info = { 0 };
	alp_status_t          rc   = alp_power_request_sleep(h, ALP_POWER_MODE_SLEEP, 10u, &info);
	zassert_equal(rc, ALP_OK);
	zassert_equal(info.realised_mode, ALP_POWER_MODE_SLEEP);
	zassert_equal(info.wake_source, (uint32_t)ALP_POWER_WAKE_TIMER);
	/* slept_ms is best-effort; assert >= 0 (i.e. just non-negative
     * which is implicit in the uint32_t type) -- the exact value
     * depends on the scheduler tick + timer granularity. */

	alp_power_close(h);
}

ZTEST(alp_power_registry, test_power_request_sleep_wake_timeout_reports_timeout)
{
	/* The backend's wake timer is cancelled (from a 3 ms timer) before its 10 ms
	 * expiry, so the semaphore take times out: ALP_ERR_TIMEOUT, RUN, no wake source. */
	if (!IS_ENABLED(CONFIG_ALP_SDK_POWER_PM_POLICY)) {
		ztest_test_skip();
	}
	alp_power_t *h = alp_power_open();
	zassert_not_null(h);
	zassert_equal(alp_power_configure_wake_source(h, ALP_POWER_WAKE_TIMER), ALP_OK);

	struct k_timer canceller;
	k_timer_init(&canceller, _cancel_wake_timer_cb, NULL);
	k_timer_start(&canceller, K_MSEC(3), K_NO_WAIT);

	alp_power_wake_info_t info = { .realised_mode = ALP_POWER_MODE_SLEEP, .wake_source = 0xffu };
	alp_status_t          rc   = alp_power_request_sleep(h, ALP_POWER_MODE_SLEEP, 10u, &info);
	k_timer_stop(&canceller);
	zassert_equal(rc, ALP_ERR_TIMEOUT);
	zassert_equal(info.realised_mode, ALP_POWER_MODE_RUN);
	zassert_equal(info.wake_source, 0u);

	alp_power_close(h);
}

ZTEST(alp_power_registry, test_power_request_sleep_stop_rounds_down_to_standby)
{
	/* #1813 review: STOP rounds DOWN to the same target as STANDBY on
     * this generic backend (PM_STATE_SUSPEND_TO_RAM -- it has nothing
     * deeper), and realised_mode must report STANDBY, not STOP, so a
     * caller is never told this backend reached a depth it never
     * proved.  The yocto twin is
     * tests/yocto/peripheral_power.c::test_stop_writes_mem_and_reports_standby. */
	if (!IS_ENABLED(CONFIG_ALP_SDK_POWER_PM_POLICY)) {
		ztest_test_skip();
	}
	alp_power_t *h = alp_power_open();
	zassert_not_null(h);
	zassert_equal(alp_power_configure_wake_source(h, ALP_POWER_WAKE_TIMER), ALP_OK);

	alp_power_wake_info_t info = { 0 };
	alp_status_t          rc   = alp_power_request_sleep(h, ALP_POWER_MODE_STOP, 10u, &info);
	zassert_equal(rc, ALP_OK);
	zassert_equal(info.realised_mode, ALP_POWER_MODE_STANDBY);
	zassert_equal(info.wake_source, (uint32_t)ALP_POWER_WAKE_TIMER);

	alp_power_close(h);
}

ZTEST(alp_power_registry, test_power_request_sleep_zero_wake_after_ms_is_nosupport)
{
	/* #1812 review BLOCKER fix: this backend can never wake without
     * wake_after_ms > 0 (its only giver is its own k_timer), so
     * request_sleep refuses outright rather than parking on
     * K_FOREVER forever -- even though ALP_POWER_WAKE_TIMER is
     * configured, matching the header's advertised capability. */
	if (!IS_ENABLED(CONFIG_ALP_SDK_POWER_PM_POLICY)) {
		ztest_test_skip();
	}
	alp_power_t *h = alp_power_open();
	zassert_not_null(h);
	zassert_equal(alp_power_configure_wake_source(h, ALP_POWER_WAKE_TIMER), ALP_OK);

	alp_power_wake_info_t info = { 0 };
	alp_status_t          rc   = alp_power_request_sleep(h, ALP_POWER_MODE_SLEEP, 0u, &info);
	zassert_equal(rc, ALP_ERR_NOSUPPORT);
	zassert_equal(info.realised_mode, ALP_POWER_MODE_RUN);

	alp_power_close(h);
}

ZTEST(alp_power_registry, test_power_capabilities_returns_null_for_null_handle)
{
	zassert_is_null(alp_power_capabilities(NULL));
}

ZTEST(alp_power_registry, test_power_wake_capabilities_zero_for_null_handle)
{
	/* #1813: dedicated accessor, separate storage from
     * alp_power_capabilities()'s alp_capabilities_t::flags -- NULL
     * reports 0, matching every other NULL-handle query on this
     * class. */
	zassert_equal(alp_power_wake_capabilities(NULL), 0u);
}

ZTEST(alp_power_registry, test_power_wake_capabilities_matches_active_backend)
{
	/* On this test build (CONFIG_ALP_SDK_POWER_PM_POLICY=y, see the
     * file header) the pm_policy backend wins and reports ONLY
     * ALP_POWER_WAKE_TIMER -- its _wake_sem has exactly one giver
     * (its own k_timer), so RTC/GPIO/UART_RX are NOT armable despite
     * an earlier draft claiming them (#1812 review); the wake_caps
     * report and the configure_wake_source acceptance/rejection
     * surface must agree. */
	alp_power_t *h = alp_power_open();
	zassert_not_null(h);

	uint32_t caps = alp_power_wake_capabilities(h);
	if (IS_ENABLED(CONFIG_ALP_SDK_POWER_PM_POLICY)) {
		zassert_equal(caps, (uint32_t)ALP_POWER_WAKE_TIMER);
		zassert_equal(alp_power_configure_wake_source(h, ALP_POWER_WAKE_RTC), ALP_ERR_NOSUPPORT);
		zassert_equal(alp_power_configure_wake_source(h, ALP_POWER_WAKE_USB), ALP_ERR_NOSUPPORT);
	} else {
		zassert_equal(caps, 0u);
		zassert_equal(alp_power_configure_wake_source(h, ALP_POWER_WAKE_RTC), ALP_ERR_NOSUPPORT);
	}
	alp_power_close(h);
}

/* ---------- Vendor-ext bypass test --------------------------------- */

ZTEST(alp_power_registry, test_renesas_vendor_ext_returns_inval_on_null_handle)
{
	/* NULL-handle gate fires before any backend dispatch. */
	zassert_equal(alp_renesas_power_supervisor_mode_set(NULL, 1u), ALP_ERR_INVAL);
}

ZTEST(alp_power_registry, test_renesas_vendor_ext_rejects_non_renesas_backend)
{
	/* The active backend in this test build is the Zephyr pm_policy
     * backend (vendor "zephyr"); the vendor-ext must reject the
     * handle with NOT_PRESENT_ON_THIS_SOC BEFORE reaching for the
     * supervisor.  This is the "bypass to NOSUPPORT-but-validation-
     * passed" path the vendor-ext audit rule requires. */
	if (!IS_ENABLED(CONFIG_ALP_SDK_POWER_PM_POLICY)) {
		/* On builds without pm_policy the stub backend rejects open
         * for runtime modes, so the bypass-to-vendor-ext path can't
         * be exercised here -- skip. */
		ztest_test_skip();
	}
	alp_power_t *h = alp_power_open();
	zassert_not_null(h);

	zassert_equal(alp_renesas_power_supervisor_mode_set(h, 1u), ALP_ERR_NOT_PRESENT_ON_THIS_SOC);
	zassert_equal(alp_renesas_power_supervisor_mode_set(h, 0u), ALP_ERR_NOT_PRESENT_ON_THIS_SOC);
	/* Higher mode values are also rejected by the same gate -- the
     * gate runs before any payload validation. */
	zassert_equal(alp_renesas_power_supervisor_mode_set(h, 99u), ALP_ERR_NOT_PRESENT_ON_THIS_SOC);

	alp_power_close(h);
}

/* ---------- Registry inventory test -------------------------------- */

ZTEST(alp_power_registry, test_backend_count_for_power)
{
	/* Wildcard stub always registers; the real pm_policy backend
     * registers only when CONFIG_PM is available (gated by the
     * board's HAS_PM hidden Kconfig).  On native_sim HAS_PM is
     * absent so only stub is registered.  The Renesas vendor-ext
     * is NOT a power backend (it shadows the public alp_power_t
     * handle but doesn't register into the registry); it earns no
     * slot here. */
	const size_t expected = IS_ENABLED(CONFIG_ALP_SDK_POWER_PM_POLICY) ? 2u : 1u;
	zassert_equal(alp_backend_count("power"), expected);
}
```
