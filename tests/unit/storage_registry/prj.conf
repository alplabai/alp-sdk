## CMakeLists.txt
```
# SPDX-License-Identifier: Apache-2.0
cmake_minimum_required(VERSION 3.20.0)
find_package(Zephyr REQUIRED HINTS $ENV{ZEPHYR_BASE})
project(test_storage_registry)
target_sources(app PRIVATE src/test_storage_registry.c)
```

## prj.conf
```kconfig
CONFIG_ZTEST=y
CONFIG_ALP_SDK=y
CONFIG_ALP_SOC_ALIF_ENSEMBLE_E7=y
CONFIG_ALP_SDK_STORAGE_SW_FALLBACK=y
```

## src/test_storage_registry.c
```c
/* SPDX-License-Identifier: Apache-2.0
 *
 * Unit tests for the storage registry dispatcher.  Mirrors the
 * spi_registry / i2c_registry harnesses; covers:
 *
 *   (a) selector / priority on the alif:ensemble:e7 pin
 *   (b) sw_fallback reachability via the registry count
 *   (c) configure_inline_aes input validation runs in the dispatcher
 *       ahead of backend dispatch
 *   (d) alp_storage_capabilities(NULL) is safe
 *   (e) close releases handle; NULL inputs are idempotent
 *   (f) sw_fallback NOSUPPORT contract via direct ops-table dispatch
 *   (g) vendor-ext gating: non-Alif handle -> NOT_PRESENT_ON_THIS_SOC
 *       from the Alif SecAES surface
 *   (h) a read-only handle: write() and erase() agree
 *   (i) overflow-safe range helper for fixed-capacity backends
 *   (j) SecAES key / key_bytes validation reaches the body, and
 *       NOSUPPORT on a build with no SE transport linked (issue #224)
 *   (k) SecAES calls gate on the open/op/close lifecycle -- a
 *       closed/never-opened handle -> NOT_READY before the vendor
 *       check runs
 *
 * Backends visible on this test build:
 *   sw_fallback   (priority 0,   "*" wildcard)
 *
 * zephyr_flash / zephyr_littlefs are not linked because their
 * CONFIG_ flags require CONFIG_FLASH_MAP / CONFIG_FILE_SYSTEM_LITTLEFS
 * which native_sim doesn't ship by default.  The dispatcher and
 * vendor-ext surfaces are exercised directly via the public API +
 * the .alp_backends_storage section walk.
 */

#include <stdbool.h>
#include <stddef.h>
#include <stdint.h>
#include <string.h>

#include <zephyr/ztest.h>

#include <alp/backend.h>
#include <alp/cap_instance.h>
#include <alp/ext/alif/storage.h>
#include <alp/storage.h>

#include "../../../../src/backends/storage/storage_ops.h"
#include "../../../../src/common/alp_slot_claim.h"

ZTEST_SUITE(alp_storage_registry, NULL, NULL, NULL, NULL, NULL);

/* ---------- (a) Selector picks the sw_fallback on the test build --------- */

ZTEST(alp_storage_registry, test_selector_picks_sw_fallback_on_alif)
{
	/* Only sw_fallback is linked in this test build (no FLASH_MAP /
     * FILE_SYSTEM_LITTLEFS).  The selector must return it as the
     * only wildcard match. */
	const alp_backend_t *be = alp_backend_select("storage", "alif:ensemble:e7");
	zassert_not_null(be);
	zassert_equal(strcmp(be->vendor, "sw_fallback"), 0);
}

/* ---------- (b) sw_fallback reachability via count ----------------------- */

ZTEST(alp_storage_registry, test_storage_registry_has_at_least_one_backend)
{
	/* The dispatcher counts entries in .alp_backends_storage; the
     * sw_fallback registration must be reachable. */
	zassert_true(alp_backend_count("storage") >= 1u);
}

/* ---------- (c) configure_inline_aes input validation -------------------- */

ZTEST(alp_storage_registry, test_configure_inline_aes_rejects_bad_inputs)
{
	/* The dispatcher validates inputs ahead of the backend op, so even
     * a NULL storage handle returns INVAL when cfg is bad (the cfg
     * check fires first). */
	zassert_equal(alp_storage_configure_inline_aes(NULL, NULL), ALP_ERR_INVAL);

	/* Bad mode -> INVAL even with NULL storage. */
	alp_storage_aes_config_t bad_mode = {
		.mode      = (alp_storage_aes_mode_t)42,
		.key       = NULL,
		.key_bytes = 0u,
		.iv        = NULL,
		.iv_bytes  = 0u,
	};
	zassert_equal(alp_storage_configure_inline_aes(NULL, &bad_mode), ALP_ERR_INVAL);

	/* mode == CTR with NULL key -> INVAL even with NULL storage. */
	alp_storage_aes_config_t null_key = {
		.mode      = ALP_STORAGE_AES_CTR,
		.key       = NULL,
		.key_bytes = 16u,
		.iv        = NULL,
		.iv_bytes  = 16u,
	};
	zassert_equal(alp_storage_configure_inline_aes(NULL, &null_key), ALP_ERR_INVAL);

	/* mode == XTS with bogus key_bytes -> INVAL. */
	static const uint8_t     _stub_key[16] = { 0 };
	static const uint8_t     _stub_iv[16]  = { 0 };
	alp_storage_aes_config_t bad_kb        = {
		.mode      = ALP_STORAGE_AES_XTS,
		.key       = _stub_key,
		.key_bytes = 7u,
		.iv        = _stub_iv,
		.iv_bytes  = 16u,
	};
	zassert_equal(alp_storage_configure_inline_aes(NULL, &bad_kb), ALP_ERR_INVAL);

	/* mode == OFF skips key/iv checks but still hits NOT_READY on NULL
     * handle (validation passes; dispatcher catches the NULL after). */
	alp_storage_aes_config_t off_cfg = {
		.mode      = ALP_STORAGE_AES_OFF,
		.key       = NULL,
		.key_bytes = 0u,
		.iv        = NULL,
		.iv_bytes  = 0u,
	};
	zassert_equal(alp_storage_configure_inline_aes(NULL, &off_cfg), ALP_ERR_NOT_READY);
}

/* ---------- (d) capabilities getter NULL-safe ---------------------------- */

ZTEST(alp_storage_registry, test_capabilities_getter_null_safe)
{
	zassert_is_null(alp_storage_capabilities(NULL));
}

/* ---------- (e) close + open NULL idempotency ---------------------------- */

ZTEST(alp_storage_registry, test_close_releases_handle)
{
	/* alp_storage_open(NULL) -> NULL, no pool slot consumed. */
	alp_storage_t *h_null = alp_storage_open(NULL);
	zassert_is_null(h_null);

	/* alp_storage_close(NULL) must not crash. */
	alp_storage_close(NULL);

	/* Sync / read / write / erase / get_info on NULL handle ->
     * NOT_READY (or INVAL when their preconditions catch first). */
	zassert_equal(alp_storage_sync(NULL), ALP_ERR_NOT_READY);
	zassert_equal(alp_storage_read(NULL, 0u, NULL, 4u), ALP_ERR_NOT_READY);
	zassert_equal(alp_storage_write(NULL, 0u, NULL, 4u), ALP_ERR_NOT_READY);
	zassert_equal(alp_storage_erase(NULL, 0u, 4u), ALP_ERR_NOT_READY);
	alp_storage_info_t info_out;
	zassert_equal(alp_storage_get_info(NULL, &info_out), ALP_ERR_NOT_READY);
}

/* ---------- (f) sw_fallback NOSUPPORT contract via direct ops dispatch --- */

extern const alp_backend_t __start_alp_backends_storage[] __attribute__((weak));
extern const alp_backend_t __stop_alp_backends_storage[] __attribute__((weak));

static const alp_storage_ops_t *_find_sw_fallback_ops(void)
{
	for (const alp_backend_t *be = __start_alp_backends_storage; be < __stop_alp_backends_storage;
	     ++be) {
		if (strcmp(be->vendor, "sw_fallback") == 0) {
			return (const alp_storage_ops_t *)be->ops;
		}
	}
	return NULL;
}

ZTEST(alp_storage_registry, test_sw_fallback_nosupport_contract)
{
	const alp_storage_ops_t *ops = _find_sw_fallback_ops();
	zassert_not_null(ops);

	/* Stack-local backend state -- the sw_fallback ops don't
     * dereference dev/be_data so we don't need a full struct alp_storage. */
	alp_storage_backend_state_t st;
	memset(&st, 0, sizeof(st));
	alp_capabilities_t   caps = { 0 };
	alp_storage_config_t cfg  = {
		.kind        = ALP_STORAGE_KIND_QSPI_FLASH,
		.instance_id = 0u,
		.freq_hz     = 0u,
		.read_only   = false,
	};
	zassert_equal(ops->open(&cfg, &st, &caps), ALP_OK);

	uint8_t            buf[4] = { 0 };
	alp_storage_info_t info   = { 0 };
	zassert_equal(ops->get_info(&st, &info), ALP_ERR_NOSUPPORT);
	zassert_equal(ops->read(&st, 0u, buf, sizeof(buf)), ALP_ERR_NOSUPPORT);
	zassert_equal(ops->write(&st, 0u, buf, sizeof(buf)), ALP_ERR_NOSUPPORT);
	zassert_equal(ops->erase(&st, 0u, sizeof(buf)), ALP_ERR_NOSUPPORT);
	zassert_equal(ops->sync(&st), ALP_ERR_NOSUPPORT);

	alp_storage_aes_config_t aes = {
		.mode = ALP_STORAGE_AES_OFF,
	};
	zassert_equal(ops->configure_inline_aes(&st, &aes), ALP_ERR_NOSUPPORT);
}

/* ---------- (g) vendor-ext gating: non-vendor handle -> NOT_PRESENT_ON_THIS_SOC */

ZTEST(alp_storage_registry, test_vendor_ext_gates_non_matching_backends)
{
	/* NULL handle -> INVAL (parameter check fires first). */
	static const uint8_t key16[16] = { 0 };
	zassert_equal(alp_alif_storage_secaes_key_provision(NULL, key16, 16u), ALP_ERR_INVAL);

	uint32_t status_out = 0u;
	zassert_equal(alp_alif_storage_secaes_get_status(NULL, &status_out), ALP_ERR_INVAL);

	/* Build a fake handle pinned to sw_fallback (vendor != "alif") --
     * the Alif vendor ext surface must return
     * NOT_PRESENT_ON_THIS_SOC. */
	const alp_backend_t *be = alp_backend_select("storage", "alif:ensemble:e7");
	zassert_not_null(be);

	struct alp_storage h;
	memset(&h, 0, sizeof(h));
	h.in_use  = true;
	h.backend = be;
	/* The Alif SecAES calls now gate on the open/op/close guard (issue
     * #629, src/common/alp_slot_claim.h) before touching the handle --
     * a lifecycle left at 0 (ALP_HANDLE_LC_UNOPENED) reads as
     * closed/never-opened and short-circuits to ALP_ERR_NOT_READY
     * before the vendor check runs. */
	h.lifecycle = ALP_HANDLE_LC_OPEN;

	zassert_equal(alp_alif_storage_secaes_key_provision(&h, key16, 16u),
	              ALP_ERR_NOT_PRESENT_ON_THIS_SOC);
	zassert_equal(alp_alif_storage_secaes_get_status(&h, &status_out),
	              ALP_ERR_NOT_PRESENT_ON_THIS_SOC);
}

/* ---------- (h) read-only handle: write() and erase() agree ------------- */

ZTEST(alp_storage_registry, test_read_only_handle_write_and_erase_agree)
{
	/* #1635: a read-only handle used to answer write() with
     * ALP_ERR_NOT_READY and erase() with ALP_ERR_INVAL for the exact
     * same cause (state.read_only).  Both must now surface
     * ALP_ERR_NOT_READY -- it's a handle STATE, not a malformed
     * argument, matching the alp_handle_op_enter() convention settled
     * by the #1646 cluster (PR #1713). Guards a regression back to
     * ALP_ERR_INVAL on the erase path. */
	alp_storage_config_t cfg = {
		.kind        = ALP_STORAGE_KIND_QSPI_FLASH,
		.instance_id = 0u,
		.freq_hz     = 0u,
		.read_only   = true,
	};
	alp_storage_t *h = alp_storage_open(&cfg);
	zassert_not_null(h);

	uint8_t payload[4] = { 0 };
	zassert_equal(alp_storage_write(h, 0u, payload, sizeof(payload)),
	              ALP_ERR_NOT_READY,
	              "write() on a read_only handle must be ALP_ERR_NOT_READY");
	zassert_equal(alp_storage_erase(h, 0u, sizeof(payload)),
	              ALP_ERR_NOT_READY,
	              "erase() on a read_only handle must be ALP_ERR_NOT_READY, not ALP_ERR_INVAL");

	alp_storage_close(h);
}

/* ---------- (i) overflow-safe range helper for fixed-capacity backends -- */

ZTEST(alp_storage_registry, test_range_in_capacity_accepts_valid)
{
	zassert_true(alp_storage_range_in_capacity(0u, 4u, 4096u));
	zassert_true(alp_storage_range_in_capacity(4092u, 4u, 4096u)); /* exact end */
	zassert_true(alp_storage_range_in_capacity(4096u, 0u, 4096u)); /* zero len at end */
}

ZTEST(alp_storage_registry, test_range_in_capacity_rejects_out_of_range)
{
	zassert_false(alp_storage_range_in_capacity(4093u, 4u, 4096u)); /* runs 1 past end */
	zassert_false(alp_storage_range_in_capacity(5000u, 0u, 4096u)); /* offset past end */
}

ZTEST(alp_storage_registry, test_range_in_capacity_rejects_wrapped_and_uint64_max)
{
	/* offset + len wraps uint64 -- must be rejected, not accepted. */
	zassert_false(alp_storage_range_in_capacity(4000u, UINT64_MAX, 4096u));
	/* UINT64_MAX offset -- narrowing to off_t would alias to a small
     * in-bounds address without this guard. */
	zassert_false(alp_storage_range_in_capacity(UINT64_MAX, 4u, 4096u));
	zassert_false(alp_storage_range_in_capacity(UINT64_MAX, 0u, 4096u));
	/* Oversized erase length just past capacity boundary. */
	zassert_false(alp_storage_range_in_capacity(0u, UINT64_MAX, 4096u));
}

/* ---------- (j) SecAES key-bytes validation reaches the body (issue #224) */

ZTEST(alp_storage_registry, test_secaes_key_provision_validation)
{
	/* Synthesise a handle that LOOKS Alif (so the body's vendor-gate
     * passes) and then exercise the key / key_bytes checks.  This
     * test build has no HAS_ALIF_SE_SERVICES (no MHUv2 / SE-service
     * DT node on native_sim), so CONFIG_ALP_SDK_STORAGE_ALIF_SECAES
     * is off and the last case below hits the NOSUPPORT fallback,
     * not a real SE round-trip. */
	static const alp_backend_t fake_alif_backend = {
		.silicon_ref = "alif:ensemble:e8",
		.vendor      = "alif",
		.base_caps   = 0u,
		.priority    = 100,
		.ops         = NULL,
		.probe       = NULL,
	};
	struct alp_storage h;
	memset(&h, 0, sizeof(h));
	h.in_use    = true;
	h.backend   = &fake_alif_backend;
	h.lifecycle = ALP_HANDLE_LC_OPEN; /* see the (g) test above */

	static const uint8_t key16[16] = { 0 };

	/* NULL key -> INVAL. */
	zassert_equal(alp_alif_storage_secaes_key_provision(&h, NULL, 16u), ALP_ERR_INVAL);
	/* Wrong widths -> INVAL.  The OSPI write-key SE service is fixed
     * at AES-128 (services_lib_api.h OSPI_KEY_LENGTH_BYTES == 16) --
     * unlike the portable alp_storage_configure_inline_aes surface,
     * 24 / 32 are not accepted here. */
	zassert_equal(alp_alif_storage_secaes_key_provision(&h, key16, 0u), ALP_ERR_INVAL);
	zassert_equal(alp_alif_storage_secaes_key_provision(&h, key16, 24u), ALP_ERR_INVAL);
	zassert_equal(alp_alif_storage_secaes_key_provision(&h, key16, 32u), ALP_ERR_INVAL);
	/* Valid key + width -> NOSUPPORT on this build (no SE transport
     * linked). */
	zassert_equal(alp_alif_storage_secaes_key_provision(&h, key16, 16u), ALP_ERR_NOSUPPORT);
}

/* ---------- (k) closed/never-opened handle -> NOT_READY before the vendor
 * check runs (issue #629's op_enter gate, added to the SecAES calls
 * alongside issue #224) ---------------------------------------------- */

ZTEST(alp_storage_registry, test_secaes_calls_gate_on_open_lifecycle)
{
	static const alp_backend_t fake_alif_backend = {
		.silicon_ref = "alif:ensemble:e8",
		.vendor      = "alif",
		.base_caps   = 0u,
		.priority    = 100,
		.ops         = NULL,
		.probe       = NULL,
	};
	struct alp_storage h;
	memset(&h, 0, sizeof(h));
	h.in_use  = true;
	h.backend = &fake_alif_backend;
	/* h.lifecycle left at 0 (ALP_HANDLE_LC_UNOPENED) -- alp_handle_op_enter()
     * must refuse before _is_alif_backend() ever runs. */

	static const uint8_t key16[16]  = { 0 };
	uint32_t             status_out = 0u;

	zassert_equal(alp_alif_storage_secaes_key_provision(&h, key16, 16u), ALP_ERR_NOT_READY);
	zassert_equal(alp_alif_storage_secaes_get_status(&h, &status_out), ALP_ERR_NOT_READY);
}
```
