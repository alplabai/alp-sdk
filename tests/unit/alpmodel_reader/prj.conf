## CMakeLists.txt
```
# SPDX-License-Identifier: Apache-2.0
cmake_minimum_required(VERSION 3.20.0)

find_package(Zephyr REQUIRED HINTS $ENV{ZEPHYR_BASE})
project(test_alpmodel_reader)

target_sources(app PRIVATE
    src/test_reader.c
)
```

## prj.conf
```kconfig
CONFIG_ZTEST=y
CONFIG_ALP_SDK=y
CONFIG_ALP_SOC_ALIF_ENSEMBLE_E7=y
CONFIG_ALP_SDK_MODEL_READER=y
CONFIG_ZCBOR=y
```

## src/fixture.h
```c
/* GENERATED by `python -m tan.model._gen_fixture` -- do not edit. */
/* clang-format off */
#ifndef ALP_MODEL_FIXTURE_H
#define ALP_MODEL_FIXTURE_H
#include <stddef.h>
#include <stdint.h>

static const uint8_t alp_model_fixture[] = {
    0x41, 0x4c, 0x50, 0x4d, 0x01, 0x00, 0x00, 0x00, 0x18, 0x00, 0x00, 0x00,
    0x49, 0x02, 0x00, 0x00, 0x61, 0x02, 0x00, 0x00, 0x02, 0x00, 0x00, 0x00,
    0xa7, 0x61, 0x76, 0x01, 0x64, 0x6e, 0x61, 0x6d, 0x65, 0x67, 0x6d, 0x69,
    0x6e, 0x69, 0x6d, 0x61, 0x6c, 0x67, 0x73, 0x72, 0x63, 0x5f, 0x73, 0x68,
    0x61, 0x58, 0x20, 0x00, 0x01, 0x02, 0x03, 0x04, 0x05, 0x06, 0x07, 0x08,
    0x09, 0x0a, 0x0b, 0x0c, 0x0d, 0x0e, 0x0f, 0x10, 0x11, 0x12, 0x13, 0x14,
    0x15, 0x16, 0x17, 0x18, 0x19, 0x1a, 0x1b, 0x1c, 0x1d, 0x1e, 0x1f, 0x66,
    0x69, 0x6e, 0x70, 0x75, 0x74, 0x73, 0x81, 0xa5, 0x65, 0x64, 0x74, 0x79,
    0x70, 0x65, 0x64, 0x69, 0x6e, 0x74, 0x38, 0x64, 0x72, 0x61, 0x6e, 0x6b,
    0x04, 0x65, 0x73, 0x68, 0x61, 0x70, 0x65, 0x84, 0x01, 0x18, 0x60, 0x18,
    0x60, 0x01, 0x65, 0x73, 0x63, 0x61, 0x6c, 0x65, 0xfb, 0x3f, 0x7f, 0xf2,
    0xe4, 0x8e, 0x8a, 0x71, 0xde, 0x62, 0x7a, 0x70, 0x20, 0x67, 0x6f, 0x75,
    0x74, 0x70, 0x75, 0x74, 0x73, 0x81, 0xa5, 0x65, 0x64, 0x74, 0x79, 0x70,
    0x65, 0x64, 0x69, 0x6e, 0x74, 0x38, 0x64, 0x72, 0x61, 0x6e, 0x6b, 0x02,
    0x65, 0x73, 0x68, 0x61, 0x70, 0x65, 0x82, 0x01, 0x02, 0x65, 0x73, 0x63,
    0x61, 0x6c, 0x65, 0xfb, 0x3f, 0x70, 0x62, 0x4d, 0xd2, 0xf1, 0xa9, 0xfc,
    0x62, 0x7a, 0x70, 0x00, 0x67, 0x74, 0x61, 0x72, 0x67, 0x65, 0x74, 0x73,
    0x82, 0xa8, 0x67, 0x62, 0x61, 0x63, 0x6b, 0x65, 0x6e, 0x64, 0x67, 0x65,
    0x74, 0x68, 0x6f, 0x73, 0x5f, 0x75, 0x6b, 0x73, 0x69, 0x6c, 0x69, 0x63,
    0x6f, 0x6e, 0x5f, 0x72, 0x65, 0x66, 0x70, 0x61, 0x6c, 0x69, 0x66, 0x3a,
    0x65, 0x6e, 0x73, 0x65, 0x6d, 0x62, 0x6c, 0x65, 0x3a, 0x65, 0x38, 0x6b,
    0x62, 0x6c, 0x6f, 0x62, 0x5f, 0x66, 0x6f, 0x72, 0x6d, 0x61, 0x74, 0x6b,
    0x76, 0x65, 0x6c, 0x61, 0x5f, 0x74, 0x66, 0x6c, 0x69, 0x74, 0x65, 0x6c,
    0x61, 0x63, 0x63, 0x65, 0x6c, 0x5f, 0x63, 0x6f, 0x6e, 0x66, 0x69, 0x67,
    0x6d, 0x65, 0x74, 0x68, 0x6f, 0x73, 0x2d, 0x75, 0x38, 0x35, 0x2d, 0x32,
    0x35, 0x36, 0x65, 0x61, 0x72, 0x65, 0x6e, 0x61, 0x1a, 0x00, 0x01, 0x00,
    0x00, 0x68, 0x72, 0x65, 0x71, 0x75, 0x69, 0x72, 0x65, 0x73, 0xa2, 0x68,
    0x73, 0x72, 0x61, 0x6d, 0x5f, 0x6b, 0x69, 0x62, 0x19, 0x01, 0x00, 0x6b,
    0x6f, 0x70, 0x5f, 0x66, 0x65, 0x61, 0x74, 0x75, 0x72, 0x65, 0x73, 0x80,
    0x64, 0x62, 0x6c, 0x6f, 0x62, 0x00, 0x70, 0x63, 0x6f, 0x6d, 0x70, 0x69,
    0x6c, 0x65, 0x72, 0x5f, 0x76, 0x65, 0x72, 0x73, 0x69, 0x6f, 0x6e, 0x6a,
    0x76, 0x65, 0x6c, 0x61, 0x20, 0x34, 0x2e, 0x31, 0x2e, 0x30, 0xa8, 0x67,
    0x62, 0x61, 0x63, 0x6b, 0x65, 0x6e, 0x64, 0x63, 0x63, 0x70, 0x75, 0x6b,
    0x73, 0x69, 0x6c, 0x69, 0x63, 0x6f, 0x6e, 0x5f, 0x72, 0x65, 0x66, 0x61,
    0x2a, 0x6b, 0x62, 0x6c, 0x6f, 0x62, 0x5f, 0x66, 0x6f, 0x72, 0x6d, 0x61,
    0x74, 0x66, 0x74, 0x66, 0x6c, 0x69, 0x74, 0x65, 0x6c, 0x61, 0x63, 0x63,
    0x65, 0x6c, 0x5f, 0x63, 0x6f, 0x6e, 0x66, 0x69, 0x67, 0x60, 0x65, 0x61,
    0x72, 0x65, 0x6e, 0x61, 0x1a, 0x00, 0x02, 0x00, 0x00, 0x68, 0x72, 0x65,
    0x71, 0x75, 0x69, 0x72, 0x65, 0x73, 0xa2, 0x68, 0x73, 0x72, 0x61, 0x6d,
    0x5f, 0x6b, 0x69, 0x62, 0x00, 0x6b, 0x6f, 0x70, 0x5f, 0x66, 0x65, 0x61,
    0x74, 0x75, 0x72, 0x65, 0x73, 0x80, 0x64, 0x62, 0x6c, 0x6f, 0x62, 0x01,
    0x70, 0x63, 0x6f, 0x6d, 0x70, 0x69, 0x6c, 0x65, 0x72, 0x5f, 0x76, 0x65,
    0x72, 0x73, 0x69, 0x6f, 0x6e, 0x6b, 0x70, 0x61, 0x73, 0x73, 0x74, 0x68,
    0x72, 0x6f, 0x75, 0x67, 0x68, 0x68, 0x63, 0x6f, 0x76, 0x65, 0x72, 0x61,
    0x67, 0x65, 0x81, 0xa4, 0x67, 0x62, 0x61, 0x63, 0x6b, 0x65, 0x6e, 0x64,
    0x6a, 0x64, 0x65, 0x65, 0x70, 0x78, 0x5f, 0x64, 0x78, 0x6d, 0x31, 0x6c,
    0x61, 0x63, 0x63, 0x65, 0x6c, 0x5f, 0x63, 0x6f, 0x6e, 0x66, 0x69, 0x67,
    0x60, 0x66, 0x73, 0x74, 0x61, 0x74, 0x75, 0x73, 0x67, 0x73, 0x6b, 0x69,
    0x70, 0x70, 0x65, 0x64, 0x66, 0x72, 0x65, 0x61, 0x73, 0x6f, 0x6e, 0x75,
    0x64, 0x78, 0x2d, 0x63, 0x6f, 0x6d, 0x70, 0x69, 0x6c, 0x65, 0x72, 0x20,
    0x6e, 0x6f, 0x74, 0x20, 0x66, 0x6f, 0x75, 0x6e, 0x64, 0x71, 0x02, 0x00,
    0x00, 0x08, 0x00, 0x00, 0x00, 0x79, 0x02, 0x00, 0x00, 0x07, 0x00, 0x00,
    0x00, 0x56, 0x45, 0x4c, 0x41, 0x00, 0x01, 0x02, 0x03, 0x54, 0x46, 0x4c,
    0x49, 0x54, 0x45, 0x00,
};
static const size_t alp_model_fixture_len = 640;

#endif /* ALP_MODEL_FIXTURE_H */
/* clang-format on */
```

## src/test_reader.c
```c
/*
 * Copyright 2026 Alp Lab AB
 * SPDX-License-Identifier: Apache-2.0
 */
#include <zephyr/ztest.h>
#include <string.h>
#include "alp/model.h"
#include "fixture.h"

ZTEST_SUITE(alpmodel_reader, NULL, NULL, NULL, NULL, NULL);

ZTEST(alpmodel_reader, test_parse_minimal_fixture)
{
	alp_model_t m;
	zassert_equal(ALP_OK, alp_model_parse(alp_model_fixture, alp_model_fixture_len, &m));
	zassert_str_equal(m.name, "minimal");
	zassert_equal(m.n_targets, 2u, "expected 2 targets, got %u", m.n_targets);
	zassert_str_equal(m.targets[0].backend, "ethos_u");
	zassert_str_equal(m.targets[0].accel_config, "ethos-u85-256");
	zassert_equal(m.targets[0].arena_bytes, 65536u);
	zassert_equal(m.targets[0].req_sram_kib, 256u);
	zassert_str_equal(m.targets[1].backend, "cpu");
	zassert_equal(m.targets[0].blob_len, 8u);
	zassert_mem_equal(m.targets[0].blob, "VELA\x00\x01\x02\x03", 8);
}

ZTEST(alpmodel_reader, test_bad_magic_rejected)
{
	uint8_t buf[64];
	memcpy(buf, alp_model_fixture, sizeof(buf));
	buf[0] = 'Z';
	alp_model_t m;
	zassert_equal(ALP_ERR_INVAL, alp_model_parse(buf, sizeof(buf), &m));
}

ZTEST(alpmodel_reader, test_bad_version_rejected)
{
	uint8_t buf[64];
	memcpy(buf, alp_model_fixture, sizeof(buf));
	buf[4] = 99;
	alp_model_t m;
	zassert_equal(ALP_ERR_VERSION, alp_model_parse(buf, sizeof(buf), &m));
}

ZTEST(alpmodel_reader, test_oversized_blob_count_rejected)
{
	uint8_t buf[700];
	zassert_true(alp_model_fixture_len <= sizeof(buf), "buffer too small for fixture");
	memcpy(buf, alp_model_fixture, alp_model_fixture_len);
	/* blob_count is the u32 at header offset 20; make the blob table run past EOF */
	buf[20] = 0xFF;
	buf[21] = 0xFF;
	buf[22] = 0x00;
	buf[23] = 0x00; /* 65535 blobs */
	alp_model_t m;
	zassert_equal(ALP_ERR_INVAL, alp_model_parse(buf, alp_model_fixture_len, &m));
}

/* Range checks must reject wrapped offset+length pairs before any pointer
 * arithmetic. The header offsets/lengths are untrusted u32s, so adding them
 * to a size_t can wrap on 32-bit targets; a crafted UINT32_MAX value must be
 * rejected on the base-offset compare regardless of word size. */
static void set_u32(uint8_t *p, uint32_t v)
{
	p[0] = (uint8_t)(v);
	p[1] = (uint8_t)(v >> 8);
	p[2] = (uint8_t)(v >> 16);
	p[3] = (uint8_t)(v >> 24);
}

ZTEST(alpmodel_reader, test_wrapped_manifest_offset_rejected)
{
	uint8_t buf[700];
	zassert_true(alp_model_fixture_len <= sizeof(buf), "buffer too small for fixture");
	memcpy(buf, alp_model_fixture, alp_model_fixture_len);
	set_u32(buf + 8, 0xFFFFFFFFu); /* mft_off */
	alp_model_t m;
	zassert_equal(ALP_ERR_INVAL, alp_model_parse(buf, alp_model_fixture_len, &m));
}

ZTEST(alpmodel_reader, test_wrapped_manifest_length_rejected)
{
	uint8_t buf[700];
	zassert_true(alp_model_fixture_len <= sizeof(buf), "buffer too small for fixture");
	memcpy(buf, alp_model_fixture, alp_model_fixture_len);
	set_u32(buf + 12, 0xFFFFFFFFu); /* mft_len, mft_off stays valid */
	alp_model_t m;
	zassert_equal(ALP_ERR_INVAL, alp_model_parse(buf, alp_model_fixture_len, &m));
}

ZTEST(alpmodel_reader, test_wrapped_table_offset_rejected)
{
	uint8_t buf[700];
	zassert_true(alp_model_fixture_len <= sizeof(buf), "buffer too small for fixture");
	memcpy(buf, alp_model_fixture, alp_model_fixture_len);
	set_u32(buf + 16, 0xFFFFFFFFu); /* tbl_off */
	alp_model_t m;
	zassert_equal(ALP_ERR_INVAL, alp_model_parse(buf, alp_model_fixture_len, &m));
}

ZTEST(alpmodel_reader, test_wrapped_blob_offset_rejected)
{
	uint8_t buf[700];
	zassert_true(alp_model_fixture_len <= sizeof(buf), "buffer too small for fixture");
	memcpy(buf, alp_model_fixture, alp_model_fixture_len);
	/* Blob table starts at tbl_off (header u32 at offset 16); entry 0 begins
	 * there with boff (u32) then blen (u32). A UINT32_MAX blob offset must be
	 * rejected without wrapping boff+blen. */
	uint32_t tbl_off = (uint32_t)buf[16] | ((uint32_t)buf[17] << 8) | ((uint32_t)buf[18] << 16) |
	                   ((uint32_t)buf[19] << 24);
	set_u32(buf + tbl_off, 0xFFFFFFFFu);
	alp_model_t m;
	zassert_equal(ALP_ERR_INVAL, alp_model_parse(buf, alp_model_fixture_len, &m));
}

ZTEST(alpmodel_reader, test_target_without_blob_key_rejected)
{
	/* Manifest {"targets": [ {"backend": "cpu"} ]} -- no "blob" key.  The
	 * blob table has one valid entry, so a defaulted index 0 would parse. */
	static const uint8_t mft[] = { 0xa1, 0x67, 't', 'a', 'r', 'g', 'e', 't',  's', 0x81, 0xa1, 0x67,
		                           'b',  'a',  'c', 'k', 'e', 'n', 'd', 0x63, 'c', 'p',  'u' };
	uint8_t              buf[24 + sizeof(mft) + 8] = { 'A', 'L', 'P', 'M', 1, 0 };
	set_u32(buf + 8, 24u);
	set_u32(buf + 12, (uint32_t)sizeof(mft));
	set_u32(buf + 16, 24u + (uint32_t)sizeof(mft));
	set_u32(buf + 20, 1u);
	memcpy(buf + 24, mft, sizeof(mft));
	/* blob table entry 0 = {off 0, len 0}: left zero */
	alp_model_t m;
	zassert_equal(ALP_ERR_INVAL, alp_model_parse(buf, sizeof(buf), &m));
}
```
