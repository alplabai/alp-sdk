/*
 * Renode-only override (issue #1158): enable sci0 as a real UART console so
 * the plain (non --sim-mode) `tan renode` boot has SOME observable output --
 * today it has none, because the shipping board keeps the M33-SM headless
 * (see metadata/renode/renesas_rzv2n.repl + renesas_rzv2n.resc headers).
 *
 * Do NOT apply this overlay to a real-hardware build. The base board .dts
 * (zephyr/boards/alp/e1m_v2n101_m33_sm/..._cm33.dts) disables sci0 on
 * purpose: it is the EVK "Pmod USB-UART" header, not populated on the SoM,
 * so enabling RX opens the receiver onto a floating RXD pin -- the resulting
 * framing/receive-error interrupt (sci0 eri, NVIC 114) escalates to a
 * Zephyr fatal (arch_system_halt) before main() ever runs on real silicon.
 * Renode's model never drives a floating-pin error condition (see the sci0
 * peripheral in renesas_rzv2n.repl), so it is safe here -- and only here.
 */
/ {
	chosen {
		zephyr,console = &uart0;
	};
};

&sci0 {
	status = "okay";

	uart0: uart {
		status = "okay";
	};
};
