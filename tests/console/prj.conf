## CMakeLists.txt
```
# SPDX-License-Identifier: Apache-2.0
cmake_minimum_required(VERSION 3.20.0)
find_package(Zephyr REQUIRED HINTS $ENV{ZEPHYR_BASE})
project(alp_console_test)
target_sources(app PRIVATE src/test_console.c)
```

## prj.conf
```kconfig
CONFIG_ZTEST=y
CONFIG_ALP_SDK=y
CONFIG_ALP_SDK_CONSOLE=y
CONFIG_ALP_SDK_CONSOLE_UNSAFE=y
CONFIG_SHELL=y
CONFIG_SHELL_BACKEND_SERIAL=n
CONFIG_SHELL_BACKEND_DUMMY=y
CONFIG_LOG=n
CONFIG_GPIO=y
CONFIG_ALP_SDK_I2C_SW_FALLBACK=y
CONFIG_ADC=y
CONFIG_ALP_SDK_ADC_SW_FALLBACK=y
CONFIG_SHELL_BACKEND_DUMMY_BUF_SIZE=2048

# `alp companion` (#673 Phase 2 command-group split) -- Alif CC3501E path.
# Pulls in chips/cc3501e/cc3501e.c (link-tests every command-group TU
# without a real bus; commands warn "companion not registered" and exit
# early, same as an app that hasn't called alp_console_companion_set()
# yet).  CONFIG_SPI/CONFIG_EMUL/CONFIG_SPI_EMUL mirror the known-working
# tests/zephyr/chips/prj.conf recipe for CONFIG_ALP_SDK_CHIP_CC3501E on
# native_sim.
CONFIG_ALP_SDK_CONSOLE_CMD_COMPANION=y
CONFIG_ALP_SDK_CHIP_CC3501E=y
CONFIG_SPI=y
CONFIG_EMUL=y
CONFIG_SPI_EMUL=y
CONFIG_GPIO_GET_CONFIG=y
```

## app.overlay
```dts
/*
 * Copyright 2026 Alp Lab AB
 * SPDX-License-Identifier: Apache-2.0
 *
 * Devicetree overlay for the alp-sdk console ztest under native_sim.
 *
 * Exposes a single gpio-emul controller and wires its pin 0 into the
 * alp,pin-array at index 0.  alp_gpio_open(0) resolves to pin 0 of
 * gpio_emul0 -- the gpio-emul reset default is low, so `alp gpio read 0`
 * returns "= 0" without any explicit drive.
 */

#include <zephyr/dt-bindings/gpio/gpio.h>

/ {
	gpio_emul0: gpio_emul0 {
		compatible = "zephyr,gpio-emul";
		status = "okay";
		gpio-controller;
		rising-edge;
		falling-edge;
		#gpio-cells = <2>;
		ngpios = <4>;
	};

	alp_pins: alp-pins {
		compatible = "alp,pin-array";
		gpios = <&gpio_emul0 0 GPIO_ACTIVE_HIGH>,   /* [0] console test pin (input) */
		        <&gpio_emul0 1 GPIO_ACTIVE_HIGH>;   /* [1] console test pin (output) */
	};
};
```

## src/test_console.c
```c
/*
 * Copyright 2026 Alp Lab AB
 * SPDX-License-Identifier: Apache-2.0
 */
#include <zephyr/ztest.h>
#include <zephyr/shell/shell.h>
#include <zephyr/shell/shell_dummy.h>
#include <string.h>

#include <alp/peripheral.h>
#include <alp/version.h> /* ALP_VERSION_STRING -- the single SDK-version source */

/* Run a shell line on the dummy backend and return its captured output. */
static const char *run(const char *line)
{
	const struct shell *sh = shell_backend_dummy_get_ptr();

	shell_backend_dummy_clear_output(sh);
	(void)shell_execute_cmd(sh, line);

	size_t      len;
	const char *out = shell_backend_dummy_get_output(sh, &len);
	return out;
}

static void *suite_setup(void)
{
	const struct shell *sh = shell_backend_dummy_get_ptr();

	WAIT_FOR(shell_ready(sh), 20000, k_msleep(1));
	zassert_true(shell_ready(sh), "timed out waiting for dummy shell backend");
	return NULL;
}

ZTEST(alp_console, test_board_reports_version)
{
	const char *out = run("alp board");

	zassert_not_null(strstr(out, "Alp SDK"), "banner line missing: %s", out);
	zassert_not_null(strstr(out, ALP_VERSION_STRING), "version missing");
}

ZTEST(alp_console, test_mem_rd_reads_known_word)
{
	static volatile uint32_t probe = 0xCAFEF00Du;
	char                     line[48];

	snprintk(line, sizeof(line), "alp mem rd 0x%lx", (unsigned long)(uintptr_t)&probe);
	const char *out = run(line);

	zassert_not_null(strstr(out, "cafef00d"), "expected value in: %s", out);
}

ZTEST(alp_console, test_mem_wr_then_rd_roundtrips)
{
	static volatile uint32_t probe = 0;
	char                     line[64];

	snprintk(line, sizeof(line), "alp mem wr 0x%lx 0x12345678", (unsigned long)(uintptr_t)&probe);
	(void)run(line);
	zassert_equal(probe, 0x12345678u, "write did not land");
}

ZTEST(alp_console, test_gpio_read_runs)
{
	/* `alp gpio read` only samples pins that are already inputs (#2933). */
	alp_gpio_t *g = alp_gpio_open(0);

	zassert_not_null(g, "open pin 0");
	zassert_equal(alp_gpio_configure(g, ALP_GPIO_INPUT, ALP_GPIO_PULL_NONE), ALP_OK, "cfg");
	alp_gpio_close(g);

	/* The gpio-emul reset level is low = 0. */
	const char *out = run("alp gpio read 0");

	zassert_true(strstr(out, "= 0") || strstr(out, "= 1"), "got: %s", out);
}

ZTEST(alp_console, test_gpio_read_refuses_output_pin)
{
	alp_gpio_t *g = alp_gpio_open(1);

	zassert_not_null(g, "open pin 1");
	zassert_equal(alp_gpio_configure(g, ALP_GPIO_OUTPUT, ALP_GPIO_PULL_NONE), ALP_OK, "cfg");
	zassert_equal(alp_gpio_write(g, true), ALP_OK, "drive high");
	alp_gpio_close(g);

	const char *out = run("alp gpio read 1");

	zassert_not_null(strstr(out, "not configured as an input"), "got: %s", out);
	zassert_is_null(strstr(out, "pin 1 ="), "must not print a level: %s", out);

	/* The refused read must not have turned the output into an input: a
	 * second read is still refused. */
	out = run("alp gpio read 1");
	zassert_not_null(strstr(out, "not configured as an input"), "pin was reconfigured: %s", out);
}

ZTEST(alp_console, test_i2c_scan_runs)
{
	const char *out = run("alp i2c scan 0");

	zassert_not_null(strstr(out, "responder"), "scan summary missing: %s", out);
}

ZTEST(alp_console, test_i2c_read_2byte_reg)
{
	/* The sw_fallback echoes the written register-address bytes back on the
	 * read phase.  With regbytes=2 and reg=0x1234 the 2-byte BIG-ENDIAN
	 * address 0x12 0x34 must lead the readback -- proving the command issued
	 * a 2-byte register address (needed for 16-bit-addressed parts like the
	 * 24C128 EEPROM). */
	const char *out = run("alp i2c read 0 0x50 0x1234 4 2");

	zassert_not_null(strstr(out, "12 34"), "2-byte reg addr not issued: %s", out);
}

ZTEST(alp_console, test_i2c_read_1byte_default)
{
	/* No regbytes arg = 1-byte register (backward compatible); the single
	 * address byte 0xab echoes back. */
	const char *out = run("alp i2c read 0 0x50 0xab 2");

	zassert_not_null(strstr(out, "ab"), "1-byte reg addr not issued: %s", out);
}

ZTEST(alp_console, test_adc_read_registers)
{
	const char *out = run("alp adc read 0");

	/* Command must be registered AND its handler must run: on native_sim the
	 * sw-fallback adc open fails, so the handler prints "open ch ...". A raw
	 * value ("raw") is the success token on real hardware. "Unknown command"
	 * means the subcmd is absent. */
	zassert_is_null(strstr(out, "Unknown command"), "adc cmd not registered: %s", out);
	zassert_true(strstr(out, "open ch") != NULL || strstr(out, "raw") != NULL,
	             "adc handler did not run: %s",
	             out);
}

ZTEST(alp_console, test_clk_dump_runs)
{
	const char *out = run("alp clk");

	zassert_not_null(strstr(out, "Hz"), "clk dump missing: %s", out);
	zassert_is_null(strstr(out, "Unknown command"), "clk cmd not registered: %s", out);
}

/*
 * `alp companion` command-group registration (#673 Phase 2 split):
 * alp_console_companion.c (core) plus the _wifi/_ble/_diag/_ota/_sock
 * sibling TUs each register their group onto the (alp, companion)
 * dynamic subcommand set from their own file -- these assert every group
 * survived the split and is reachable by name.  No companion is bound
 * (alp_console_companion_set() is never called), so each command exits
 * early via its "companion not registered" guard; the point here is that
 * the shell resolves the command at all, not the CC3501E transaction
 * behind it (that's chips/cc3501e/cc3501e.c's own coverage, see
 * tests/zephyr/cc3501e_host_driver). */
ZTEST(alp_console, test_companion_ver_registered)
{
	const char *out = run("alp companion ver");

	zassert_is_null(strstr(out, "Unknown command"), "companion ver not registered: %s", out);
}

ZTEST(alp_console, test_companion_ping_registered)
{
	const char *out = run("alp companion ping");

	zassert_is_null(strstr(out, "Unknown command"), "companion ping not registered: %s", out);
}

ZTEST(alp_console, test_companion_reset_registered)
{
	const char *out = run("alp companion reset");

	zassert_is_null(strstr(out, "Unknown command"), "companion reset not registered: %s", out);
}

ZTEST(alp_console, test_companion_bench_registered)
{
	const char *out = run("alp companion bench");

	zassert_is_null(strstr(out, "Unknown command"), "companion bench not registered: %s", out);
}

ZTEST(alp_console, test_companion_wifi_group_registered)
{
	const char *out = run("alp companion wifi scan");

	zassert_is_null(strstr(out, "Unknown command"), "companion wifi not registered: %s", out);
}

ZTEST(alp_console, test_companion_ble_group_registered)
{
	const char *out = run("alp companion ble enable");

	zassert_is_null(strstr(out, "Unknown command"), "companion ble not registered: %s", out);
}

/* Sibling of the wifi connect/ap guards above (#1376/#1480): `ble connect`'s
 * 3rd token is the only optional flag and must be "random"; a mistyped token
 * used to be compared `== 0` and otherwise silently ignored, connecting as
 * address type public with no diagnostic. */
ZTEST(alp_console, test_ble_connect_rejects_unrecognised_third_token)
{
	const char *out = run("alp companion ble connect aa:bb:cc:dd:ee:ff randm");

	zassert_not_null(strstr(out, "unrecognised argument"),
	                 "an unrecognised 3rd token must fail loudly, not be dropped: %s",
	                 out);
	/* It must be rejected DURING parsing -- before any companion/state check. */
	zassert_is_null(strstr(out, "companion not registered"),
	                "a usage error must not be reported as a missing companion: %s",
	                out);
}

ZTEST(alp_console, test_ble_connect_still_accepts_random_token)
{
	const char *out = run("alp companion ble connect aa:bb:cc:dd:ee:ff random");

	zassert_is_null(
	    strstr(out, "unrecognised argument"), "\"random\" is the one legal 3rd token: %s", out);
	zassert_not_null(strstr(out, "companion not registered"),
	                 "a well-formed random connect should reach the companion check: %s",
	                 out);
}

ZTEST(alp_console, test_companion_ble_gatt_subgroup_registered)
{
	const char *out = run("alp companion ble gatt read 0");

	zassert_is_null(strstr(out, "Unknown command"), "companion ble gatt not registered: %s", out);
}

ZTEST(alp_console, test_companion_diag_group_registered)
{
	const char *out = run("alp companion diag info");

	zassert_is_null(strstr(out, "Unknown command"), "companion diag not registered: %s", out);
}

ZTEST(alp_console, test_companion_ota_group_registered)
{
	const char *out = run("alp companion ota status");

	zassert_is_null(strstr(out, "Unknown command"), "companion ota not registered: %s", out);
}

ZTEST(alp_console, test_companion_sock_group_registered)
{
	const char *out = run("alp companion sock tcp-get 127.0.0.1 80 /");

	zassert_is_null(strstr(out, "Unknown command"), "companion sock not registered: %s", out);
}

/* #1376/#1480: an unrecognised 4th token used to be silently DROPPED, for both
 * `wifi connect` and `wifi ap`.  The dangerous shape is an UNQUOTED SSID
 * containing a space: it splits across argv[1]/argv[2], the real passphrase
 * lands in argv[3], and the old `strcmp(argv[3], "wpa3") == 0` test ignored it
 * -- so the console printed a confident "connecting"/"ap starting" line for an
 * SSID the user never typed, with their passphrase eaten as a security token.
 * Associating with a truncated SSID is worse than refusing.
 *
 * These six tests (three `wifi connect` + three `wifi ap`, below) are one set
 * and should stay one: each family's first test proves the dangerous form is
 * now refused, and its other test(s) prove the refusal did not simply ban
 * spaces or break the one legal flag.  No companion is registered in this
 * suite, so a command that gets PAST argument validation reports "companion
 * not registered" -- that reply is the marker for "parsed fine", and its
 * absence in the rejection case is the marker for "rejected during
 * parsing". */
ZTEST(alp_console, test_wifi_connect_rejects_unrecognised_fourth_token)
{
	const char *out = run("alp companion wifi connect my ssid secret");

	zassert_not_null(strstr(out, "unrecognised argument"),
	                 "an unrecognised 4th token must fail loudly, not be dropped: %s",
	                 out);
	zassert_not_null(strstr(out, "must be quoted"), "the refusal must say how to fix it: %s", out);
	/* It must be rejected DURING parsing -- before any companion/state check. */
	zassert_is_null(strstr(out, "companion not registered"),
	                "a usage error must not be reported as a missing companion: %s",
	                out);
}

ZTEST(alp_console, test_wifi_connect_accepts_quoted_ssid_with_space)
{
	const char *out = run("alp companion wifi connect \"my ssid\" secret");

	zassert_is_null(strstr(out, "unrecognised argument"),
	                "a QUOTED ssid containing a space must still parse: %s",
	                out);
	/* Parsed cleanly, so it reached the companion check. */
	zassert_not_null(strstr(out, "companion not registered"),
	                 "a well-formed connect should reach the companion check: %s",
	                 out);
}

ZTEST(alp_console, test_wifi_connect_still_accepts_wpa3_token)
{
	const char *out = run("alp companion wifi connect \"my ssid\" secret wpa3");

	zassert_is_null(
	    strstr(out, "unrecognised argument"), "\"wpa3\" is the one legal 4th token: %s", out);
	zassert_not_null(strstr(out, "companion not registered"),
	                 "a well-formed wpa3 connect should reach the companion check: %s",
	                 out);
}

ZTEST(alp_console, test_wifi_ap_rejects_unrecognised_fourth_token)
{
	const char *out = run("alp companion wifi ap my ssid secret");

	zassert_not_null(strstr(out, "unrecognised argument"),
	                 "an unrecognised 4th token must fail loudly, not be dropped: %s",
	                 out);
	zassert_not_null(strstr(out, "must be quoted"), "the refusal must say how to fix it: %s", out);
	/* It must be rejected DURING parsing -- before any companion/state check. */
	zassert_is_null(strstr(out, "companion not registered"),
	                "a usage error must not be reported as a missing companion: %s",
	                out);
}

ZTEST(alp_console, test_wifi_ap_accepts_quoted_ssid_with_space)
{
	const char *out = run("alp companion wifi ap \"my ssid\" secret");

	zassert_is_null(strstr(out, "unrecognised argument"),
	                "a QUOTED ssid containing a space must still parse: %s",
	                out);
	/* Parsed cleanly, so it reached the companion check. */
	zassert_not_null(strstr(out, "companion not registered"),
	                 "a well-formed ap should reach the companion check: %s",
	                 out);
}

ZTEST(alp_console, test_wifi_ap_still_accepts_wpa3_token)
{
	const char *out = run("alp companion wifi ap \"my ssid\" secret wpa3");

	zassert_is_null(
	    strstr(out, "unrecognised argument"), "\"wpa3\" is the one legal 4th token: %s", out);
	zassert_not_null(strstr(out, "companion not registered"),
	                 "a well-formed wpa3 ap should reach the companion check: %s",
	                 out);
}

/* #1552: the "wpa3" token with an EMPTY passphrase used to be accepted, because
 * the empty passphrase selected open and `if (argc >= 4) { sec = 2u; }` then
 * overwrote that with WPA3-SAE -- which has no open mode, so the result was a
 * declared WPA3-SAE network with no PSK. Bench-measured on E1M-AEN801 before
 * the fix: `wifi ap TestAP-1480 "" wpa3` was accepted and the AP was started.
 * Both commands carry the identical shape, so both get the identical test. */

ZTEST(alp_console, test_wifi_connect_rejects_wpa3_with_empty_passphrase)
{
	const char *out = run("alp companion wifi connect \"my ssid\" \"\" wpa3");

	zassert_not_null(strstr(out, "requires a passphrase"),
	                 "wpa3 with an empty passphrase must be refused, not silently "
	                 "configured as SAE with no PSK: %s",
	                 out);
	/* Refused DURING parsing -- before any companion/state check, same
	 * ordering the #1376/#1480 token guards established. */
	zassert_is_null(strstr(out, "companion not registered"),
	                "a usage error must not be reported as a missing companion: %s",
	                out);
}

ZTEST(alp_console, test_wifi_ap_rejects_wpa3_with_empty_passphrase)
{
	const char *out = run("alp companion wifi ap \"my ssid\" \"\" wpa3");

	zassert_not_null(strstr(out, "requires a passphrase"),
	                 "wpa3 with an empty passphrase must be refused, not silently "
	                 "configured as SAE with no PSK: %s",
	                 out);
	zassert_is_null(strstr(out, "companion not registered"),
	                "a usage error must not be reported as a missing companion: %s",
	                out);
}

/* Controls: the guard must reject ONLY the contradiction, not the two
 * legitimate ways to ask for an open network. Without these, deleting the
 * `argc >= 4` half of the condition would still pass the two tests above while
 * banning every open network. */

ZTEST(alp_console, test_wifi_connect_still_accepts_empty_passphrase_without_wpa3)
{
	const char *out = run("alp companion wifi connect \"my ssid\" \"\"");

	zassert_is_null(strstr(out, "requires a passphrase"),
	                "an empty passphrase with no wpa3 token is a valid open network: %s",
	                out);
	zassert_not_null(strstr(out, "companion not registered"),
	                 "a well-formed open connect should reach the companion check: %s",
	                 out);
}

ZTEST(alp_console, test_wifi_ap_still_accepts_empty_passphrase_without_wpa3)
{
	const char *out = run("alp companion wifi ap \"my ssid\" \"\"");

	zassert_is_null(strstr(out, "requires a passphrase"),
	                "an empty passphrase with no wpa3 token is a valid open soft-AP: %s",
	                out);
	zassert_not_null(strstr(out, "companion not registered"),
	                 "a well-formed open ap should reach the companion check: %s",
	                 out);
}

/* SPI1 host passthrough: the group registers, and its argument parsing runs
 * BEFORE the companion check -- a mistyped option must read as a usage error,
 * not as "no companion bound", or a bench operator debugging a dead bus starts
 * from the wrong end. */

ZTEST(alp_console, test_companion_spi1_group_registered)
{
	const char *out = run("alp companion spi1 release");

	zassert_is_null(strstr(out, "Unknown command"), "companion spi1 not registered: %s", out);
}

ZTEST(alp_console, test_spi1_xfer_rejects_odd_hex_before_companion_check)
{
	const char *out = run("alp companion spi1 xfer abc");

	zassert_not_null(strstr(out, "usage:"), "an odd-length hex TX must be refused: %s", out);
	zassert_is_null(strstr(out, "companion not registered"),
	                "a usage error must not be reported as a missing companion: %s",
	                out);
}

ZTEST(alp_console, test_spi1_xfer_accepts_valid_hex_and_reaches_the_companion_check)
{
	const char *out = run("alp companion spi1 xfer 9f000000 hold");

	zassert_not_null(strstr(out, "companion not registered"),
	                 "a well-formed xfer should reach the companion check: %s",
	                 out);
}

ZTEST_SUITE(alp_console, NULL, suite_setup, NULL, NULL, NULL);
```
