# AE8SUPERSET_CM55_HP_View register map
Vendor: Alif Semiconductor; Series: E8; File version: 1.0
The families of fusion processors and microcontrollers (MCUs) from Alif Semiconductor create a scalable and compatible continuum of highly integrated embedded processor devices for use in low-end to high-end intelligent IoT end-point applications. Architected for power efficiency and long battery life, these devices deliver high computation and ML/AI capability, multi-layered security, computer vision, and highly interactive human-machine interface.
CPU: CM55 r1p0, selectable endian, MPU, FPU, double-precision FPU, DSP, VTOR, 8 interrupt priority bits, 1 SAU regions
Registers are 32-bit, read-write, reset 0x0 unless marked. A register's access mark holds for its fields unless they carry their own. Offsets are from the block's base; lines under a group give offsets from that group; [hi:lo] are bit positions; {n}, {i} and the like mark numbered series; 'fields as' and 'values as' point back to an identical list; <NAME> marks a mode.

## Memory map
0x1A010000 CLKCTL_SYS blocks up to offset 0x828
0x1A210000 REFCLK_CNT_READ size 0x8
0x1A220000 REFCLK_CNT_CTL size 0xA0
0x1A230000 REFCLK_CNT_BASE0 size 0x40
0x1A240000 REFCLK_CNT_BASE1 size 0x40
0x1A250000 REFCLK_CNT_BASE2 size 0x40
0x1A260000 REFCLK_CNT_BASE3 size 0x40
0x1A300000 WDT_AP_CTRL size 0xFD0
0x1A310000 WDT_AP_REFRESH size 0xFD0
0x1A320000 WDT_AP_S_CTRL size 0xFD0
0x1A330000 WDT_AP_S_REFRESH size 0xFD0
0x1A410000 S32KCLK_CNT_READ size 0x8
0x1A420000 S32KCLK_CNT_CTL size 0xA0
0x1A430000 S32KCLK_CNT_BASE0 size 0x40
0x1A440000 S32KCLK_CNT_BASE1 size 0x40
0x1A500000 IRQRTR size 0xFB4
0x1A602000 CGU size 0x2C
0x1A603000 PINMUX size 0x240
0x1A604000 AON size 0x48
0x1A609000 VBAT size 0x14
0x1A60A000 ANA size 0x44
0x1A60F000 STOP_MODE size 0x4
0x40000000 MHU_A32_M55HP_0_RX size 0x1000
0x40010000 MHU_M55HP_A32_0_TX size 0x1000
0x40020000 MHU_A32_M55HP_1_RX size 0x1000
0x40030000 MHU_M55HP_A32_1_TX size 0x1000
0x40040000 MHU_SECPU_M55HP_0_RX size 0x1000
0x40050000 MHU_M55HP_SECPU_0_TX size 0x1000
0x40060000 MHU_SECPU_M55HP_1_RX size 0x1000
0x40070000 MHU_M55HP_SECPU_1_TX size 0x1000
0x40080000 MHU_M55HE_M55HP_0_RX size 0x1000
0x40090000 MHU_M55HP_M55HE_0_TX size 0x1000
0x400A0000 MHU_M55HE_M55HP_1_RX size 0x1000
0x400B0000 MHU_M55HP_M55HE_1_TX size 0x1000
0x400C0000 DMA1_SEC size 0x1000
0x400E0000 DMA1_NS size 0x1000
0x400E1000 NPU_HP size 0x1000
0x400E2000 EVTRTR1 size 0x94
0x400F0000 M55HP_CFG size 0x14
0x40100000 WDT_HP_CTRL size 0x1000
0x40101000 WDT_HP_REFRESH size 0x1000
0x42000000 LPRTC size 0x28
0x42001000 LPTIMER size 0xC0
0x42002000 LPGPIO size 0x110
0x42003000 LPCMP size 0x4
0x42004000 BOR_BOD size 0x4
0x42007000 LPGPIO_CTRL size 0x20
0x43000000 LPSPI0 size 0xF0
0x43001000 LPI2S size 0x264
0x43002000 LPPDM size 0x7D8
0x43003000 LPCPI size 0x54
0x43004000 LPSPI1 size 0xF0
0x43005000 LPI2C1 size 0x100
0x43006000 LPI3C size 0x284
0x43007000 M55HE_CFG size 0x28
0x43008000 LPUART size 0x100
0x43009000 LPI2C0 size 0x24
0x4300A000 GPIO16 size 0x110
0x4300B000 GPIO17 size 0x110
0x4300C000 LPUTIMER size 0x10138
0x48000000 UTIMER size 0x10138
0x48100000 ETH size 0x1168
0x48102000 SDMMC size 0xF70
0x48103000 SPI0 size 0xF4
0x48104000 SPI1 size 0xF4
0x48105000 SPI2 size 0xF4
0x48106000 SPI3 size 0xF4
0x48107000 CRC0 size 0x100
0x48108000 CRC1 size 0x100
0x48200000 USB size 0xCA04
{0x49000000+0x1000*n} GPIO{n} size 0x110 (n=0..14)
0x49010000 I2C0 size 0x100
0x49011000 I2C1 size 0x100
0x49012000 I2C2 size 0x100
0x49013000 I2C3 size 0x100
0x49014000 I2S0 size 0x264
0x49015000 I2S1 size 0x264
0x49016000 I2S2 size 0x264
0x49017000 I2S3 size 0x264
{0x49018000+0x1000*n} UART{n} size 0x100 (n=0..7)
0x49020000 ADC120 size 0x74
0x49021000 ADC121 size 0x74
0x49022000 ADC122 size 0x74
0x49023000 CMP0 size 0x28
0x49024000 CMP1 size 0x28
0x49025000 CMP2 size 0x28
0x49026000 CMP3 size 0x28
0x49027000 ADC24 size 0x74
0x49028000 DAC120 size 0x8
0x49029000 DAC121 size 0x8
0x4902A000 DAC6 size 0x4
0x4902B000 ADC_VREF size 0x4
0x4902D000 PDM size 0x7D8
{0x4902E000+0x10*n} HWSEM{n} size 0xC (n=0..15)
0x4902F000 CLKCTL_PER_SLV size 0xBC
0x49030000 CPI size 0x54
0x49031000 CDC size 0x254
0x49032000 DSI size 0x194
0x49033000 CSI size 0x30C
0x49034000 I3C size 0x284
0x49035000 EVTRTR0 size 0xA0
0x49036000 CANFD size 0xD1
0x49037000 CAN_CNT size 0xC
0x4903F000 CLKCTL_PER_MST size 0xB0
0x49040000 GPU2D size 0xEC
0x49042000 NPU_HG size 0x13A0
0x49044000 JPEG size 0x800
0x49080000 DMA0_SEC size 0x1000
0x490A0000 DMA0_NS size 0x1000
0x83000000 OSPI0 size 0x14C
0x83001000 AES0 size 0x7C
0x83002000 OSPI1 size 0x14C
0x83003000 AES1 size 0x7C
0xE000E100 M55HP_NVIC_S size 0x4E0
0xE002E100 M55HP_NVIC_NS size 0x4E0

## Licence text in the file
THIS SOFTWARE IS PROVIDED "AS IS". NO WARRANTIES, WHETHER EXPRESS, IMPLIED. OR STATUTORY, INCLUDING, BUT NOT LIMITED TO, IMPLIED WARRANTIES OF. MERCHANTABILITY AND FITNESS FOR A PARTICULAR PURPOSE APPLY TO THIS SOFTWARE. ALIF SHALL NOT, IN ANY CIRCUMSTANCES, BE LIABLE FOR SPECIAL, INCIDENTAL, OR. CONSEQUENTIAL DAMAGES, FOR ANY REASON WHATSOEVER.
