## zephyr/dts/bindings/ipm/alif,secure-enclave-services.yaml
```yaml
# Copyright (c) 2026 Alp Lab AB
# SPDX-License-Identifier: Apache-2.0
#
# Secure-Enclave (SE) services channel, carried over a pair of Arm MHUv2
# mailboxes.  The Apache-2.0 hal_alif SE client
# (se_services/zephyr/src/se_service.c) DEVICE_DT_GET_OR_NULLs the two phandle
# properties below at SYS_INIT and drives them through Zephyr's IPM API (the
# alp-sdk in-tree "arm,mhuv2" driver).  Property shape matches Alif's
# zephyr_alif fork binding (the same hal_alif consumer); upstream Zephyr v4.4
# ships no such binding, so the alp-sdk carries this clean re-author.
# ADR 0017 Tier-2 (INTERIM, task #21).

description: Secure Enclave services through Arm MHUv2 on Alif Ensemble SoCs

compatible: "alif,secure-enclave-services"

include: [base.yaml]

properties:
  mhuv2-send-node:
    type: phandle
    required: true
    description: Arm MHUv2 SENDER (tx) node -- the RTSS -> SE outbound mailbox.

  mhuv2-recv-node:
    type: phandle
    required: true
    description: Arm MHUv2 RECEIVER (rx) node -- the SE -> RTSS inbound mailbox.
```

## zephyr/dts/bindings/ipm/arm,mhuv2.yaml
```yaml
# Copyright (c) 2026 Alp Lab AB
# SPDX-License-Identifier: Apache-2.0
#
# ARM Message Handling Unit v2 (MHUv2), exposed through Zephyr's IPM API.
#
# Re-authored for the alp-sdk in-tree IPM driver (zephyr/drivers/ipm/
# ipm_arm_mhuv2.c).  Property shape is identical to Alif's Apache-2.0
# zephyr_alif fork binding (dts/bindings/mhu/arm,mhuv2.yaml) -- the same SoC
# MHUv2 IP -- so the fork DT nodes bind unchanged.  Upstream Zephyr v4.4 ships
# no MHUv2 IPM driver/binding; this is the alp-sdk vendor-ext that lets the
# Secure-Enclave service client (hal_alif se_services/) reach the SE over the
# RTSS<->SE mailboxes.  ADR 0017 Tier-2 (INTERIM).

description: ARM MHUv2 (Message Handling Unit v2), exposed via the Zephyr IPM API

compatible: "arm,mhuv2"

include: [base.yaml]

properties:
  reg:
    required: true

  interrupts:
    required: true

  interrupt-names:
    required: true
    description: |
      Exactly one of 'tx' (sender-side MHU frame) or 'rx' (receiver-side MHU
      frame).  The driver keys its sender/receiver role off this name
      (DT_INST_IRQ_HAS_NAME(n, tx)): a 'tx' node is the outbound mailbox, a 'rx'
      node the inbound one.
```

## zephyr/dts/bindings/mbox/alif,mhuv2-mbox.yaml
```yaml
# Copyright 2026 Alp Lab AB
# SPDX-License-Identifier: Apache-2.0
#
# vendor-ext; bench-validated on E1M-AEN801 for the dual-M55 RPMsg path.
#
# Binding for the ARM MHUv2 (Message Handling Unit, v2) as integrated in the
# Alif Ensemble (E1/E3/E5/E7/E8) family for inter-core doorbell signalling
# (e.g. RTSS-HE <-> APSS / RTSS-HP). Each devicetree node describes exactly
# ONE MHUv2 frame -- either a sender frame or a receiver frame, selected by the
# `alif,direction` property. The driver
# (zephyr/drivers/mbox/mbox_alif_mhuv2.c) presents the standard Zephyr MBOX
# class API and operates in doorbell (signalling) mode only: no payload travels
# through the MHU itself; the OpenAMP static-vrings carry data in shared SRAM
# and the MHU only rings a per-bit doorbell.
#
# A DISTINCT compatible `alif,mhuv2-mbox` is used deliberately (NOT `arm,mhuv2`)
# so this binding never collides with the `arm,mhuv2` mhu-class binding shipped
# by the opt-in alifsemi/zephyr_alif fork; the whole stack works on the DEFAULT
# upstream-Zephyr + hal_alif base with no fork.
#
# The single mbox cell is the doorbell BIT INDEX (0..31) inside channel-window 0
# of the frame. We use window 0 only. This is intentionally NOT the Linux
# 2-cell `arm,mhuv2` form (Linux encodes <channel-window doorbell>); Zephyr's
# MBOX API addresses a single uint32_t channel id, which here maps to the bit.
#
# Register offsets and the AEN dual-M55 node addresses/IRQs were transcribed
# from the ARM MHUv2 spec (DDI 0515) and the alifsemi/zephyr_alif fork's
# dts/arm/alif/ensemble/common/e1.dtsi. The E1M-AEN801 bench validated the
# driver with OpenAMP RPMsg on 2026-06-19 (#225).

description: |
  ARM MHUv2 inter-core mailbox frame as integrated in Alif Ensemble.
  vendor-ext -- authored from the ARM MHUv2 register spec and the
  alifsemi/zephyr_alif fork DTS; bench-validated on E1M-AEN801 for the
  dual-M55 RPMsg path.

  One node = one MHUv2 frame (sender OR receiver). #mbox-cells = <1>, the cell
  being the doorbell bit index (0..31) in channel-window 0.

  Example:

    mhu_he_rx: mhu@400a0000 {
        compatible = "alif,mhuv2-mbox";
        reg = <0x400A0000 0x1000>;
        interrupts = <43 3>;
        alif,direction = "rx";
        #mbox-cells = <1>;
        status = "okay";
    };

    mhu_he_tx: mhu@400b0000 {
        compatible = "alif,mhuv2-mbox";
        reg = <0x400B0000 0x1000>;
        alif,direction = "tx";
        #mbox-cells = <1>;
        status = "okay";
    };

compatible: "alif,mhuv2-mbox"

include: [base.yaml, "mailbox-controller.yaml"]

properties:
  reg:
    required: true
    description: |
      Base address and size (0x1000) of this MHUv2 frame's register window.

  interrupts:
    description: |
      Combined doorbell interrupt for a receiver frame. Required when
      `alif,direction = "rx"`; omitted for sender frames (which never take an
      interrupt in doorbell mode).

  alif,direction:
    type: string
    required: true
    enum:
      - "tx"
      - "rx"
    description: |
      Role of this frame.
        - "tx": sender frame. Implements `send` (rings the doorbell via CH_SET)
          and performs the ACCESS_REQUEST/ACCESS_READY wake handshake. No
          callback, no interrupt.
        - "rx": receiver frame. Implements `register_callback` + `set_enabled`
          (UNMASK/MASK), services the doorbell IRQ, and acks via CH_CLEAR.
          `interrupts` is required for this role.

mbox-cells:
  - channel
```

## zephyr/dts/bindings/mbox/renesas,rz-mhu-b-mbox.yaml
```yaml
# Copyright 2026 Alp Lab AB
# SPDX-License-Identifier: Apache-2.0
#
# vendor-ext (alp-sdk #683); BENCH-UNVERIFIED.
#
# Renesas RZ MHU-B mailbox controller, as found on RZ/V2N (R9A09G056).  MHU-B is
# NOT the plain linear MHU the upstream `renesas,rz-mhu-mbox` binding + driver
# (zephyr/drivers/mbox/mbox_renesas_rz_mhu.c, FSP r_mhu_ns) implement: it is a
# 42-slot register crossbar (hal_renesas
# drivers/rz/fsp/src/rzv/bsp/mcu/rzv2n/bsp_mhu_b.h) where only channels
# {5, 11, 17, 23} are valid on this core and the send/receive directions of a
# channel live in DIFFERENT physical register blocks.  A distinct compatible is
# used (NOT `renesas,rz-mhu-mbox`) so this binding never collides with a real
# plain-MHU node; the driver is
# zephyr/drivers/mbox/mbox_renesas_rz_mhu_b.c, backed by the vendored FSP port
# zephyr/drivers/mbox/r_mhu_b_ns/r_mhu_b_ns.c (see that file's header for the
# register-semantic notes and the one send_type derivation this port infers).
#
# `channel` is the FSP/hardware MHU-B channel (5, 11, 17 or 23), NOT the MBOX
# API channel_id `tx-mask`/`rx-mask`/`#mbox-cells` address (that pair of
# software channel IDs rides on top of this single hardware channel's
# MSG/RSP halves, exactly like the plain-MHU binding).

description: Renesas RZ MHU-B mailbox (RZ/V2N and later "B"-generation MHU)

compatible: "renesas,rz-mhu-b-mbox"

include: [base.yaml, mailbox-controller.yaml]

properties:
  channel:
    type: int
    required: true
    description: |
      FSP/hardware MHU-B channel number for the underlying MHU-B unit used for
      MBOX.  Must be one of {5, 11, 17, 23} on rzv2n
      (BSP_FEATURE_MHU_B_NS_VALID_CHANNEL_MASK); any other value is rejected by
      R_MHU_B_NS_Open().

  reg:
    required: true
    description: |
      Base address of this channel's SEND register block (the pair-body's
      send slot -- see bsp_mhu_b.h R_BSP_MHU_B_NS_REG_PAIR_BODY).  The
      driver does not read this property at runtime: it resolves BOTH the
      send and the (possibly different) receive register block itself from
      the pair-body table by `channel` number.  Kept here for documentation
      and because the binding schema requires it.

  interrupts:
    required: true
    description: |
      The receive-side interrupt for this channel's role (bsp_irq_id.h
      MHU_MSGn_NS_IRQn or MHU_RSPn_NS_IRQn).  The driver derives send_type
      (MSG-role vs RSP-role) by matching this against bsp_mhu_b.h's
      per-channel SEND_TYPE_MSG_BODY / SEND_TYPE_RSP_BODY IRQ tables.

  tx-mask:
    type: int
    required: true
    description: TX supported channels mask

  rx-mask:
    type: int
    required: true
    description: RX supported channels mask

  channels-count:
    type: int
    required: true
    description: number of channels supported for a MBOX instance.

  shared-memory:
    type: phandle
    description: |
      Reference to the shared memory region that is going
      to be used for the buffer communication between
      MHU units. No data will be transmitted if not set.

mbox-cells:
  - channel
```

## zephyr/dts/bindings/mdio/snps,designware-mdio.yaml
```yaml
# Copyright 2026 Alp Lab AB
# SPDX-License-Identifier: Apache-2.0
#
# Clause-22 MDIO bus embedded in the Synopsys DesignWare GMAC (Alif Ensemble
# alif,ethernet). No `reg` here: MAC_MDIO_Address/Data are MAC-relative
# offsets 0x200/0x204, resolved by the driver from the parent node's `reg`.
# Driver: zephyr/drivers/ethernet/mdio/mdio_dwmac_alif.c.

description: Synopsys DesignWare GMAC embedded MDIO controller (Clause 22)

compatible: "snps,designware-mdio"

include: mdio-controller.yaml
```

## zephyr/dts/bindings/memory-controllers/alif,dtcm.yaml
```yaml
# Copyright (c) 2026 Alp Lab AB
# SPDX-License-Identifier: Apache-2.0
#
# Alif Ensemble RTSS-core DTCM (Data Tightly Coupled Memory).
#
# Re-authored in alp-sdk (config, not Alif driver code) to add the
# `global_base` property that hal_alif's soc_memory_map.h local_to_global()
# consumes -- DT_PROP(DT_NODELABEL(dtcm), global_base).  See the sibling
# alif,itcm.yaml header for the full rationale.  DTCM global view =
# 0x58800000 on the E8 RTSS-HE (from the fork ensemble_rtss_he.dtsi).
#
# ADR 0017 Tier-1.5 (in-tree thin glue over the upstream/hal base).

description: Alif Ensemble RTSS-core DTCM (Data Tightly Coupled Memory)

compatible: "alif,dtcm"

include: [base.yaml, "zephyr,memory-region.yaml"]

properties:
  reg:
    required: true
  global_base:
    required: true
    type: int
    description: |
      Global (system-bus) base address of the DTCM as seen by other bus
      masters (e.g. the Ethos-U NPU's AXI master), used by
      soc_memory_map.h local_to_global() to translate a CPU-local DTCM
      pointer into the address the NPU must be programmed with.
```

## zephyr/dts/bindings/memory-controllers/alif,itcm.yaml
```yaml
# Copyright (c) 2026 Alp Lab AB
# SPDX-License-Identifier: Apache-2.0
#
# Alif Ensemble RTSS-core ITCM (Instruction Tightly Coupled Memory).
#
# Re-authored in alp-sdk (config, not Alif driver code) to add the
# `global_base` property that hal_alif's soc_memory_map.h local_to_global()
# consumes -- DT_PROP(DT_NODELABEL(itcm), global_base).  Upstream Zephyr's
# arm,itcm binding has no such property, so an itcm node compatible with
# "arm,itcm" cannot carry global_base and the Ethos-U address-remap glue
# (ethosu_callback.c) fails to compile.  The Apache-2.0 zephyr_alif fork
# carries an equivalent alif,itcm binding (dts/bindings/arm/alif,itcm.yaml);
# this mirror lets the same itcm node bind on the upstream-Zephyr + hal_alif
# base.  The app overlay re-`compatible`s the board's arm,itcm node onto this
# binding and sets global_base (ITCM global view = 0x58000000 on the E8 RTSS-HE,
# from the fork ensemble_rtss_he.dtsi).
#
# ADR 0017 Tier-1.5 (in-tree thin glue over the upstream/hal base).

description: Alif Ensemble RTSS-core ITCM (Instruction Tightly Coupled Memory)

compatible: "alif,itcm"

include: [base.yaml, "zephyr,memory-region.yaml"]

properties:
  reg:
    required: true
  global_base:
    required: true
    type: int
    description: |
      Global (system-bus) base address of the ITCM as seen by other bus
      masters (e.g. the Ethos-U NPU's AXI master), used by
      soc_memory_map.h local_to_global() to translate a CPU-local ITCM
      pointer into the address the NPU must be programmed with.
```

## zephyr/dts/bindings/misc/alif,hwsem.yaml
```yaml
# Copyright 2026 Alp Lab AB
# SPDX-License-Identifier: Apache-2.0
#
# vendor-ext, BENCH-UNVERIFIED.
#
# Binding for ONE Alif Ensemble hardware-semaphore (HWSEM) instance, used to
# arbitrate a shared resource between the two RTSS cores (M55-HE <-> M55-HP) in
# AMP -- a mutual-exclusion primitive that survives the lack of cache coherency
# and needs no spin-loop in shared SRAM. The Ensemble exposes 16 independent
# HWSEM instances (HWSEM0..15), one per node; each is an atomic
# request/release latch keyed by a per-core MASTER ID. The driver
# (zephyr/drivers/misc/alif_hwsem/hwsem_alif.c) presents a tiny take/give API
# (NOT a standard Zephyr device-class API -- HWSEM has no upstream class), so
# the node is a bare register window with no bus, clocks, or pinctrl.
#
# A DISTINCT compatible `alif,hwsem` is used deliberately so this binding never
# collides with the `arm,*`/`snps,*` semaphore bindings and the stack builds on
# the DEFAULT upstream-Zephyr + hal_alif base with no fork.
#
# Register layout and the E8 node addresses were transcribed clean-room from the
# Alif DFP HWSEM register header (drivers/include/hwsem.h, struct HWSEM_Type)
# and the per-instance bases in Device/soc/AE822FA0E5597/include/rtss_he/soc.h
# (HWSEM0_BASE 0x4902E000 .. HWSEM15_BASE 0x4902E0F0, stride 0x10). They have
# NOT been validated on real silicon.

description: |
  Alif Ensemble hardware semaphore (HWSEM) -- one node = one of the 16 HWSEM
  instances. An atomic request/release latch arbitrating a shared resource
  between the two RTSS cores (M55-HE <-> M55-HP) under AMP. The take/give pair
  is keyed by the caller's MASTER ID (the core's CPUID, e.g. 0x410FD222 for
  RTSS-HE, 0x410FD221 for RTSS-HP), so a release only succeeds for the owner.

  vendor-ext, BENCH-UNVERIFIED -- authored from the Alif DFP HWSEM register
  header; not yet run on silicon.

  Example (HWSEM0 at 0x4902E000):

    hwsem0: hwsem@4902e000 {
        compatible = "alif,hwsem";
        reg = <0x4902e000 0x10>;
        status = "okay";
    };

compatible: "alif,hwsem"

include: [base.yaml]

properties:
  reg:
    required: true
    description: |
      Base address and size (0x10) of this HWSEM instance's register window.
      The three registers (REQ +0x00, REL +0x04, RST +0x08) occupy 0x0C; the
      instance stride is 0x10 (the next instance begins at +0x10).
```
