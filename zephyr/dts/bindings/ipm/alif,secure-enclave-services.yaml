## zephyr/dts/bindings/ospi/snps,designware-ospi.yaml
```yaml
# Copyright (C) 2024 Alif Semiconductor.
# Copyright (c) 2026 Alp Lab AB
#
# SPDX-License-Identifier: Apache-2.0
#
# ADR 0017 Tier-1.5 (in-tree thin driver over an Apache-2.0 hal_alif HW
# library) -- HW-BLOCKED, BUILD-ONLY this batch.  Vendored VERBATIM (below the
# provenance header) from the Apache-2.0 zephyr_alif fork
# (dts/bindings/ospi/snps,designware-ospi.yaml, HEAD da4a9034) -- the
# properties (aes-reg, bus-speed, cs-pin, ddr-drive-edge, rx-ds-delay,
# xip-wait-cycles, xip-base-address, baud2-delay) map 1:1 onto the hal_alif
# `struct ospi_init` config fields (modules/hal/alif drivers/ospi/include/
# ospi_hal.h), which is why this binding is vendored rather than re-derived.
# Bound in-tree by zephyr/drivers/flash/flash_ospi_alif.c.
#
# The E1M-AEN801 (Ensemble E8) has no octal-NOR/HyperBus part populated this
# hardware batch, so this only proves the ospi0 node BINDS + the hal_alif
# init/XiP-enable entry points compile and link (see
# examples/aen/aen-ospi-regcheck).  See docs/adr/0017-alp-sdk-over-the-vendor-sdk.md.
#
# Vendored VERBATIM from here down (no functional edits).

description: Synopsys Designware OSPI controller

compatible: "snps,designware-ospi"

include: [base.yaml, pinctrl-device.yaml]

properties:
  reg:
    required: true

  interrupts:
    required: true

  pinctrl-0:
    required: true

  pinctrl-names:
    required: true

  aes-reg:
    type: array
    description: register space
    required: true

  bus-speed:
    type: int
    required: true
    description: speed

  clock-frequency:
    type: int
    description: |
      Input clock frequency

  cs-pin:
    type: int
    description: slave connected pin
    required: true

  ddr-drive-edge:
    type: int
    description: control the driving edge of TXD in DDR mode
    default: 1

  rx-ds-delay:
    type: int
    description: receive datastrobe delay
    default: 16

  tx-fifo-threshold:
    type: int
    description: transmit fifo threshold
    default: 128

  xip-wait-cycles:
    type: int
    description: waitcycles on XiP transaction
    default: 16

  xip-rxds-vl-en:
    type: boolean
    description: Enable/Disable RXDS Variable Latency on XiP transaction

  xip-base-address:
    type: array
    description: XiP memory address range

  baud2-delay:
    type: int
    description: Enable/disable BAUD2 delay. This needs to be enabled when BAUDR divisor is 2.
                 Enumerated values
                 0 - disable BAUD2 delay
                 1 - enable BAUD2 delay
                 2 - auto sets BAUD2 delay when BAUDR divisor is 2
    default: 2
    enum:
      - 0
      - 1
      - 2
```

## zephyr/dts/bindings/spi/alif,dwc-ssi-spi.yaml
```yaml
# Copyright (c) 2018 Synopsys, Inc. All rights reserved.
# Copyright (c) 2024 Alif Semiconductor
# Copyright (c) 2026 Alp Lab AB
# SPDX-License-Identifier: Apache-2.0

description: |
  Alif Ensemble DesignWare DWC_ssi SPI controller.

  Distinct compatible (NOT "snps,designware-spi") so the alp-sdk vendored
  DWC-SSI driver (zephyr/drivers/spi/spi_dw_alif.c, ported from the Apache-2.0
  zephyr_alif fork) binds instead of upstream Zephyr's DW-apb-SSI spi_dw, which
  owns "snps,designware-spi" and would double-instantiate. The Ensemble SPI IP
  is DWC_ssi, whose CTRLR0 bit layout differs from DW-apb-SSI -- set `dwc-ssi`.

  ADR 0017 Tier-2 (a genuine fork-driver copy -- hal_alif ships no SSI library):
  INTERIM. Retires onto the opt-in sdk-alif fork once `spi0` is repointed to the
  fork compatible AND bench-verified; a pure-Tier-1 end-state is one upstream
  patch away (SSI_IS_MST, CTRLR0[31], under CONFIG_SPI_DW_HSSI). See docs/adr/0017
  + task #21. BENCH-UNVERIFIED.

compatible: "alif,dwc-ssi-spi"

include: [spi-controller.yaml, pinctrl-device.yaml]

properties:
  reg:
    required: true

  interrupts:
    required: true

  dwc-ssi:
    type: boolean
    description: |
      Select the DWC_ssi register layout (CTRLR0 bit positions) instead of the
      legacy DW_apb_ssi layout. The Ensemble on-AHB SPIs are DWC_ssi, so set
      this; leaving it off silently uses the DW-apb layout and mis-programs the
      controller.

  aux-reg:
    type: boolean
    description: Auxiliary-register access mode. Default off for the Ensemble.

  fifo-depth:
    type: int
    default: 16
    description: |
      RX/TX FIFO depth (SSI_{TX,RX}_FIFO_DEPTH). Override per the Alif TRM for
      the specific instance; 16 is a safe overridable default, not an
      authoritative silicon value.

  max-xfer-size:
    type: int
    default: 16
    description: |
      Frame size (SPI_MAX_XFER_SIZE); only 16 or 32 are valid. Override per the
      TRM; 16 is a conservative overridable default.
    enum:
      - 16
      - 32

  rx-delay:
    type: int
    default: 0
    description: |
      SPI_CLK cycles to delay before sampling RxD. 0 = no delay (reset default);
      raise per the TRM / board signal integrity if needed.

  serial-target:
    type: boolean
    description: |
      True if this instance is a serial target (slave); false (default) =
      serial master (SSI_IS_MASTER).

  slv-slct-toggle:
    type: boolean
    description: |
      Toggle the chip-select line between consecutive data frames.
```

## zephyr/dts/bindings/spi/renesas,rz-sci-b-spi.yaml
```yaml
# Copyright (c) 2026 Alp Lab AB
# SPDX-License-Identifier: Apache-2.0

description: |
  Renesas RZ SCI-B Simple-SPI controller (new-generation RZ MPUs: RZ/V2N, ...).

  An SCI channel running in clock-synchronous "Simple SPI" mode.  This node is a
  child of the SoC sci<N> node (compatible "renesas,rz-sci-b"); the PARENT
  supplies reg, channel, the fixed rxi/txi/tei/eri interrupt vectors and the
  pin-control state, while this child carries the SPI-controller framework
  (chip-select GPIOs + child-device addressing).

  Master mode has NO hardware slave-select on the SCI (CCR0.SSE applies to slave
  mode only), so the chip-select must be wired as a GPIO via cs-gpios.

  Example (GD32 supervisor fast path on SCI7, P76/P77/P96 + GPIO CS on P97):

    &sci7 {
        pinctrl-0 = <&sci7_spi_pins>;
        pinctrl-names = "default";
        status = "okay";

        spi7: spi {
            compatible = "renesas,rz-sci-b-spi";
            #address-cells = <1>;
            #size-cells = <0>;
            cs-gpios = <&gpio9 7 GPIO_ACTIVE_LOW>;
            status = "okay";
        };
    };

compatible: "renesas,rz-sci-b-spi"

include: [spi-controller.yaml]

properties:
  cs-gpios:
    required: true
    description: |
      Chip-select GPIO(s).  REQUIRED on this controller: the SCI in master
      Simple-SPI mode has no hardware slave-select at all (CCR0.SSE is a
      slave-mode feature), so without a GPIO CS the peripheral cannot frame
      transactions and slaves that latch on CS edges (e.g. the GD32 bridge's
      NSS/EXTI) never synchronize.  Omitting it is always a board-porting bug.
```

## zephyr/dts/bindings/spi/renesas,rz-spi-b.yaml
```yaml
# Copyright (c) 2026 Alp Lab AB
# SPDX-License-Identifier: Apache-2.0

description: |
  Renesas RZ SPI_B (RSPI) controller (new-generation RZ MPUs: RZ/V2N, RZ/V2H).

  Example:

    &spi1 {
        compatible = "renesas,rz-spi-b";
        reg = <0x42800400 0x400>;
        channel = <1>;
        clk-src = <1>;
        interrupts = <456 1>, <457 1>, <110 1>, <109 1>;
        interrupt-names = "rxi", "txi", "tei", "eri";
        pinctrl-0 = <&spi1_pins>;
        pinctrl-names = "default";
        status = "okay";
    };

compatible: "renesas,rz-spi-b"

include: [spi-controller.yaml, pinctrl-device.yaml]

properties:
  reg:
    required: true

  channel:
    type: int
    required: true

  clk-src:
    type: int
    required: true
    enum: [0, 1]
    description: |
      Communication clock source used for the bitrate calculation:
        - 0: SCISPICLK
        - 1: PCLK (P4CLK on RZ/V2N)

  interrupts:
    required: true

  interrupt-names:
    required: true

  pinctrl-0:
    required: true

  pinctrl-names:
    required: true
```

## zephyr/dts/bindings/timer/alif,utimer.yaml
```yaml
# Copyright (c) 2024 Alif Semiconductor
#
# SPDX-License-Identifier: Apache-2.0

description: Alif Universal Timer

compatible: "alif,utimer"

include: [base.yaml]

properties:
  reg:
    required: true

  reg-names:
    required: true

  timer-id:
    type: int
    description: |
      Channel number for each channel

  counter-direction:
    type: int
    required: true
    description: |
      Sets timer counter direction.

      Use constants defined in dt-bindings/timer/alif_utimer.h.

      * ALIF_UTIMER_COUNTER_DIRECTION_UP           - used as up counter.
      * ALIF_UTIMER_COUNTER_DIRECTION_DOWN         - used as down counter.
      * ALIF_UTIMER_COUNTER_DIRECTION_TRIANGLE     - used as triangle counter.

  clock-frequency:
    type: int
    description: |
      UTIMER counter tick rate in Hz.  This is the source for the Zephyr
      counter_config_info.freq field used by counter_us_to_ticks().

      The fork's ALIF_UTIMER_CLK is a frequency-only dummy with no rate the
      Zephyr clock controller can report, so the rate is carried here as a
      board/overlay property.  The counter_alif_utimer driver defaults to
      100000000 (100 MHz) when this is absent; confirm the real rate against
      the Alif Ensemble TRM at bench bring-up.
```

## zephyr/dts/bindings/usb/alif,dwc2-uhc.yaml
```yaml
# Copyright 2026 Alp Lab AB
# SPDX-License-Identifier: Apache-2.0
#
# Alif Ensemble DWC2 USB controller in host (UHC) mode.
#
# "alif,dwc2-uhc" shares the same Synopsys DWC2 silicon as the device-mode
# "snps,dwc2" binding; the distinct compatible keeps the host (UHC-class) and
# device (UDC-class) drivers collision-free so both can coexist in a DT that
# exposes both controllers.
#
# NOTE: no "uhc.yaml" base exists in Zephyr 4.4.  The usb-controller.yaml
# base (used by all NXP and virtual UHC bindings) provides maximum-speed
# (full enum incl. super-speed), vbus-gpios, and bus: usb.
# The Alif DWC2 is a HS-capable OTG core; set maximum-speed = "high-speed"
# in the board DT node (or leave it to the driver default).

description: Alif Ensemble DWC2 USB controller in host (UHC) mode

compatible: "alif,dwc2-uhc"

include: [usb-controller.yaml]

properties:
  reg:
    required: true

  interrupts:
    required: true
```

## zephyr/dts/bindings/usb/alif,xhci-uhc.yaml
```yaml
# Copyright 2026 Alp Lab AB
# SPDX-License-Identifier: Apache-2.0
#
# Alif Ensemble USB controller (DWC3-family xHCI USB-2.0) in host mode.
#
# NOTE: no "uhc.yaml" base exists in Zephyr 4.4.  The usb-controller.yaml
# base provides maximum-speed, vbus-gpios, and bus: usb (used by NXP UHC
# bindings as the closest existing ancestor).
# The Alif Ensemble USB IP is an xHCI USB-2.0 dual-role controller (DWC3-
# family) @ 0x48200000 / IRQ 101 (AE402FA0E5597 DFP soc.h).

description: Alif Ensemble USB controller (DWC3-family) in xHCI host mode

compatible: "alif,xhci-uhc"

include: [usb-controller.yaml]

properties:
  reg:
    required: true
  interrupts:
    required: true
```
