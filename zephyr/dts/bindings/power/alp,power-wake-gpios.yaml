## zephyr/dts/bindings/video/snps,designware-csi.yaml
```yaml
# Copyright (C) 2024 Alif Semiconductor
# Copyright (c) 2026 Alp Lab AB
# SPDX-License-Identifier: Apache-2.0

description: MIPI CSI-2 controller IP used by Alif SoC.

compatible: "snps,designware-csi"

include: base.yaml

properties:
  interrupts:
    required: true

  data-lanes1:
    type: int
    default: 2
    description:
      Number of data lanes for PHY-1
    enum: [1, 2]

  data-lanes2:
    type: int
    default: 2
    description:
      Number of data lanes for PHY-2
    enum: [1, 2]

  phy-if:
    type: phandle-array
    required: true
    specifier-space: dphy
    description:
      Handle to the PHY interface.

  ipi-mode:
    type: string
    required: false
    default: "Camera"
    description: |
      Video mode transmission type.
    enum: ["Camera", "Controller"]

  csi-vsa:
    type: int
    required: false
    description: |
      The Vertical Synchronism Active time in Horizontal lines.

  csi-vbp:
    type: int
    required: false
    description: |
      The Vertical back porch time in Horizontal lines.

  csi-vfp:
    type: int
    required: false
    description: |
      The Vertical front porch time in Horizontal lines.

  csi-vact:
    type: int
    required: false
    description: |
      The vertical active period time in number of Horizontal lines.

  csi-hsa:
    type: int
    required: false
    description: |
      The Horizontal Synchronism Active time in PIXCLK.

  csi-hbp:
    type: int
    required: false
    description: |
      The Horizontal back porch time in PIXCLK.

  csi-hsd:
    type: int
    required: false
    description: |
      The Horizontal synch porch time in PIXCLK.

  csi-hact:
    type: int
    required: false
    description: |
      The Horizontal active time in PIXCLK.

  csi-hline:
    type: int
    required: false
    description: |
      Issue #2287 Stage B. Optional, Controller-mode only ("csi-ipi-mode" =
      "Controller"): total IPI line length in PIXCLK, i.e. what the sensor's
      own line time (its HMAX-derived 1H period) works out to once
      re-expressed in this controller's pixel clock -- csi-hsa + csi-hbp +
      csi-hsd + csi-hact. When present, csi-hsd is DERIVED from it at
      configure time (hsd = csi-hline - csi-hsa - csi-hbp - hact, where hact
      is the format's own active width, not a fixed DT value) instead of
      read as a fixed csi-hsd property -- csi-hsd is IGNORED (overridden by
      the derivation) whenever csi-hline is set, whether or not csi-hsd
      itself is also present in DT (a shared base dtsi may set csi-hsd
      unconditionally for every board on this controller, in which case
      there is no "unset" state to omit it into -- the override still
      applies). This is what keeps the derived Controller-mode timing
      correct across every format a sensor can select (e.g. a sensor with a
      cropped ROI mode alongside its full-frame mode -- see
      raspberry_pi_global_shutter_camera.overlay's own comment) where a
      single fixed csi-hsd, swept for only one of those formats, would
      otherwise silently mistime every other one. Requires csi-vtotal to
      also be set (the two are configured as a pair); leaving one but not
      the other set is a devicetree authoring mistake this binding does not
      itself reject.

  csi-vtotal:
    type: int
    required: false
    description: |
      Issue #2287 Stage B. Optional, Controller-mode only, pairs with
      csi-hline above: total number of lines per frame in the sensor's own
      timing (its VMAX in master mode) -- csi-vsa + csi-vbp + csi-vfp +
      csi-vact. When present, csi-vfp is DERIVED from it at configure time
      (vfp = csi-vtotal - csi-vsa - csi-vbp - vact, where vact is the
      format's own active height) instead of read as a fixed csi-vfp
      property -- csi-vfp is IGNORED (overridden) the same way csi-hsd is,
      see csi-hline's description above (including for a shared base dtsi
      that sets csi-vfp unconditionally). See csi-hline's description above
      for why deriving from a format-independent total (rather than a
      per-format fixed value) is what this property exists for.

  csi-pixclk-hz:
    type: int
    required: false
    description: |
      Issue #2327. Optional, effective in EITHER "ipi-mode": the IPI pixel
      clock rate to request, in Hz, REPLACING csi2_dw_validate_data()'s
      (video_csi_dw.c) normal request for that mode -- Controller mode's
      bare derived pixel rate, or Camera mode's 20%-margined one (pll_fin * 2
      * lanes / bpp [* 1.2 in Camera mode], no bandwidth margin in Controller
      mode -- see that function's own comments on each branch). Both of those
      normal requests assume the reachable clock-control divisor they land on
      happens to keep the IPI line time close to the sensor's own line time
      -- true for IMX296's Controller-mode bare rate (118.8 MHz -> 133.33 MHz,
      raspberry_pi_global_shutter_camera.overlay's own comment walks through
      the margin this leaves), but not guaranteed for every sensor: a 2-lane
      sensor's bare OR margined rate can exceed the pixel-clock divider's
      reachable range outright (alif_pixclk_set_rate() rejects above ~200 MHz
      with -ERANGE) in EITHER mode -- IMX335's own case, bench runs 316-330:
      its Camera-mode margined request (285.12 MHz) and even its bare one
      (237.6 MHz) both exceed the ceiling, and its measured line timing could
      not be matched in Controller mode either (see
      innomaker_cam_imx335.overlay), so the shield states its own intended
      IPI pixel clock explicitly under Camera mode instead. When absent (0),
      behaviour is byte-identical to before this property existed in either
      mode: the bare (Controller) or margined (Camera) derived pixrate is
      requested exactly as before. In Camera mode, an explicit csi-pixclk-hz
      also changes the HSD derivation (csi2_dw_validate_data()'s CAM branch)
      to a lanes-aware formula -- see that branch's own comment; the legacy,
      lanes-omitting formula is UNCHANGED when this property is absent, since
      OV5647/OV9281 are both bench-proven against it. In Controller mode,
      csi-hline / csi-vtotal are ALSO required in practice for this property
      to be meaningful (the IPI timing is only meaningful once its drain rate
      is one this property, not the derivation, controls) -- Camera mode
      never uses csi-hsa/csi-hbp/csi-hline/csi-vsa/csi-vbp/csi-vtotal at all
      (csi2_dw_validate_data()'s CAM branch always derives hsa/hbp/vsa/vbp/vfp/
      vact itself); this binding does not itself enforce either pairing.

      Practical ceiling: ~200 MHz. This is alif_pixclk_set_rate()'s own
      reachable-divisor limit off its 400 MHz source (divisor 2), not a limit
      this property enforces itself -- a value above that is a shield
      authoring mistake and fails the build's clock_control_set_rate() call
      at runtime with an explicit LOG_ERR naming this property, not a
      silent fallback to the derived bare/margined pixrate (see
      csi2_dw_validate_data()'s own comment on that -ERANGE path), in EITHER
      ipi-mode.

  ipi-fs-sync:
    type: boolean
    description: |
      Issue #2287 Stage B (bench runs 304-306, E1M-AEN803 2026W36-0001): sets
      CSI_IPI_ADV_FEATURES_SYNC_EVENT (bit 24, csi2_dw_ipi_advanced_features()
      in video_csi_dw.c) instead of clearing it -- re-locks the IPI's frame
      boundary to the CSI-2 protocol's own Frame Start short packet on every
      frame, instead of the controller inferring frame boundaries purely from
      the video-packet stream (this bit's default, cleared, state). Runs
      304-306's multi-frame ROI capture through the ISP (the first workload to
      stream continuously in DW CSI-2 Controller-timing mode, derived hsd 679/
      vfp 153) showed a captured frame straddling what looks like two sensor
      frames -- a real scene visible only in one horizontal band, the rest
      horizontally-streaky texture not matching the scene, the band's row
      range differing per run (run 307: rows 0-255 plus a thin strip at the
      bottom; run 308: rows 832-895 -- the band MOVED between runs, not a
      fixed offset). Bench run C5 isolated this property against the
      symptom (build with it enabled, run 308) and found NO effect --
      GAINDLY (build C4) was isolated the same way, also no effect. The
      ACTUAL cause (bench runs 309/310, see changelog.d/2287.md) was a race
      in alif_cam_work_helper()'s own CPI re-arm timing (video_alif.c),
      fixed by moving CPI re-arm responsibility to the ISP -- this property
      is NOT implicated. Kept as a real, working, still-untested-against-any-
      symptom capability (isolating one variable at a time was the right
      call even though this one came back negative) -- NOT enabled on any
      shield. Optional, default false (unchanged controller behaviour).

  rx-ddr-clk1:
    type: int
    required: false
    default: 400000000
    description: |
      The value of RX DDR Lane Clock coming from CMOS sensor to RX D-PHY and
      to MIPI-CSI IP as RXBYTECLKHS. This is the clock value from DPHY ID 0.

  rx-ddr-clk2:
    type: int
    required: false
    default: 400000000
    description: |
      The value of RX DDR Lane Clock coming from CMOS sensor to RX D-PHY and
      to MIPI-CSI IP as RXBYTECLKHS. This is the clock value from DPHY ID 1.

child-binding:
  child-binding:
    child-binding:
      include: video-interfaces.yaml
      properties:
        reg:
          type: int
          enum:
            - 0 # Selfie Camera EP
            - 1 # Standard Camera EP
            - 2 # CPI EP
          description: Endpoints to Selfie and Standard can be used.
            Only one of these EPs are supported by CSI to transfer data to CPI.
            Though, multiple cameras can be configured simultaneously.
```

## zephyr/dts/bindings/video/sony,imx296.yaml
```yaml
# Copyright 2026 Alp Lab AB
#
# SPDX-License-Identifier: Apache-2.0
#
# ADR-0017-ADJACENT (authored from the Sony IMX296 datasheet), PARTIALLY
# BENCH-VERIFIED (I2C identity only -- issue #2287, bench run 229). Shaped
# after upstream's dts/bindings/video/sony,imx219.yaml (i2c-device.yaml
# + a video-interfaces.yaml endpoint child), mirroring
# zephyr/dts/bindings/video/ovti,ov9281.yaml's `clocks: required: true`. See
# zephyr/drivers/video/imx296.c for the datasheet-section citations and
# retirement note.

description: |
  Sony IMX296 1.58 MP global-shutter image sensor

  A raw Bayer (colour) or mono global-shutter image sensor with a single-lane
  MIPI CSI-2 image data interface and a CCI (I2C compatible) control bus.
  Only All-pixel scan mode is supported: 1456x1088 RAW10 (the whole
  effective array as transmitted; 1440x1080 is the recommended recording
  crop inside it), 1 data lane, 37.125 / 54 / 74.25 MHz INCK.

compatible: "sony,imx296"

include: i2c-device.yaml

properties:
  clocks:
    description: |
      Reference to the INCK clock, which must be 37.125 MHz, 54 MHz or
      74.25 MHz -- see zephyr/drivers/video/imx296.c.
    required: true

child-binding:
  child-binding:
    include: video-interfaces.yaml
    properties:
      no-lp11-clock-lane-park:
        type: boolean
        description: |
          DATASHEET-INFERRED, NOT BENCH-MEASURED (issue #2287): this
          driver's imx296_init() leaves the sensor in STANDBY -- no MIPI
          output at all, so no LP-11 -- and this datasheet documents no
          register that forces the CLOCK lane to Stop-state (LP-11) short
          of exiting STANDBY into full master-mode streaming (XMSTA), the
          same shape as OV5647 issue #2248, which that driver fixes with an
          explicit lane-park sequence
          (zephyr/drivers/video/ov5647.c, ov5647_lane_park()) this sensor
          has no equivalent registers for. Setting this bool on the
          sensor's OWN CSI-2 endpoint (not the host's `&csi_ep_in`) tells
          zephyr/drivers/mipi_dphy/dphy_dw.c's dphy_dw_slave_setup() to
          skip only the CLOCK-lane Stop-state bit
          (CSI_PHY_STOPSTATE_PHY_STOPSTATECLK) in its bounded wait for this
          sensor -- the DATA-lane Stop-state bit and the wait's timeout
          stay fatal, for this sensor and every other. Set only in
          raspberry_pi_global_shutter_camera.overlay; do not set it on a
          sensor whose driver already guarantees LP-11 (OV5647, OV9281).
```
