## zephyr/dts/bindings/power/alp,power-wake-gpios.yaml
```yaml
# Copyright 2026 Alp Lab AB
# SPDX-License-Identifier: Apache-2.0
#
# alp,power-wake-gpios -- the application's LPGPIO pads that may wake the Alif
# Ensemble E8 from STOP / STANDBY (ALP_POWER_WAKE_GPIO, alp-sdk#2784).  Read by
# src/backends/power/alif_se_power_hw.c; nothing in the public <alp/power.h>
# names a pad, the devicetree does.

description: |
  Wake pads for ALP_POWER_WAKE_GPIO on the Alif SE STOP / STANDBY backend.

  Only pads of the `lpgpio` controller (P15_n = line n) qualify: the LPGPIO island is in
  the VBAT domain and stays powered through STOP.  The polarity flag of each entry is the
  ASSERTED level, so GPIO_ACTIVE_LOW wakes on a falling edge and GPIO_ACTIVE_HIGH on a
  rising edge.  A pad the SoM itself wires (the power-domain pads P15_0, P15_1, P15_4 ..
  P15_7 and the OSPI INTn nets P15_2 / P15_3 on the E1M-AEN801 / E1M-AEN803) is refused at
  run time: ALP_POWER_WAKE_GPIO is then not advertised and
  alp_power_configure_wake_source() answers ALP_ERR_NOSUPPORT.

  Example (the pad must be free on your carrier; `pinctrl_wake_pads` is the pad group
  that muxes the pad to LPGPIO and enables its input buffer):

    wake-pads {
        compatible = "alp,power-wake-gpios";
        wake-gpios = <&lpgpio 2 GPIO_ACTIVE_LOW>;
        pinctrl-0 = <&pinctrl_wake_pads>;
        pinctrl-names = "default";
    };

compatible: "alp,power-wake-gpios"

include: [base.yaml, pinctrl-device.yaml]

properties:
  wake-gpios:
    type: phandle-array
    required: true
    description: |
      LPGPIO pads that may wake the SoC.  Flag = asserted level; the wake is the edge TO that
      level.  Any one of them ends the sleep.

  pinctrl-0:
    required: true
    description: |
      Pad group for the wake pads: LPGPIO function with the input buffer (READ_ENABLE) and,
      for an open-drain source, a pull-up.
```

## zephyr/dts/bindings/power/alp,som-power-domain.yaml
```yaml
# Copyright 2026 Alp Lab AB
# SPDX-License-Identifier: Apache-2.0
#
# alp,som-power-domain -- one quiesce-able on-module power domain
# (Wi-Fi/BLE, Ethernet PHY, external flash, external RAM, temperature sensor,
# RTC, backlight).  Generated from `power_domains:` in
# metadata/e1m_modules/aen/on-module-links.yaml; every control pad is pinned to
# the pad TSVs by scripts/check_som_power_domains.py.  Data only (alp-sdk#2784):
# nothing in the SDK drives these pads yet.

description: |
  One SoM power domain.  The `*-gpios` properties name the SoC pads that gate
  the domain; the polarity flag is the ASSERTED level (GPIO_ACTIVE_LOW on a
  reset or power-down line means "drive low to assert").  Which property a pad
  lands in follows its role: reset -> reset-gpios, rail_enable and enable ->
  enable-gpios, powerdown -> powerdown-gpios, wake_in -> wake-gpios.

  Example:

    wifi-ble {
        compatible = "alp,som-power-domain";
        alp,role = "wifi_ble";
        reset-gpios = <&lpgpio 1 GPIO_ACTIVE_LOW>;
        enable-gpios = <&lpgpio 5 GPIO_ACTIVE_HIGH>;
        alp,default-action = "hold_reset";
        alp,default-modes = "stop", "standby";
        alp,stop-hold = "unproven";
        alp,restore = "nreset_release";
        alp,rail-off-opt-in;
    };

compatible: "alp,som-power-domain"

include: [base.yaml]

properties:
  alp,role:
    type: string
    required: true
    enum:
      - wifi_ble
      - eth_phy
      - ext_flash
      - ext_ram
      - temp_sensor
      - rtc
      - backlight
    description: Portable role name of the domain (stable across a SoM swap in the family).

  reset-gpios:
    type: phandle-array
    description: Reset line of the domain's chip.  Flag = asserted level.

  enable-gpios:
    type: phandle-array
    description: Supply or function enable of the domain's chip.  Flag = asserted (enabled) level.

  powerdown-gpios:
    type: phandle-array
    description: Power-down pin of the domain's chip.  Flag = asserted (powered-down) level.

  wake-gpios:
    type: phandle-array
    description: Wake input driven by the domain's chip (the RV-3028 /INT on P15_0).  Flag = asserted level.

  alp,primary-rtc:
    type: boolean
    description: |
      The domain's chip is the primary RTC and the primary RTC wake source.
      The internal LPRTC is secondary (Alif ER001/ER002): the SES boot leaves
      the LF clock on LFRC (`[SES] No LF XTAL`).  LFXO works when selected
      (about 32785 Hz measured) but selecting it via `se_service_set_run_cfg`
      has side effects, so LPRTC stays secondary until the full-profile backend
      (U5/U7).

  alp,device:
    type: phandle
    description: Node of the driver that owns the chip, where the board carries one.

  alp,chip:
    type: string
    description: Part name for this SKU, from its `on_module` block.

  alp,default-action:
    type: string
    required: true
    enum:
      - hold_reset
      - powerdown_pin
      - deep_power_down_cmd
      - shutdown_reg
      - keep_alive
      - enable_low
    description: |
      Action the SDK's AUTO policy takes (hold_reset, powerdown_pin,
      deep_power_down_cmd, shutdown_reg, keep_alive, enable_low).

  alp,default-modes:
    type: string-array
    required: true
    description: Sleep modes the default action applies to.

  alp,stop-hold:
    type: string
    required: true
    enum: ["yes", "no", "unproven", "none"]
    description: |
      Whether the default action's pad keeps its level through STOP.
      `unproven` for every LPGPIO (P15_n) pad until the STOP bench shows the
      output holds; `no` for main-domain pads; `none` when the domain has no
      control pad.

  alp,restore:
    type: string
    required: true
    enum: [nreset_release, pin_release, driver_release, register_write, none]
    description: |
      How the domain is brought back.  `nreset_release` means the nRESET-only
      path (cc3501e_hard_reset), never a supply cycle.

  alp,rail-off-opt-in:
    type: boolean
    description: The domain has a supply-gate action that is opt-in only (Kconfig-gated).

  alp,bom-optional:
    type: boolean
    description: The SKU lists the chip as a BOM variant; it may be absent on a given unit.

  alp,dependents:
    type: string-array
    enum:
      - cam_ldo
      - sd_enable
      - phy_refclk
    description: |
      Other loads the domain's control also affects: cam_ldo and sd_enable are
      carrier loads the CC3501E drives; phy_refclk is the Y3 50 MHz PHY
      reference oscillator whose TRI pin is the PHY power-down pad (P15_4).
```
