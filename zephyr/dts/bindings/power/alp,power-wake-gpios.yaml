## zephyr/dts/bindings/video/vsi,isp-pico.yaml
```yaml
# Copyright (C) 2024 Alif Semiconductor
# Copyright (c) 2026 Alp Lab AB
# SPDX-License-Identifier: Apache-2.0
#
# Vendored from the Apache-2.0 zephyr_alif fork (dts/bindings/video/vsi,isp-pico.yaml).
# ADR 0017 Tier-2 (INTERIM).  Drives the Alif Ensemble ISP-Pico block
# (Verisilicon ISP Nano "Pico") via zephyr/drivers/video/isp_pico.c, which links
# the hal_alif libisp wrapper (the Vivante blob, opt-in via USE_ALIF_ISP_LIB).

description: ALIF ISP Interface

compatible: "vsi,isp-pico"

include: base.yaml

properties:
  reg:
    required: true

  interrupts:
    required: true

  tpg-bayer-pattern:
    type: string
    required: false
    default: "GBRG"
    description: |
      Specifies the Bayer format output from TPG.
    enum:
      - "RGGB"
      - "GRBG"
      - "GBRG"
      - "BGGR"

  tpg-image-idx:
    type: string
    required: false
    default: "Disabled"
    enum:
      - "3x3-Color-Block"
      - "Color-Bar"
      - "Gray-Bar"
      - "Highlighted-grid"
      - "Random-Generator"
      - "Disabled"

  tpg-pix-width:
    type: int
    required: false
    enum:
      - 0 # 8-bit
      - 1 # 10-bit
      - 2 # 12-bit

  tpg-width:
    type: int
    required: false
    default: 0
    description: |
      TPG output frame width in pixels, fed to VSI_MPI_ISP_SetChnAttr as the
      INPUT_TPG port rect (see isp_configure() in isp_pico.c).  0 (the
      binding default) leaves the geometry unset, which alp-sdk#2256 finding
      1 traced to a "Setting the Channel config failed!" (-EINVAL from
      SetChnAttr, a 0x0 port rect); bench runs 179-181 (E1M-AEN803
      2026W36-0009) confirmed 1280x720 and 1920x1080 both make SetChnAttr
      succeed. The board overlay enabling a TPG image MUST set this to a
      silicon-confirmed value (examples/aen/aen-isp-regcheck uses 1280x720),
      or isp_configure() refuses to start; the binding itself stays 0 by
      default (fail closed) since no single geometry fits every board.
      Note: this rect only satisfies SetChnAttr -- alp-sdk#2256 finding 2
      (every TPG frame still raising INTR_SIZE_ERR, because the TPG
      pattern's own internal frame size lives inside the closed libisp/VSI
      middleware, absent from both the DFP and hal_alif's vsi_comm_isp.h)
      stays open regardless of this value.

  tpg-height:
    type: int
    required: false
    default: 0
    description: |
      TPG output frame height in pixels.  See tpg-width; the same rules
      apply.

  isp-subsampling:
    type: string
    required: false
    default: "Co-sited"
    description: |
      Specifies for the YUV422 if the Cb and Cr channels are sampled with
      Y0Cb0Cr0 Y1 - Cosited
      Y0Cb0 Y1Cr1 - Interleaved
      Y0Cb(0 + 1)/2 Y1Cr(0 + 1)/2 - Non-cosited
    enum:
      - "Co-sited"
      - "Interleaved"
      - "Non-cosited"

  fieldsel:
    type: string
    required: false
    default: "both"
    description: |
      Specifies if the field selection should be done on Even fields (Even lines)/
      Odd fields (Odd lines) or both fields (both Even and Odd lines).
    enum:
      - "both"
      - "even"
      - "odd"

  crop-x0:
    type: int
    default: 0
    description: |
      specify the left coordinate at the start of ROI.

  crop-y0:
    type: int
    default: 0
    description: |
      specify the top coordinate at the start of ROI.

child-binding:
  child-binding:
      include: video-interfaces.yaml
```
