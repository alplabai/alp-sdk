## zephyr/drivers/usb/uhc/Kconfig.xhci_alif
```kconfig
# Copyright 2026 Alp Lab AB
# SPDX-License-Identifier: Apache-2.0

config UHC_XHCI_ALIF
	bool "Alif Ensemble xHCI USB host controller driver"
	default y
	depends on DT_HAS_ALIF_XHCI_UHC_ENABLED
	depends on UHC_DRIVER
	help
	  xHCI USB-2.0 host driver for the Alif Ensemble USB (DWC3-family,
	  controller base 0x48200000, IRQ 101).

	  Implements the full uhc_api: DWC3 host-mode init + xHCI reset,
	  command/event-ring processing, root-hub port reset + single-device
	  enumeration, ep_enqueue/ep_dequeue (control/bulk -- NOT interrupt;
	  an interrupt endpoint returns -ENOTSUP, since this driver's
	  ep_enqueue() is fully synchronous and a real interrupt-IN needs
	  periodic, asynchronous completion this driver does not implement),
	  bus reset/suspend/resume, disable/shutdown, and an event-ring IRQ
	  for hotplug notification.

	  Only *_enable()'s controller bring-up itself -- DWC3 host-mode
	  init, xHCI reset, and the command/event-ring round trip (No-Op +
	  Enable Slot commands) -- was proven on an E8 EVK (see the timing
	  comments in uhc_xhci_alif_first_light()); uhc_xhci_alif_enumerate()'s
	  device-dependent stages (Address Device, GET_DESCRIPTOR) did NOT
	  reach completion on that same bench session, blocked on the EVK's
	  D+/D- signal path.  Everything else (ep_enqueue/ep_dequeue, bus
	  suspend/resume, disable/shutdown, the ISR) follows the same
	  register sequencing but has NOT itself been bench-run -- see issue
	  #388 for the open bench checklist.

	  Do NOT enable this on a production build until the above has a
	  bench pass: this is a from-spec implementation with no hardware
	  confirmation past controller bring-up, on a peripheral (USB host)
	  that drives an external, untrusted device.

	  Driver: zephyr/drivers/usb/uhc/uhc_xhci_alif.c
	  Binding: zephyr/dts/bindings/usb/alif,xhci-uhc.yaml
```

## zephyr/dts/bindings/alp,cc3501e-attn.yaml
```yaml
# Copyright 2026 Alp Lab AB
# SPDX-License-Identifier: Apache-2.0
#
# alp,cc3501e-attn — the CC3501E slave->master attention line (issue #130).

description: |
  CC3501E attention/READY input (CC35 GPIO17 -> Alif P2_6 on E1M-AEN rev-1).

  Points CONFIG_ALP_SDK_CC3501E_EVENT_IRQ at the pin whose edge schedules a
  GET_PENDING_EVENTS drain, via the `cc3501e-attn` alias.

  This is DELIBERATELY its own binding rather than a second "alp,pin-array"
  node: that compatible is resolved as a single, indexed array by
  src/zephyr/peripheral_gpio.c, and adding a second one broke pin resolution
  outright (bridge bring-up failed with err=-1, bench-caught 2026-08-26).
  It is equally deliberately NOT "gpio-leds"/"gpio-keys" -- those instantiate
  drivers that would drive this pin, and it is an INPUT carrying the bridge's
  READY flow control.  The binding exists only so the `gpios` property is
  parsed as a phandle-array and GPIO_DT_SPEC_GET() resolves; no driver binds
  to it.

  The net is a rev-1 bodge, absent on the stock E1M-AEN EVK, which is why the
  Kconfig that consumes it defaults to n.

  Example:
    cc3501e_attn: cc3501e-attn {
        compatible = "alp,cc3501e-attn";
        gpios = <&gpio2 6 GPIO_ACTIVE_HIGH>;
    };

compatible: "alp,cc3501e-attn"

properties:
  gpios:
    type: phandle-array
    required: true
    description: |
      The single attention input.  GPIO_DT_SPEC_GET(DT_ALIAS(cc3501e_attn),
      gpios) reads index 0.
```

## zephyr/dts/bindings/alp,gd32-pads.yaml
```yaml
# Copyright 2026 Alp Lab AB
# SPDX-License-Identifier: Apache-2.0
#
# alp,gd32-pads -- the GD32G553 control pads the V2N CM33 drives or watches
# outside the SPI link: SWD (SWDIO / SWCLK / NRST) and the bridge ATTN input.

description: |
  Generated from metadata/e1m_modules/v2n/supervisor-links.yaml (`gd32_pads`).

  DELIBERATELY its own binding rather than entries of "alp,pin-array": that
  array is a single positional table whose index 0 is the GD32 SPI
  chip-select (Renesas P97 = GD32 PA8), so any id that drifted by one would
  drive the chip-select.  These pads are resolved only through the INTERNAL
  pad opener (GD32G553_PAD_ID_SWDIO / _SWCLK / _NRST / _ATTN) used by the SWD
  driver and the V2N supervisor; the portable alp_gpio_open() refuses those ids.

  swclk-gpios and attn-gpios name the SAME pad (P71 = GD32 PA14) in two roles:
  GD32 SWCLK, which the host may drive only inside an SWD session with
  GD32_NRST asserted first, and the bridge ATTN output, which the host watches
  as an input with a rising-edge interrupt.  The pads are plain GPIO (no
  pinctrl function), hence inputs out of reset.

  nrst-gpios is open-drain on the board (shared with the primary PMIC's
  reset-out).  The flag is not set here because the Renesas RZ GPIO driver has
  no open-drain mode; the SWD driver emulates it (output low = assert, input =
  release) and never drives the pad high.

compatible: "alp,gd32-pads"

properties:
  swdio-gpios:
    type: phandle-array
    required: true
  swclk-gpios:
    type: phandle-array
    required: true
  nrst-gpios:
    type: phandle-array
    required: true
  attn-gpios:
    type: phandle-array
    required: true
```

## zephyr/dts/bindings/audio/alif,alif-pdm.yaml
```yaml
# Copyright (C) 2025 Alif Semiconductor
# SPDX-License-Identifier: Apache-2.0

description: |
  Alif Pulse Density Module

  Decimator settling (issue #2133 round 4e/4f): PCM delivered shortly after
  every DMIC_TRIGGER_START -- including a restart after an
  overrun/STOP-then-START cycle, not just the very first capture -- may
  contain the FIR/decimator's startup transient and read as full-scale
  (silicon observed +/-32767) or otherwise non-representative. MEASURED
  bound (round 4f): a raw hex dump of the start of capture showed roughly 7
  zero samples followed by ~25 samples of ring-down at 48 kHz -- under 1 ms
  total, well inside this driver's typical 100 ms block. This is not a
  driver bug and is not filtered by the driver: upstream Zephyr dmic
  drivers don't discard a settling block either, and the dmic API has no
  settling contract for a driver to implement against. Consumers should
  discard AT LEAST 1 ms of samples after every START, or the first block,
  WHICHEVER IS LONGER -- discarding only "the first block" is not enough
  for a consumer using a block size smaller than ~1 ms, which could still
  see settling in its second block. examples/aen/aen-pdm-mic-alif excludes
  its first (anchor) block from signal-level stats for this reason, which
  covers it at that example's 100 ms block size.

compatible: "alif,alif-pdm"

include: [base.yaml, pinctrl-device.yaml]

properties:
  reg:
    required: true

  interrupts:
    required: true

  fifo_watermark:
    type: int
    required: true
    description: Fifo watermark threshold value
    enum:
      - 0
      - 1
      - 2
      - 3
      - 4
      - 5
      - 6
      - 7

  bypass_iir_filter:
    type: int
    required: true
    description: Bypass IIR filter
    enum:
      - 0
      - 1

  # clk-frequency-min/clk-frequency-max: the SAME property names Zephyr's own
  # zephyr/dts/bindings/audio/pdm-dmic.yaml ("Digital microphone common
  # configuration", landed 2ceda8506e7) uses for a mic's PDM clock range --
  # reused here rather than inventing alif-local names (issue #2133 round 4a).
  # Upstream models the mic as a SEPARATE CHILD node (compatible
  # "zephyr,pdm-dmic", which `include: [pdm-dmic.yaml]`s and thereby makes
  # clk-frequency-min/max/clk-duty-cycle-min/max/channel-left/right ALL
  # required); this driver does NOT yet adopt that child-node model -- these
  # two properties are applied directly to the CONTROLLER node instead, and
  # stay optional here. `include: [pdm-dmic.yaml]` was checked and rejected:
  # it would make the two duty-cycle properties required on every
  # alif,alif-pdm node, which nothing here reads. Migrating to the real
  # zephyr,pdm-dmic child-node model is a follow-up, not this round.
  clk-frequency-min:
    type: int
    description: |
      Minimum PDM bit-clock frequency (Hz) the mic(s) wired to this instance
      accept. Board-level fact, not a SoC/driver one -- e.g. the E1M-EVK's
      MP34DT05TR-A mics need >= 1.2 MHz (ST's in-tree mpxxdtyy.h:
      MPXXDTYY_MIN_PDM_FREQ). Optional: when unset, dmic_alif_pdm_configure()
      only enforces the caller's dmic_cfg.io window (issue #2133). If both
      clk-frequency-min and clk-frequency-max are set, min must not exceed
      max -- PDM_INIT's BUILD_ASSERT catches an inverted range at build time.

  clk-frequency-max:
    type: int
    description: |
      Maximum PDM bit-clock frequency (Hz) the mic(s) wired to this instance
      accept -- see clk-frequency-min. E1M-EVK MP34DT05TR-A: <= 3.25 MHz
      (mpxxdtyy.h: MPXXDTYY_MAX_PDM_FREQ). Optional, same fallback as
      clk-frequency-min.

  channel-gain:
    type: int
    default: 0x200
    description: |
      Per-channel PDM_CH_GAIN value applied to every enabled hardware channel
      by dmic_alif_pdm_configure() (issue #2143). GAIN is an UNSIGNED 8.4
      fixed-point field, bits [11:0] of PDM_CH_GAIN, reset 0x10 = 1.0x (Alif
      SVD AE822FA0E5597BS0_CM55_HP_View.svd, PDM_CH_GAIN register, GAIN
      field, lines ~19081-19092: "Gain in unsigned 8.4 format", bitRange
      [11:0]; matches the Alif DFP's PDM_MAX_GAIN_CTRL 0xFFFU,
      drivers/include/pdm.h). A value written above PDM_CH_GAIN_MAX (0xFFF)
      truncates to bits [11:0] -- 0x1000 exactly truncates to 0, which MUTES
      the channel -- see PDM_INIT's BUILD_ASSERT below.

      The default (0x200 = 32.0x = +30.1 dB) is PROVISIONAL, pending a
      calibrated full-scale measurement, not a tuned value. Full-scale
      headroom at 0x200 is UNMEASURED: issue #2133 round 4e's silicon run
      (gain 0x800 = 128x, quiet room, no controlled stimulus) put every
      unclipped sample at a multiple of 0x80 (the gain is a saturating
      multiply applied AFTER the datapath quantizes, so a coarser gain step
      doesn't cost resolution) and pinned the start transient / post-restart
      window at full scale -- evidence 0x800 clips a close clap or any start
      transient, but not a calibrated pre-gain full-scale figure. 0x200 is
      NOT "clearly below the clip point" as an earlier round claimed. It is
      also NOT a documented "voice-tuned" value: BLE Audio's
      `ALIF_BLE_AUDIO_PDM_MICROPHONE_GAIN` Kconfig (`range 1 256`,
      left-shifted by 4 before writing this register) has three different
      values in the same codebase and none is described as tuned for
      anything -- `0x140` is its Kconfig DEFAULT (20), `0x320` is a
      DIFFERENT `#ifndef` FALLBACK (50, sdk-alif
      subsys/bluetooth/le_audio/audio_source_pdm.c), and sdk-alif
      samples/bluetooth/le_audio/unicast_initiator's `prj.conf` ships a
      THIRD value, 100 (`0x640`). A round 4f speaker-to-mic loopback
      (TAS2563 speakers -> PDM mics, E1M-AEN803 serial 2026W36-0002, PROBE_LOOPBACK mode of
      examples/aen/aen-i2s-tas2563-probe on branch
      test/u46-i2s-tas2563-on-reworked-mux, issue #2143) confirmed 0x200
      captures frequency- and level-correct audio on mic ch0/ch1 (PDM
      controller 0) -- see zephyr/drivers/audio/alif_pdm.c's top-of-file
      STATUS comment for the numbers; the D2 pair (HW 4/5) is register-level
      verified only. Full-scale headroom at 0x200 remains UNMEASURED by that
      test (it used a fixed loudspeaker level, not a calibration sweep).
      Alif's own audio-capture references are NOT a clean precedent for a
      48 kHz default either: `alif_kws`'s `AudioBackend.cpp` sets 0xF00, but
      that sample's shipped model runs at 16 kHz (`g_AudioRate = 16000`,
      generated/kws/kws_micronet_m_vela_H128.tflite.cc), which selects mode
      4, not the mode 7 this driver defaults to -- 0xF00 was never
      Alif-validated at 48 kHz. The GitHub-hosted
      alifsemi/alif_ml-embedded-evaluation-kit's mic_listener.c uses 0x800
      (not vendored locally, so not a `path:NNN` citation). The driver's OLD
      hardcoded default (0x0D) is Alif's register-level driver test value
      (sdk-alif tests/drivers/pdm/src/alif_test_pdm.h:88-123, and sdk-alif
      samples/drivers/audio/dmic_alif/src/main.c:22) -- never an audio-tuned
      value: 0x0D = 0.8125x (-1.8 dB vs unity), 31.9 dB below the
      provisional 0x200 (issue #2133 round 4d). Override per board/mic once
      a controlled-stimulus calibration exists; PDM_INIT's BUILD_ASSERT
      rejects an out-of-range value at build time.
```

## zephyr/dts/bindings/can/cast,can.yaml
```yaml
# Copyright (C) 2024 Alif Semiconductor
# SPDX-License-Identifier: Apache-2.0

description: Cast CAN

include: [can-controller.yaml, can-fd-controller.yaml, pinctrl-device.yaml]

compatible: "cast,can"

properties:
  reg:
    required: true

  reg-names:
    required: true

  interrupt-parent:
    required: true

  interrupts:
    required: true

  interrupt-names:
    required: true

  clocks:
    required: true
    description: Includes Clock Controller module

  clock-frequency:
    type: int
    required: true
    description: |
      CAN core clock in Hz. The driver programs CANFD_CTRL.CKDIV (bits [7:0]) =
      160 MHz / clock-frequency (integer divisor 2..255), so the value should divide
      160 MHz exactly (bench-verified at 20 MHz, CKDIV 8).

  can-fd:
    type: boolean
    description: |
     Enable CAN FD support.
     When enabled, can-fd-ctrl-reg and can-fd-bit must be specified.

  can-fd-ctrl-reg:
    type: int
    description: |
      Address of the CAN FD control register.
      Required when can-fd is true.

  can-fd-bit:
    type: int
    description: |
      Bit position within can-fd-ctrl-reg that enables CAN FD mode.
      Required when can-fd is true.
```

## zephyr/dts/bindings/display/alp,display-backlight.yaml
```yaml
# Copyright (c) 2026 Alp Lab AB
# SPDX-License-Identifier: Apache-2.0

description: |
  A display's backlight at its default brightness, set once at boot.

  The SDK sets the brightness (src/zephyr/display_backlight.c, APPLICATION
  init, through led_set_brightness()), so an application that opens the
  display needs no backlight code. The node names an LED -- a child of a
  pwm-leds or gpio-leds node -- and the percentage it starts at.

  Do NOT use this for a backlight enable that the panel driver already owns
  (the HX8394's bl-gpios): that pin is a driver-sequenced enable, never a
  dimming PWM.

compatible: "alp,display-backlight"

include: base.yaml

properties:
  led:
    type: phandle
    required: true
    description: |
      The backlight LED: a child node of a pwm-leds or gpio-leds node.

  default-brightness:
    type: int
    default: 100
    description: |
      Initial brightness, percent, 0..100 (asserted at build time).

  required-devices:
    type: phandles
    description: |
      Devices that must be ready before the backlight is lit (the display
      controller, a bridge): if any of them failed to initialise the backlight
      stays off and the reason is logged, instead of lighting a dead panel.
      The backlight is set at a later APPLICATION priority than the display
      chain, so these have run by then.
```
