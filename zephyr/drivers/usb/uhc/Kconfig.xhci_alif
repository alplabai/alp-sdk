## zephyr/dts/bindings/display/alp,sn65dsi83-recovery.yaml
```yaml
# Copyright (c) 2026 Alp Lab AB
# SPDX-License-Identifier: Apache-2.0

description: |
  Health check and recovery of a TI SN65DSI83 bridge, run by the core that owns
  its I2C bus when a DIFFERENT core initialised the bridge (alp,i2c-handover:
  the display core configures the bridge, then gives the I2C controller to the
  core that owns it for good).  Declare it as a child of the I2C bus at the
  bridge's address, next to the bridge owner's ti,sn65dsi83 node with the same
  recovery-recipe-address.

  The agent does nothing until the recipe's magic word is set (a build whose
  display is not behind a bridge never publishes one), and never writes unless
  the bridge's ID registers read back.  Driver: zephyr/drivers/display/
  sn65dsi83_recovery_agent.c.

compatible: "alp,sn65dsi83-recovery"

include: [i2c-device.yaml]

properties:
  recipe-address:
    type: int
    required: true
    description: |
      Address of the shared `struct sn65dsi83_recipe`; the same value as the
      bridge node's recovery-recipe-address on the display core.
```

## zephyr/dts/bindings/gpio/alp,gpio-output.yaml
```yaml
# Copyright (c) 2026 Alp Lab AB
# SPDX-License-Identifier: Apache-2.0

description: |
  alp-sdk ad hoc GPIO-output consumer. Carries a single `gpios` phandle an app
  resolves directly via GPIO_DT_SPEC_GET(), for a board-specific signal the
  portable <alp/*> peripheral surface has no concept of (so alp_gpio_open()'s
  `alp,pin-array` id space is not the right fit either). Mirrors
  alp,adc-input.yaml's reasoning: a `compatible` (rather than the bare
  `zephyr,user` node shape) is required for edtlib to type the property as
  phandle-array at all, since infer_binding_for_paths only special-cases the
  literal "/zephyr,user" node path (gen_edt.py) -- see
  examples/aen/aen-camera-firstlight/boards/trigger_gpio.overlay for the first
  consumer.

compatible: "alp,gpio-output"

include: [base.yaml]

properties:
  gpios:
    type: phandle-array
    required: true
    description: The GPIO pin this consumer drives.
```

## zephyr/dts/bindings/input/ilitek,ili251x.yaml
```yaml
# Copyright (c) 2026 Alp Lab AB
# SPDX-License-Identifier: Apache-2.0

description: |
  Ilitek ILI251x capacitive touch controller (ILI2511 on the Riverdi
  RVT121HVDFWCA0-B 12.1" panel), on-bus I2C, 7-bit address 0x41.

  int-gpios is optional: when absent, the driver polls at
  CONFIG_INPUT_ILI251X_PERIOD_MS instead of waiting for an interrupt (the
  E1M-EVK runs this way -- the touch INT pad lands on the CC3501E
  co-processor, not the Alif core).

compatible: "ilitek,ili251x"

include: [i2c-device.yaml, touchscreen-common.yaml]

properties:
  reset-gpios:
    type: phandle-array
    description: |
      Active-low reset line. Optional: when absent the driver skips the
      reset pulse and relies on the controller's power-on state.

  int-gpios:
    type: phandle-array
    description: |
      Active-low, open-drain interrupt line. Optional: see above.
```

## zephyr/dts/bindings/ipc/alp,ipc-v2n-rpmsg.yaml
```yaml
# Copyright 2026 Alp Lab AB
# SPDX-License-Identifier: Apache-2.0

description: |
  ipc_service backend for the RZ/V2N / V2M Cortex-M33 system manager.  The
  CM33 is the OpenAMP remote (virtio device) of the Cortex-A55/Linux master:
  it publishes a vendor-shaped resource table + the Alp AMP beacon in the
  `rsctbl` memory node, takes its vring addresses from the `vring_ctrl0` /
  `vring_ctrl1` nodes and its buffer pool from `chosen { zephyr,ipc_shm }`
  (board dts, generated by scripts/gen_zephyr_board.py).  Upstream's
  zephyr,ipc-openamp-static-vrings cannot be used here: it lays its own
  vrings out inside one region and has no resource table, whereas the A55
  attach path (src/backends/rpc/yocto_uio_drv.c) reads both from the table.

  Endpoints are created at fixed rpmsg addresses 1024 + registration index
  (the A55 names the CM33 service address explicitly as dst_ept).

compatible: "alp,ipc-v2n-rpmsg"

include: base.yaml

properties:
  mboxes:
    required: true
    description: |
      MHU-B mailbox (renesas,rz-mhu-b-mbox).  "rx" is the A55 -> CM33
      doorbell; "tx" is declared for MBOX_DT_SPEC_GET() users, the CM33 ->
      A55 doorbell is a direct MHU-B register write
      (<alp/protocol/v2n_mhu_doorbell.h>).

  mbox-names:
    required: true
    description: Must be "tx" and "rx".
```

## zephyr/dts/bindings/mipi-dsi/snps,designware-dsi.yaml
```yaml
# Copyright (c) 2026 Alp Lab AB
# SPDX-License-Identifier: Apache-2.0
#
# Synopsys DesignWare MIPI-DSI host controller -- the DSI-TX bridge between the
# CDC200 DPI source and the shared DesignWare MIPI D-PHY (TX role) on the Alif
# Ensemble E8.  re-authored, NOT vendored: the host property set is grounded in
# the Alif CMSIS DFP register map (drivers/include/dsi.h: DSI_PWR_UP shutdownz,
# DSI_DPI_COLOR_CODING, DSI_DPI_CFG_POL shutd/colorm active-low bits,
# DSI_VID_PKT_SIZE, DSI_PCKHDL_CFG EOTP/BTA/ECC_RX/CRC_RX, the PHY_IF_CFG lane
# count) and matches the property names the zephyr_alif fork node carries so the
# same node text binds.  Builds on the upstream Zephyr mipi-dsi-host.yaml base
# (the mipi-dsi bus is upstream-native; only the host driver is missing).  No
# upstream Zephyr nor hal_alif ships a snps,designware-dsi host driver -- ADR
# 0017 Tier-2 when a driver is authored.  The D-PHY TX role is already covered by
# the in-tree zephyr/drivers/mipi_dphy/dphy_dw.c (dphy_dw_master_setup).
# BENCH-UNVERIFIED.

description: Synopsys DesignWare MIPI-DSI host controller

compatible: "snps,designware-dsi"

include: mipi-dsi-host.yaml

properties:
  reg:
    required: true

  interrupts:
    required: true

  cdc-if:
    type: phandle
    required: true
    description: Phandle to the CDC200 (tes,cdc-2.1) DPI source instance.

  phy-if:
    type: phandle-array
    required: true
    specifier-space: dphy
    description:
      Phandle (+ D-PHY id cell) to the shared DesignWare MIPI D-PHY, driven in
      the TX role by dphy_dw_master_setup().

  cam-disp-mux-gpios:
    type: phandle-array
    description: |
      Drive high to route the shared D-PHY lanes + clock to the MIPI-DSI TX
      (vs the CSI-2 RX).  Bench-unknown on the AEN801 SoM -- omit unless wired.

  eotp-lp-tx-en:
    type: boolean
    description:
      Insert an EoTp short packet at the end of LP transmission
      (DSI_PCKHDL_CFG.EOTP_TX_EN).

  eotp-rx-en:
    type: boolean
    description: Enable reception of an EoTp short packet at end of LPDT reception.

  ecc-recv-en:
    type: boolean
    description:
      Enable ECC reception, correction and reporting (DSI_PCKHDL_CFG.ECC_RX_EN).

  crc-recv-en:
    type: boolean
    description:
      Enable CRC reception and error reporting (DSI_PCKHDL_CFG.CRC_RX_EN).

  frame-ack-en:
    type: boolean
    description: Request peripheral ACK at the end of frames (DSI_PCKHDL_CFG.BTA_EN).

  dpi-video-mode:
    type: string
    default: "non-burst-sync-events"
    enum:
      - "non-burst-sync-events"
      - "non-burst-sync-pulses"
      - "burst"
    description: |
      The video transmission mode the PANEL needs, ORed into the mode flags the
      panel driver hands to dsi_dw_attach().  A panel driver is supposed to
      declare this itself, but upstream ones frequently do not: Zephyr's
      himax,hx8394 driver sets mdev.mode_flags = MIPI_DSI_MODE_VIDEO and
      nothing else, which leaves this host in non-burst sync-events no matter
      what the panel actually wants.  Since the board is what knows which panel
      is fitted, the board describes it here.
      "burst" needs lane bandwidth ABOVE the DPI byte rate: the host asks the
      PLL for DSI_HS_CLK_SCALING_FACTOR (4/3) x pixel-clock * bpp / lanes.
      panel-max-lane-bandwidth clamps only that RATE -- MODE_TYPE still comes
      from the mode flags (dsi_dw_burst_mode_setup()), so a low clamp does not
      cancel the burst, it runs a burst whose lane is SLOWER than the DPI feed,
      which starves the link. Keep the clamp above pixel-clock * bpp / lanes.

  autoinsert-eotp:
    type: boolean
    description: |
      Append an EoTp short packet to every HS transmission
      (DSI_PCKHDL_CFG.EOTP_TX_EN, reached via MIPI_DSI_MODE_EOT_PACKET).  Some
      panels never leave their idle state without it.  Distinct from
      eotp-lp-tx-en, which is the LP-transmission EoTp (EOTP_TX_LP_EN).

  dpi-colorm-active:
    type: int
    required: true
    description:
      Color-Mode command pulse polarity (DSI_DPI_CFG_POL.COLORM_ACTIVE_LOW).
      If dpicolorm is active low, use 0, otherwise use 1.
    enum:
      - 0
      - 1

  dpi-shutdn-active:
    type: int
    required: true
    description:
      Shutdown command pulse polarity (DSI_DPI_CFG_POL.SHUTD_ACTIVE_LOW).
      If dpishutdn is active low, use 0, otherwise use 1.
    enum:
      - 0
      - 1

  vid-pkt-size:
    type: int
    default: 0
    description:
      Video packet size in pixels (DSI_VID_PKT_SIZE, bits[13:0]).  The product of
      number of chunks and video packet size should be the active line width.

  dpi-video-pattern-gen:
    type: string
    required: false
    enum:
      - "vertical-color-bar"
      - "horizontal-color-bar"
      - "vertical-bit-error-rate"
    description: Built-in video pattern generator for testing DSI without DPI input.

  panel-max-lane-bandwidth:
    type: int
    default: 500000000
    description:
      The lane bandwidth a panel supports (bps).  D-PHY PLL calculations are
      limited to half of this value.

  bl-gpios:
    type: phandle-array
    description: |
      Backlight-enable GPIO, declared directly on THIS (the DSI host) node
      rather than on a panel child.  Only needed when the panel/bridge is not
      itself a DSI peripheral node under this one (e.g. a DSI-to-LVDS bridge
      chip controlled over a separate I2C bus, compatible "ti,sn65dsi83") --
      such a shield has no panel@N child to carry the property the normal
      way.  Consumed only by zephyr/soc-bridge/alif/mipi_display_e8.c's
      backlight pad-mux helper (alif_dsi_panel_bl_pad_to_gpio()), which
      otherwise only walks this node's children; the property by itself
      drives nothing -- a gpio-hog (or a driver) still has to set the level.
```

## zephyr/dts/bindings/misc/alp,i2c-handover.yaml
```yaml
# Copyright (c) 2026 Alp Lab AB
# SPDX-License-Identifier: Apache-2.0

description: |
  One I2C controller shared between two cores of the same SoC, handed from
  the core that configures a peripheral at boot to the core that owns the bus
  afterwards (Alif Ensemble: the M55-HE configures a display bridge over
  I2C1, the M55-HP then owns the same controller for the camera).

  Each image carries one node; the roles pair through three flag words in
  always-on shared SRAM (protocol: zephyr/soc-bridge/alif/i2c_handover.h):

    release  (the first owner): once its drivers have finished with the bus
             (the last step of APPLICATION init, after the display bridge),
             masks this core's interrupt for the controller, stops it and
             publishes a per-boot nonce and CLEAN. A controller that will not go
             idle is still released, as DIRTY, with a warning: the other core
             runs its bus recovery rather than wait forever. A `bus` that is
             DISABLED in this image has nothing to stop and is released at once
             (a shield that never needs the bus on this core keeps it disabled).
    acquire  (the next owner): before ANY touch of the bus -- POST_KERNEL
             priority 0, ahead of every driver and of an app's pad recovery --
             waits for a release it has not taken yet, then consumes it (state
             cleared, nonce recorded), so an already-taken release never
             satisfies a later wait.

  The release side clears the state first thing at boot. A release published
  but not yet taken survives a warm reset (always-on SRAM), and an acquire side
  that reaches its wait before the release side's boot-time clear can take it:
  harmless where the release side keeps the bus disabled, a hazard with a bridge
  on the bus. An image restarted alone after it took the bus waits for a release
  that is not coming, and a release-side reset while the acquire side is running
  reconfigures the bus under it: reset BOTH cores together, release side first --
  unless the release node has an alive-address, which makes a release-side-only
  reset safe (the release side then leaves the controller alone).

compatible: "alp,i2c-handover"

include: base.yaml

properties:
  role:
    type: string
    required: true
    enum:
      - release
      - acquire
    description: Which side of the handover this image is.

  bus:
    type: phandle
    description: |
      The shared I2C controller, a snps,designware-i2c instance (asserted at
      build time). Required for `release`; unused by `acquire`.

  flag-address:
    type: int
    required: true
    description: |
      Address of the three 32-bit flag words (state, nonce, consumed: 12 bytes),
      in SRAM both cores see and that survives a warm reset.

  alive-address:
    type: int
    description: |
      Address of a 32-bit liveness word in the same always-on SRAM, set on BOTH
      sides to the same value.
      `acquire`: the word is advanced every 10 ms by a timer that is started right
      AFTER the bus is taken (not by the main loop: a pass can take seconds, and
      the word must not move while this core is still waiting for the release).
      `release`: turns on warm-boot detection. A release-side reset while the
      acquiring core is running and owns the bus is recognised (record "taken"
      -- snapshotted at PRE_KERNEL_1, where a release nobody took is also
      cleared -- and the word moving within 100 ms, alp_i2c_handover_is_warm())
      and then touches NOTHING of the controller: no driver init, no NVIC line, no
      state clear, no release. Needs `zephyr,deferred-init` on the bus node
      (asserted at build time): the glue then initialises the controller itself,
      on a cold boot only.
      Unset: every boot is treated as cold (reset both cores together).
```

## zephyr/dts/bindings/misc/alp,pad-config.yaml
```yaml
# Copyright 2026 Alp Lab AB
# SPDX-License-Identifier: Apache-2.0
#
# alp,pad-config -- a pinctrl state with no driver of its own.

description: |
  Holds a pinctrl state (`pinctrl-0` / `pinctrl-names`) for pads that a portable-API
  consumer reads through a driver which never applies pinctrl itself.

  On the Alif Ensemble a pad's input buffer (REN) is on only once pinctrl sets it, and
  neither gpio_dw nor Zephyr's gpio-qdec applies a state, so an input read through them is
  idle for ever. No driver binds to this node: the app applies the state with
  pinctrl_apply_state(PINCTRL_DT_DEV_CONFIG_GET(node), PINCTRL_STATE_DEFAULT), because the
  SDK has no portable pad-config API.

  Example (examples/aen/aen-trace-runner/volume_he.overlay):
    tr_pads: tr-pads {
        compatible = "alp,pad-config";
        pinctrl-0 = <&pinctrl_tr_enc>;
        pinctrl-names = "default";
    };

compatible: "alp,pad-config"

include: [base.yaml, pinctrl-device.yaml]
```
