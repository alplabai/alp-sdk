/*
 * Copyright (c) 2026 Alp Lab AB
 * SPDX-License-Identifier: Apache-2.0
 *
 * E1M-AEN601 (Alif Ensemble E6) Cortex-M55-HP carrier pin control.
 *
 * Console: the E1M edge "UART0" maps to Alif UART5 (P3_4 RX_A / P3_5 TX_A)
 * on the AEN module PCB; the Alp E1M-EVK carrier wires its USB-UART console
 * to it.  Confirmed against the shared AEN-family SoM pinout (common with
 * AEN401 / AEN801 -- same E1M connector mapping).
 *
 * GPIO / I2C / SPI pin groups are added alongside their drivers.
 * Only the console is wired here for the real-firmware build baseline.
 */

#include <zephyr/dt-bindings/pinctrl/alif-ensemble-pinctrl.h>

&pinctrl {
	pinctrl_uart5: pinctrl_uart5 {
		group0 {
			pinmux = <PIN_P3_4__UART5_RX_A>;
			input-enable;
		};

		group1 {
			pinmux = <PIN_P3_5__UART5_TX_A>;
		};
	};
};
