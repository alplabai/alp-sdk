## zephyr/dts/bindings/crc/alif,crc.yaml
```yaml
# Copyright (c) 2026 Alp Lab AB
# SPDX-License-Identifier: Apache-2.0

description: |
  Alif Ensemble CRC engine.

  A polled, memory-mapped hardware CRC accelerator (no interrupt, no DMA used by
  this driver).  Bound by the alp-sdk clean-room driver
  zephyr/drivers/crc/crc_alif.c, which implements the UPSTREAM Zephyr v4.4 CRC
  class API (<zephyr/drivers/crc.h>: crc_begin / crc_update / crc_finish over
  struct crc_ctx).

  The compatible "alif,crc" is alp-sdk-native.  Upstream Zephyr v4.4 ships no
  Alif CRC binding, and the Apache-2.0 zephyr_alif fork's CRC driver targets a
  fork-private API (crc_compute() + struct crc_params, CONFIG_CRC_DRV) that does
  not exist upstream -- so there is no fork binding to consume or retire onto.
  ADR 0017 Tier-1.5 (in-tree-thin over the silicon).  See docs/adr/0017 +
  task #21.  vendor-ext, BENCH-UNVERIFIED.

  Supported enum crc_type -> Alif hardware algorithm (others -> -ENOTSUP):
    CRC8_CCITT  -> CRC_8_CCITT   (poly 0x07)
    CRC16       -> CRC_16        (poly 0x8005)
    CRC16_CCITT -> CRC_16_CCITT  (poly 0x1021)
    CRC32_IEEE  -> CRC_32        (poly 0x04C11DB7)
    CRC32_C     -> CRC_32C       (poly 0x1EDC6F41, via the custom-poly register)

  On the E8 SoM this models crc0@48107000 / crc1@48108000.

compatible: "alif,crc"

include: base.yaml

properties:
  reg:
    required: true
```

## zephyr/dts/bindings/dac/alif,dac.yaml
```yaml
# Copyright (C) 2025 Alif Semiconductor
# Copyright (c) 2026 Alp Lab AB
# SPDX-License-Identifier: Apache-2.0

description: |
  Alif Ensemble DAC12 (2x 12-bit current-output DACs: dac0, dac1).

  Bound by the alp-sdk vendored DAC driver (zephyr/drivers/dac/dac_alif.c,
  ported VERBATIM from the Apache-2.0 zephyr_alif fork).  The compatible
  "alif,dac" is fork-native and does NOT collide with any upstream Zephyr DAC
  binding (upstream ships no Alif DAC).

  ADR 0017 Tier-2 (a genuine fork-driver copy -- hal_alif ships no DAC class
  driver, only the analog_ctrl VREF helper library reached via
  CONFIG_USE_ALIF_HAL_ANALOG): INTERIM.  Retires onto the opt-in sdk-alif fork
  compatible once the dac nodes are repointed AND bench-verified.  See
  docs/adr/0017 + task #21.  BENCH-UNVERIFIED.

  The driver maps the reg blocks via DEVICE_MMIO_NAMED_MAP, so reg-names is
  REQUIRED.  The driver expects (in this order, by name -- the order is
  irrelevant since it uses DEVICE_MMIO_NAMED_ROM_INIT_BY_NAME):
    reg-names "dac_reg"  = per-instance DAC control block (dac0 0x49028000,
                           dac1 0x49029000)
              "cmp_reg"  = shared comparator block 0x49023000 (VREF control)
              "vbat_reg" = always-on VBAT/analog block 0x1A60A000 (LDO+BG)
              "adc_vref" = shared ADC/DAC VREF block 0x4902B000 -- ONLY mapped
                           when CONFIG_ANALOG_ALIASING; omit otherwise.

  NOTE (reg-names): the upstream fork binding (alif,alif_dac.yaml) declares ONLY
  `reg`, NOT reg-names, even though the driver maps reg blocks BY NAME -- so the
  fork binding is incomplete for a NAMED MMIO driver.  reg-names is ADDED here
  (authored from the driver's DEVICE_MMIO_NAMED_* usage + the fork e1.dtsi node
  reg-names) so the named-MMIO map resolves.

  The Alif DAC is a write-only IP with NO interrupt; the nodes carry no
  `interrupts` (unlike the ADC).

compatible: "alif,dac"

include: [base.yaml, pinctrl-device.yaml]

properties:
  reg:
    required: true

  reg-names:
    required: true

  alif,reference-mv:
    type: int
    default: 750
    description: |
      DAC12 full-scale reference voltage, in millivolts.  This property is the
      mv->code DIVISOR used by the alp-sdk portable DAC backend
      (src/backends/dac/zephyr_drv.c) to convert a requested millivolt setpoint
      into a 12-bit code:
        code = mv * (2^12 - 1) / reference_mv
      It does NOT program the silicon: the DAC reference is fixed in hardware by
      the driver.

      The dac_alif driver programs the DAC12 reference field to DAC12_VREF_CONT
      = 0x4 (dac_alif.c CMP_COMP_REG2_DAC12_VREF_CONT = (0x4U << 17), which is
      identical to the hal_alif analog_ctrl.h:41 #define DAC12_VREF_CONT
      (0x4U << 17)).  The DAC12 reference table in hal_alif analog_ctrl.h:31-40
      reads code 0x4 (100b) = 0.750 V, so the divisor MUST be 750 for the
      portable mv->code conversion to track the reference the silicon is
      actually programmed to.  The Alif Ensemble DAC12 full-scale is the DAC
      VREF, NOT the 3.3 V supply rail.

      Register value verified vs hal_alif (analog_ctrl.h:41 / dac_alif.c); the
      ABSOLUTE on-pad mV (output buffer, load, trim) is bench-pending and is NOT
      claimed here.  Override per board only if a board reprograms
      DAC12_VREF_CONT to a different code (0.500-0.833 V per the analog_ctrl.h
      table).

  twoscomp_enabled:
    type: boolean
    description: Enables conversion from two's complement signed input to
                 unsigned binary.

  bypass_enabled:
    type: boolean
    description: Enables DAC input bypass mode.

  bypass_val:
    type: int
    description: Value to be used when DAC bypass mode is enabled(0-0xFFF)

  output_current:
    type: string
    required: true
    description: Selects the DAC output current trim value.
    enum:
      -  "DAC_0UA_OUT_CUR"
      -  "DAC_100UA_OUT_CUR"
      -  "DAC_200UA_OUT_CUR"
      -  "DAC_300UA_OUT_CUR"
      -  "DAC_400UA_OUT_CUR"
      -  "DAC_500UA_OUT_CUR"
      -  "DAC_600UA_OUT_CUR"
      -  "DAC_700UA_OUT_CUR"
      -  "DAC_800UA_OUT_CUR"
      -  "DAC_900UA_OUT_CUR"
      -  "DAC_1000UA_OUT_CUR"
      -  "DAC_1100UA_OUT_CUR"
      -  "DAC_1200UA_OUT_CUR"
      -  "DAC_1300UA_OUT_CUR"
      -  "DAC_1400UA_OUT_CUR"
      -  "DAC_1500UA_OUT_CUR"

  capacitance:
    type: string
    required: true
    description: Selects DAC high-performance mode capacitance trim value.
    enum:
      -  "DAC_2PF_CAPACITANCE"
      -  "DAC_4PF_CAPACITANCE"
      -  "DAC_6PF_CAPACITANCE"
      -  "DAC_8PF_CAPACITANCE"
```

## zephyr/dts/bindings/display/tes,cdc-2.1.yaml
```yaml
# Copyright (c) 2026 Alp Lab AB
# SPDX-License-Identifier: Apache-2.0
#
# TES CDC-2.1 (CDC200) display controller -- the DPI/RGB pixel-pump feeding the
# MIPI-DSI bridge on the Alif Ensemble E8.  re-authored, NOT vendored: the
# property set is grounded in the Alif CMSIS DFP register map (drivers/include/
# cdc.h: CDC_GLB_CTRL HSPOL/VSPOL/BLPOL/PCLKPOL polarity bits, the cdc_timing_info_t
# hsync/hbp/hfp/hactive + vsync/vbp/vfp/vactive timing, the two CDC_LAYER_CFG
# layers and the 8 CDC_PIXEL_FORMAT codes) and matches the property names the
# zephyr_alif fork node carries so the same node text binds.  No upstream Zephyr
# nor hal_alif ships a tes,cdc-2.1 (or any DPI display) driver -- ADR 0017 Tier-2
# when a driver is authored.  BENCH-UNVERIFIED.

description: TES CDC-2.1 (CDC200) display controller

compatible: "tes,cdc-2.1"

include: [display-controller.yaml, pinctrl-device.yaml]

properties:
  reg:
    required: true

  interrupts:
    required: true

  interrupt-names:
    required: true

  hfront-porch:
    type: int
    required: true
    description: Horizontal front porch in display clock cycles

  hback-porch:
    type: int
    required: true
    description: Horizontal back porch in display clock cycles

  hsync-len:
    type: int
    required: true
    description: HSYNC pulse width in display clock cycles

  vfront-porch:
    type: int
    required: true
    description: Vertical front porch in display clock cycles

  vback-porch:
    type: int
    required: true
    description: Vertical back porch in display clock cycles

  vsync-len:
    type: int
    required: true
    description: VSYNC pulse width in display clock cycles

  hsync-active:
    type: int
    required: true
    description:
      Horizontal synchronization pulse polarity (CDC_GLB_CTRL.HSPOL, bit 31).
      If HSYNC is active low, use 0, otherwise use 1.

  vsync-active:
    type: int
    required: true
    description:
      Vertical synchronization pulse polarity (CDC_GLB_CTRL.VSPOL, bit 30).
      If VSYNC is active low, use 0, otherwise use 1.

  de-active:
    type: int
    required: true
    description:
      Data Enable (blank) pulse polarity (CDC_GLB_CTRL.BLPOL, bit 29).
      If DE is active low, use 0, otherwise use 1.

  pixelclk-active:
    type: int
    required: true
    description:
      Pixel Clock pulse polarity (CDC_GLB_CTRL.PCLKPOL, bit 28).
      If PCLK is active low, use 0, otherwise use 1.

  clock-frequency:
    type: int
    description: DPI pixel clock frequency in Hz.

  bg-color:
    type: int
    description: 24-bit display background color (CDC_BACKGND_COLOR).

  enable-l1:
    type: int
    required: false
    default: 0
    description: Enablement status of layer 1 (CDC_LAYER_CFG[0]).
    enum:
      - 0
      - 1

  enable-l2:
    type: int
    required: false
    default: 0
    description: Enablement status of layer 2 (CDC_LAYER_CFG[1]).
    enum:
      - 0
      - 1

  pixel-fmt-l1:
    type: string
    required: false
    description: Pixel format for Layer 1 (CDC_PIXEL_FORMAT).
    enum:
      - "argb-8888"
      - "rgb-888"
      - "rgb-565"
      - "rgba-8888"
      - "al-44"
      - "l-8"
      - "argb-1555"
      - "argb-4444"
      - "undefined"

  pixel-fmt-l2:
    type: string
    required: false
    description: Pixel format for Layer 2 (CDC_PIXEL_FORMAT).
    enum:
      - "argb-8888"
      - "rgb-888"
      - "rgb-565"
      - "rgba-8888"
      - "al-44"
      - "l-8"
      - "argb-1555"
      - "argb-4444"
      - "undefined"

  def-back-color-l1:
    type: int
    required: false
    description: Default per-layer background color - layer 1.

  def-back-color-l2:
    type: int
    required: false
    description: Default per-layer background color - layer 2.

  win-x0-l1:
    type: int
    description: Layer 1 window horizontal start (CDC_LAYER_CFG window).
  win-y0-l1:
    type: int
    description: Layer 1 window vertical start.
  win-x1-l1:
    type: int
    description: Layer 1 window horizontal stop.
  win-y1-l1:
    type: int
    description: Layer 1 window vertical stop.
  blend-factor1-l1:
    type: int
    description: Layer 1 blend factor F1 (CDC_BLEND_* selection).
  blend-factor2-l1:
    type: int
    description: Layer 1 blend factor F2.
  const-alpha-l1:
    type: int
    description: Layer 1 constant alpha (0..255).

  # The L2 (overlay-layer) window/blend props below are read UNCONDITIONALLY by
  # the driver's CDC200_DEFINE macro (.layer[1] init: win-x0/y0-l2, blend-factor1/
  # 2-l2, const-alpha-l2), so a node that declares only L1 (enable-l2 defaults 0)
  # must still resolve them.  Without a default DT_INST_PROP(i, ...) fails to
  # compile.  Defaults mirror the zephyr_alif fork's reset values so an L2-less
  # node behaves identically to the fork.
  win-x0-l2:
    type: int
    default: 0
    description: Layer 2 window horizontal start.
  win-y0-l2:
    type: int
    default: 0
    description: Layer 2 window vertical start.
  win-x1-l2:
    type: int
    description: Layer 2 window horizontal stop.
  win-y1-l2:
    type: int
    description: Layer 2 window vertical stop.
  blend-factor1-l2:
    type: int
    default: 6
    description: Layer 2 blend factor F1.
  blend-factor2-l2:
    type: int
    default: 7
    description: Layer 2 blend factor F2.
  const-alpha-l2:
    type: int
    default: 0xff
    description: Layer 2 constant alpha (0..255).
```

## zephyr/dts/bindings/flash_controller/alif,mram-flash-controller.yaml
```yaml
# Copyright (c) 2025 Alif Semiconductor
# Copyright (c) 2026 Alp Lab AB
#
# SPDX-License-Identifier: Apache-2.0
#
# ADR 0017 Tier-2 (vendored fork binding, INTERIM).  Binds the Alif Ensemble
# on-die MRAM flash controller (compatible "alif,mram-flash-controller", base
# 0x80000000) so the in-tree flash_mram_alif driver (a vendored copy of the
# Apache-2.0 zephyr_alif drivers/flash/flash_mram_alif.c) can attach and set
# FLASH_HAS_DRIVER_ENABLED for MCUboot's flash_map.  Upstream Zephyr v4.4 +
# hal_alif expose the MRAM only as a "zephyr,memory-region"/"soc-nv-flash"
# memory region (no flash driver).  Retire onto the opt-in sdk-alif fork once
# the MRAM node is repointed AND bench-verified.
# See docs/adr/0017-alp-sdk-over-the-vendor-sdk.md.

description: Alif SoC MRAM flash controller

compatible: "alif,mram-flash-controller"

include: flash-controller.yaml
```

## zephyr/dts/bindings/i2c/alif,lpi2c.yaml
```yaml
# Copyright (C) 2024 Alif Semiconductor.
# Copyright (c) 2026 Alp Lab AB
# SPDX-License-Identifier: Apache-2.0
#
# vendor-ext, BENCH-UNVERIFIED.
#
# Binding for the Alif Ensemble LPI2C (Low-Power I2C) controller. Ported from
# the Apache-2.0 alifsemi/zephyr_alif fork's dts/bindings/i2c/alif,lpi2c.yaml;
# upstream Zephyr v4.4 + hal_alif v2.2.0 do NOT ship it. Property names match
# the fork binding exactly. The driver is zephyr/drivers/i2c/i2c_alif_lpi2c.c.
#
# On the E1M-X / Ensemble E8 SoM this controller is LPI2C0 @0x43009000 on pins
# P7_4 (LPI2C0_SCL_A) / P7_5 (LPI2C0_SDA_A) -- the on-module "BRD_I2C"
# housekeeping bus (OPTIGA 0x30, RV-3028 RTC 0x52, TMP112 0x48, EEPROM 0x50).
#
# The fork register model has NO `clocks` property (the fork's lpi2c0 node
# carries none); the FIFO-mode driver does not program a bus clock. The fork
# node addresses/IRQ were transcribed from the fork DTS
# (dts/arm/alif/ensemble/common/e1.dtsi: reg = <0x43009000 0x100>,
# interrupts = <47 ...>). Not yet validated on silicon.

description: Alif LP-I2C node

compatible: "alif,lpi2c"

include: [base.yaml, i2c-controller.yaml, pinctrl-device.yaml]

properties:
  interrupts:
    required: true
```
