## zephyr/boards/alp/e1m_aen601_m55_hp/Kconfig.alp_e1m_aen601_m55_hp
```kconfig
# Copyright (c) 2026 Alp Lab AB
# SPDX-License-Identifier: Apache-2.0

config BOARD_ALP_E1M_AEN601_M55_HP
	select SOC_AE612FA0E5597LS0_RTSS_HP
```

## zephyr/boards/alp/e1m_aen601_m55_hp/Kconfig.defconfig
```kconfig
# Copyright (c) 2026 Alp Lab AB
# SPDX-License-Identifier: Apache-2.0

if BOARD_ALP_E1M_AEN601_M55_HP

# The Ensemble E6 RTSS-HP has CONFIG_NUM_IRQS=480, so the ARMv8-M vector table
# is (16 + 480) * 4 = 1984 bytes and VTOR must be 2 KiB (0x800) aligned.
# Bump the MCUboot header reservation to match so the chain-loaded jump
# target == _vector_table.  (Mirrors the AEN401/AEN801 M55-HP setting.)
config ROM_START_OFFSET
	default 0x800 if BOOTLOADER_MCUBOOT

endif # BOARD_ALP_E1M_AEN601_M55_HP
```

## zephyr/boards/alp/e1m_aen601_m55_hp/board.yml
```yaml
# Copyright (c) 2026 Alp Lab AB
# SPDX-License-Identifier: Apache-2.0
board:
  name: alp_e1m_aen601_m55_hp
  full_name: E1M-AEN601 (Alif Ensemble E6) Cortex-M55 HP carrier
  vendor: alp
  socs:
    - name: ae612fa0e5597ls0
```

## zephyr/boards/alp/e1m_aen801_m55_he/board.yml
```yaml
# Copyright (c) 2026 Alp Lab AB
# SPDX-License-Identifier: Apache-2.0
board:
  name: alp_e1m_aen801_m55_he
  full_name: E1M-AEN801 (Alif Ensemble E8) Cortex-M55 HE carrier
  vendor: alp
  socs:
    - name: ae822fa0e5597ls0
```

## zephyr/boards/alp/e1m_v2n101_m33_sm/Kconfig.alp_e1m_v2n101_m33_sm
```kconfig
# Copyright (c) 2026 Alp Lab AB
# SPDX-License-Identifier: Apache-2.0

config BOARD_ALP_E1M_V2N101_M33_SM
	select SOC_R9A09G056N48GBG_CM33
```

## zephyr/drivers/dma/Kconfig.dma_pl330_alif
```kconfig
# Copyright 2020 Broadcom
# SPDX-License-Identifier: Apache-2.0

config DMA_PL330_ALIF
	bool
	prompt "PL330 DMA driver (Alif peripheral-flow)"
	default y
	depends on DT_HAS_ALIF_DMA_PL330_ENABLED
	help
	  This option enables support of pl330 DMA Controller.

config DMA_PL330_ALIF_MAX_BLOCK_COUNT
	int "Maximum scatter-gather block count per channel"
	depends on DMA_PL330_ALIF
	default 2
	help
	  Number of dma_block_config entries pre-allocated per channel.
	  This is the maximum scatter-gather chain length accepted by
	  dma_config(). Increase if your application needs longer blocks.
```

## zephyr/drivers/usb/uhc/Kconfig
```kconfig
# Copyright 2026 Alp Lab AB
# SPDX-License-Identifier: Apache-2.0
rsource "Kconfig.xhci_alif"
```

## zephyr/drivers/usb/uhc/Kconfig.dwc2_alif
```kconfig
# Copyright 2026 Alp Lab AB
# SPDX-License-Identifier: Apache-2.0

config UHC_DWC2_ALIF
	bool "Alif Ensemble DWC2 USB host controller driver (SKELETON, bench-gated)"
	default y
	depends on DT_HAS_ALIF_DWC2_UHC_ENABLED
	depends on UHC_DRIVER
	help
	  SKELETON DWC2-host UHC driver for Alif Ensemble (E4/E6/E8).

	  The uhc_api op table, DT binding, register map (grounded from the
	  shared usb_dwc2_hw.h defines), and Kconfig are real.  Every host
	  bring-up path (bus reset, host-channel programming, transfer
	  completion, ISR) carries a TODO(aen401-bench) marker with the
	  intended DWC2 register sequence as a comment.

	  Do NOT enable this driver in production until the bench-gated paths
	  are filled in and validated on real AEN401 silicon.

	  Driver: zephyr/drivers/usb/uhc/uhc_dwc2_alif.c
	  Binding: zephyr/dts/bindings/usb/alif,dwc2-uhc.yaml
```

## zephyr/drivers/video/Kconfig.jpeg_hantro_vc9000e
```kconfig
# Vendored VERBATIM from the Apache-2.0 zephyr_alif fork
# (drivers/video/Kconfig.jpeg_hantro_vc9000e) @ d8eed1926407087dff150a1c4d25ba586d775746
# (branch main, repo alifsemi/zephyr_alif).  ADR 0017 Tier-2 (INTERIM).  The
# `default y` is safe: this symbol also `depends on
# DT_HAS_VERISILICON_HANTRO_VC9000E_JPEG_ENABLED`, so it stays off until a
# board overlay enables the "verisilicon,hantro-vc9000e-jpeg" node.  See
# zephyr/drivers/video/jpeg_hantro_vc9000e.c for the driver (vendored +
# v4.4-ported) and docs/adr/0017-alp-sdk-over-the-vendor-sdk.md.
#
# Copyright (c) 2026 Alif Semiconductor
# SPDX-License-Identifier: Apache-2.0

config VIDEO_JPEG_HANTRO_VC9000E
	bool "VeriSilicon Hantro VC9000E JPEG Hardware Encoder"
	default y
	depends on DT_HAS_VERISILICON_HANTRO_VC9000E_JPEG_ENABLED
	help
	  Enable support for VeriSilicon Hantro VC9000E JPEG hardware encoder.
	  Supports JPEG/MJPEG encoding with YUV420 input formats,
	  hardware-accelerated compression up to 2MP @ 200 FPS.

if VIDEO_JPEG_HANTRO_VC9000E

config VIDEO_JPEG_HANTRO_VC9000E_HEADER_SIZE
	int "JPEG header buffer size"
	default 623
	help
	  Size of JPEG header in bytes. The hardware encoder generates
	  the compressed data, but the header is generated in software.

config VIDEO_JPEG_HANTRO_VC9000E_MAX_WIDTH
	int "Maximum JPEG image width"
	default 16384
	help
	  Maximum supported image width in pixels.

config VIDEO_JPEG_HANTRO_VC9000E_MAX_HEIGHT
	int "Maximum JPEG image height"
	default 16384
	help
	  Maximum supported image height in pixels.

config VIDEO_JPEG_HANTRO_VC9000E_MIN_SIZE
	int "Minimum JPEG image dimension"
	default 32
	help
	  Minimum supported image width/height in pixels.

endif # VIDEO_JPEG_HANTRO_VC9000E
```

## zephyr/dts/bindings/adc/alp,adc-input.yaml
```yaml
# Copyright (c) 2026 Alp Lab AB
# SPDX-License-Identifier: Apache-2.0

description: |
  alp-sdk analog-input consumer.  Carries a single `io-channels` phandle that the
  portable ADC backend resolves via ADC_DT_SPEC_GET(DT_ALIAS(alp_adcN)) -- the
  alias points at a node of this binding, whose io-channels selects the ADC
  controller + input and whose channel@N config (gain/reference/vref-mv/...) the
  Zephyr ADC API reads.  This is the alp-sdk convention for binding an
  ALP_E1M_ADCn / EVK_ADC_* portable id to a concrete SoC ADC channel.

compatible: "alp,adc-input"

include: [base.yaml]

properties:
  io-channels:
    type: phandle-array
    required: true
    description: ADC controller + input cell for this analog input.
```

## zephyr/dts/bindings/alp,pin-array.yaml
```yaml
# Copyright 2026 Alp Lab AB
# SPDX-License-Identifier: Apache-2.0
#
# alp,pin-array — single devicetree node listing every GPIO the
# alp-studio pin allocator can hand to alp_gpio_open(pin_id).
#
# pin_id is the index into the `gpios` property: pin_id=0 is the
# first phandle, pin_id=1 the second, etc.  This keeps the studio's
# allocation logic decoupled from per-SoC GPIO controller numbering.

description: |
  Alp SDK pin array.  Used internally by src/zephyr/peripheral_gpio.c
  to translate a studio-resolved pin_id into a Zephyr gpio_dt_spec.

  Example:
    alp_pins: alp-pins {
        compatible = "alp,pin-array";
        gpios = <&gpio0 1 GPIO_ACTIVE_HIGH>,
                <&gpio0 2 GPIO_ACTIVE_HIGH>,
                <&gpio1 5 (GPIO_ACTIVE_LOW | GPIO_PULL_UP)>;
    };

compatible: "alp,pin-array"

properties:
  gpios:
    type: phandle-array
    required: true
    description: |
      Ordered list of GPIO specifiers.  Index N is bound to
      alp_gpio_open(N) at runtime.
```

## zephyr/dts/bindings/comparator/alif,cmp.yaml
```yaml
# Copyright (c) 2025 Alif Semiconductor
# Copyright (c) 2026 Alp Lab AB
# SPDX-License-Identifier: Apache-2.0
#
# Alif Ensemble analog comparator (HSCMP / LPCMP).  The compatible string and the
# driver_instance / positive_input / negative_input / hysteresis_level property
# names + enums are transcribed VERBATIM from the Apache-2.0 zephyr_alif fork
# binding (dts/bindings/comparator/alif,cmp.yaml).  Binds the alp-sdk Tier-2
# comparator_alif.c driver (zephyr/drivers/comparator/comparator_alif.c), which
# implements the upstream Zephyr v4.4 comparator class API
# (<zephyr/drivers/comparator.h>).
#
# This binding intentionally OMITS the fork's `clocks` / `cmp-gpios` properties:
# the alp-sdk build gates the CMP clock through the hal_alif analog_ctrl helper
# (CLKCTRL_PER_SLV->CMP_CTRL bit 0), not a DT clock phandle -- the fork's
# ALIF_CMP*_CLK packed values are 7-arg encodings that MUST NOT be copied onto
# the upstream alif,clockctrl (see reference_alif_clock_encoding_fork_vs_upstream).
# A board that wires the comparator output to a GPIO can add cmp-gpios in its own
# overlay; the internal-reference regcheck does not need it.

description: Alif Ensemble analog comparator (HSCMP / LPCMP)

compatible: "alif,cmp"

include: [base.yaml, pinctrl-device.yaml]

properties:
  reg:
    required: true

  driver_instance:
    type: string
    required: true
    description: Selects the comparator hardware instance.
    enum:
      - "CMP_INSTANCE_LP"
      - "CMP_INSTANCE_0"
      - "CMP_INSTANCE_1"
      - "CMP_INSTANCE_2"
      - "CMP_INSTANCE_3"

  positive_input:
    type: string
    required: true
    description: |
      Select the input routed to the positive terminal of the comparator
      (COMP_HS_IN_P_SEL, CMP_COMP_REG1 bits [1:0]).  CMP_POS_IN0..IN3 select the
      CMPx_IN0..IN3 analog pads.
    enum:
      - "CMP_POS_IN0"
      - "CMP_POS_IN1"
      - "CMP_POS_IN2"
      - "CMP_POS_IN3"

  negative_input:
    type: string
    required: true
    description: |
      Select the input routed to the negative terminal of the comparator
      (COMP_HS_IN_M_SEL, CMP_COMP_REG1 bits [3:2]).  CMP_NEG_IN0 = VREF_IN0 pin,
      CMP_NEG_IN1 = VREF_IN1 pin, CMP_NEG_IN2 = internal Vref, CMP_NEG_IN3 = the
      on-chip DAC6 programmable reference (the internal-reference path -- no
      external wiring needed).
    enum:
      - "CMP_NEG_IN0"
      - "CMP_NEG_IN1"
      - "CMP_NEG_IN2"
      - "CMP_NEG_IN3"

  hysteresis_level:
    type: string
    required: true
    description: |
      Comparator hysteresis level (COMP_HS_HYST, CMP_COMP_REG1 bits [6:4]); 6 mV
      per step.
    enum:
      - "0mV"
      - "6mV"
      - "12mV"
      - "18mV"
      - "24mV"
      - "30mV"
      - "36mV"
      - "42mV"

  polarity_en:
    type: boolean
    description: Invert the comparator result (CMP_POLARITY_CTRL).

  prescaler:
    type: int
    description: |
      Comparator filter prescaler -- number of clocks between filter-tap updates
      (CMP_PRESCALER_CTRL).  Max 0x3F.

  filter_taps:
    type: int
    description: |
      Number of comparator filter taps, 2..8 (CMP_FILTER_CTRL).  Enabling the
      filter also sets CMP_FILTER_CONTROL_ENABLE (bit 0).

  cmp-gpios:
    type: phandle-array
    description: |
      Optional GPIO(s) the comparator output is routed to on a board.  Carried
      for parity with the fork binding; the internal-reference regcheck does not
      use it.
```

## zephyr/dts/bindings/counter/alif,lptimer.yaml
```yaml
# Copyright (c) 2026 Alp Lab AB
#
# SPDX-License-Identifier: Apache-2.0
#
# Alif Ensemble LPTIMER (low-power timer), bound as a Zephyr counter-class
# device (a free-running 32-bit DOWN-counter with one underflow alarm channel)
# by the alp-sdk Tier-1.5 driver zephyr/drivers/counter/counter_alif_lptimer.c
# (compatible "alif,lptimer").  On the E8 SoM this models the always-on
# lptimer@42001000 block: four independent channels, each clocked from the
# VBAT-domain low-frequency source.
#
# This is a DISTINCT always-on IP from the LPRTC ("snps,dw-apb-rtc",
# lprtc@42000000) and the UTIMER ("alif,utimer-counter").  Clean-room: the
# alifsemi/zephyr_alif fork ships NO "alif,lptimer" binding and NO Zephyr
# LPTIMER driver; register model transcribed from the Alif DFP
# (drivers/include/lptimer.h + sys_ctrl_lptimer.h).  ADR 0017 Tier-1.5,
# BENCH-UNVERIFIED.

description: Alif Ensemble LPTIMER counter channel

compatible: "alif,lptimer"

include: base.yaml

properties:
  reg:
    required: true
    description: LPTIMER block base address and size.

  interrupts:
    required: true
    description: The selected channel's underflow interrupt.

  channel:
    type: int
    required: true
    enum: [0, 1, 2, 3]
    description: |
      LPTIMER channel index (0..3).  Selects the per-channel config block
      (base + channel * 0x14) and the matching VBAT TIMER_CLKSEL field.
      Channels 0 and 2 do NOT support the cascade clock source.

  clock-source:
    type: int
    required: true
    enum: [0, 1, 2, 3]
    description: |
      VBAT TIMER_CLKSEL clock source for this channel
      (Alif DFP sys_ctrl_lptimer.h enum LPTIMER_CLK_SRC):
        0 = 32 kHz, 1 = 128 kHz, 2 = external, 3 = cascade.
      Must match clock-frequency.

  clock-frequency:
    type: int
    required: true
    description: |
      Counter tick rate in Hz, i.e. the selected clock-source frequency
      (32768 for 32 kHz, 131072 for 128 kHz, ...).  Used only to scale
      counter_us_to_ticks(); it does not program any register.
```

## zephyr/dts/bindings/counter/alif,utimer-counter.yaml
```yaml
# Copyright (c) 2025 Alif Semiconductor
# Copyright (c) 2026 Alp Lab AB
#
# SPDX-License-Identifier: Apache-2.0

# Alif UTIMER counter-mode child node.
#
# The fork's UTIMER DTS shape places a `counter { compatible =
# "alif,utimer-counter"; }` child under the alif,utimer parent.  The alp-sdk
# counter driver (zephyr/drivers/counter/counter_alif_utimer.c) binds the
# PARENT alif,utimer compatible directly (it reads both reg windows + timer-id
# from the parent), so this binding exists only so the disabled child node
# validates against the devicetree schema.  No driver binds it.
#
# Transcribed from the Apache-2.0 alifsemi/zephyr_alif fork
# (dts/bindings/counter/alif,utimer-counter.yaml).  vendor-ext, BENCH-VERIFIED
# (2026-06-17 E8 bench pass).

description: Alif UTIMER in counter mode

compatible: "alif,utimer-counter"

include: base.yaml
```

## zephyr/dts/bindings/counter/snps,dw-apb-rtc.yaml
```yaml
# Copyright (c) 2023 Alif Semiconductor.
# Copyright (c) 2026 Alp Lab AB
#
# SPDX-License-Identifier: Apache-2.0
#
# Synopsys DesignWare APB RTC, used as a Zephyr counter-class device (a
# free-running 32-bit up-counter with a single compare/alarm channel -- NOT a
# calendar RTC).  Bound by the alp-sdk Tier-2 driver
# zephyr/drivers/counter/counter_dw_rtc.c (compatible "snps,dw-apb-rtc"); on the
# E8 SoM this models lprtc@42000000.
#
# Vendored VERBATIM from the Apache-2.0 alifsemi/zephyr_alif fork
# (dts/bindings/counter/snps,dw-apb-rtc.yaml, commit da4a9034) -- upstream
# Zephyr v4.4 ships no snps,dw-apb-rtc binding (its snps,dw-timers is a
# different DW APB Timers IP).  vendor-ext, BENCH-UNVERIFIED.

description: Synopsys DesignWare RTC counter node

compatible: "snps,dw-apb-rtc"

include: base.yaml

properties:
  reg:
    required: true

  interrupts:
    required: true

  wrap-enable:
    type: boolean
    description: Wrap mode enable disable

  prescaler:
    type: int
    description: prescaler load value

  load-value:
    type: int
    description: counter load value

  clock-frequency:
    type: int
    description: counter clock frequency
```
