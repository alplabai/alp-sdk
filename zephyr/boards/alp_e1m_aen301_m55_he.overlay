/*
 * Copyright 2026 Alp Lab AB
 * SPDX-License-Identifier: Apache-2.0
 *
 * Devicetree overlay for the M55-HE slice of an E1M-AEN301
 * (Alif Ensemble E3, no A-class) heterogeneous project.
 *
 * NOTE: the AEN preset's `mailbox.controller` is still TBD (per
 * `metadata/e1m_modules/E1M-AEN301.yaml`).  See the M55-HP
 * overlay's note for the build-time guard rails.
 */

#include "../../build/generated/dts-reservations.dtsi"

/ {
    chosen {
        zephyr,ipc     = &ipc0;
        zephyr,ipc-shm = &alp_default_rpmsg;
    };

    soc {
        ipc0: ipc@0 {
            compatible = "zephyr,ipc-openamp-static-vrings";
            memory-region = <&alp_default_rpmsg>;
            /* TBD: insert mailbox controller phandle when the AEN
             *      hand-written HW config supplies it. */
            mbox-names = "tx", "rx";
            role = "remote";
            status = "okay";
        };
    };
};
