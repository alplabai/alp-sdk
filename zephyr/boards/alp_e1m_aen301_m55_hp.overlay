/*
 * Copyright 2026 Alp Lab AB
 * SPDX-License-Identifier: Apache-2.0
 *
 * Devicetree overlay for the M55-HP slice of an E1M-AEN301
 * (Alif Ensemble E3, no A-class) heterogeneous project.
 */

#include "alp_e1m_aen_m55_hp_mhuv2.overlay.inc"
