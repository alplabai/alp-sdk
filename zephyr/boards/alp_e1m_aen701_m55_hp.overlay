/*
 * Copyright 2026 Alp Lab AB
 * SPDX-License-Identifier: Apache-2.0
 *
 * Devicetree overlay for the M55-HP slice of an E1M-AEN701
 * (Alif Ensemble E7) heterogeneous project.
 */

#include "alp_e1m_aen_m55_hp_mhuv2.overlay.inc"
