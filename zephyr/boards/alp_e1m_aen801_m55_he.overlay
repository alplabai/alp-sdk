/*
 * Copyright 2026 Alp Lab AB
 * SPDX-License-Identifier: Apache-2.0
 *
 * Devicetree overlay for the M55-HE slice of an E1M-AEN801
 * (Alif Ensemble E8) heterogeneous project.
 */

#include "alp_e1m_aen_m55_he_mhuv2.overlay.inc"
