/*
 * Copyright 2026 Alp Lab AB
 * SPDX-License-Identifier: Apache-2.0
 *
 * Devicetree overlay for the M55-HE slice of an E1M-AEN401
 * (Alif Ensemble E4, no A-class) heterogeneous project.
 */

#include "alp_e1m_aen_m55_he_mhuv2.overlay.inc"
