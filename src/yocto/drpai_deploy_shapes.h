/*
 * Copyright 2026 Alp Lab AB
 * SPDX-License-Identifier: Apache-2.0
 *
 * deploy.json (TVM graph-runtime JSON) rank/shape recovery for the
 * Renesas DRP-AI inference backend (issue #1635) -- see the "deploy.json
 * rank/shape recovery" section of inference_drpai.cpp for the full
 * rationale.  Split into its own header, standalone from the rest of
 * that file, for exactly one reason: this parser has ZERO dependency on
 * MeraDrpRuntimeWrapper.h / <linux/drpai.h> / the RUHMI TVM sysroot that
 * the rest of inference_drpai.cpp needs to compile, so keeping it here
 * lets tests/native/drpai_deploy_shapes/test_deploy_shapes.cpp exercise
 * the real parser directly with a plain host compiler -- no vendor SDK,
 * no Zephyr, no DRP-AI hardware.  inference_drpai.cpp includes this
 * header and uses its symbols unqualified via `using namespace
 * alp_drpai;` inside its own anonymous namespace; nothing here is
 * meant to be included by more than those two translation units, and
 * every function is `inline` accordingly (header-only, safe to include
 * from both without an ODR violation).
 *
 * alp-sdk carries no JSON library (see inference_drpai.cpp's file
 * header), so this is a minimal recursive-descent scanner for exactly
 * one machine-generated structure (TVM's deploy.json graph JSON) --
 * not a general-purpose JSON parser.
 */
#ifndef ALP_SDK_YOCTO_DRPAI_DEPLOY_SHAPES_H
#define ALP_SDK_YOCTO_DRPAI_DEPLOY_SHAPES_H

#include <cstdint>
#include <cstdio>
#include <cstring>
#include <string>
#include <utility>
#include <vector>

namespace alp_drpai
{

/** One parsed JSON value: enough of the grammar to walk deploy.json
 *  (objects, arrays, strings, numbers, true/false/null) -- no more. */
struct JsonValue {
	enum class Kind { Null, Bool, Number, String, Array, Object } kind = Kind::Null;
	double                                         number              = 0;
	std::string                                    str;
	std::vector<JsonValue>                         arr;
	std::vector<std::pair<std::string, JsonValue>> obj;

	/** First member named @p key, or nullptr.  Object-only; nullptr on any
	 *  other kind or a missing key. */
	const JsonValue *find(const std::string &key) const
	{
		for (auto &kv : obj) {
			if (kv.first == key) {
				return &kv.second;
			}
		}
		return nullptr;
	}
};

/** Recursive-descent parser for the JsonValue grammar above.  Every
 *  `parse_*` returns false on the first malformed byte instead of
 *  guessing -- deploy.json is machine-generated by our own compiler, so a
 *  parse failure means "not the file we expect", and _drpai_parse_deploy_shapes()
 *  treats that identically to a missing file. */
class JsonParser
{
  public:
	JsonParser(const char *s, size_t n) : p_(s), end_(s + n)
	{
	}

	bool parse(JsonValue &out)
	{
		skip_ws();
		return parse_value(out);
	}

  private:
	const char *p_;
	const char *end_;

	void skip_ws()
	{
		while (p_ < end_ && (*p_ == ' ' || *p_ == '\t' || *p_ == '\n' || *p_ == '\r')) {
			++p_;
		}
	}

	bool parse_value(JsonValue &out)
	{
		skip_ws();
		if (p_ >= end_) {
			return false;
		}
		switch (*p_) {
		case '{':
			return parse_object(out);
		case '[':
			return parse_array(out);
		case '"':
			return parse_string(out);
		case 't':
		case 'f':
			return parse_bool(out);
		case 'n':
			return parse_null(out);
		default:
			return parse_number(out);
		}
	}

	bool parse_object(JsonValue &out)
	{
		out.kind = JsonValue::Kind::Object;
		++p_;
		skip_ws();
		if (p_ < end_ && *p_ == '}') {
			++p_;
			return true;
		}
		for (;;) {
			skip_ws();
			JsonValue key;
			if (!parse_string(key)) {
				return false;
			}
			skip_ws();
			if (p_ >= end_ || *p_ != ':') {
				return false;
			}
			++p_;
			JsonValue val;
			if (!parse_value(val)) {
				return false;
			}
			out.obj.emplace_back(std::move(key.str), std::move(val));
			skip_ws();
			if (p_ >= end_) {
				return false;
			}
			if (*p_ == ',') {
				++p_;
				continue;
			}
			if (*p_ == '}') {
				++p_;
				return true;
			}
			return false;
		}
	}

	bool parse_array(JsonValue &out)
	{
		out.kind = JsonValue::Kind::Array;
		++p_;
		skip_ws();
		if (p_ < end_ && *p_ == ']') {
			++p_;
			return true;
		}
		for (;;) {
			JsonValue val;
			if (!parse_value(val)) {
				return false;
			}
			out.arr.push_back(std::move(val));
			skip_ws();
			if (p_ >= end_) {
				return false;
			}
			if (*p_ == ',') {
				++p_;
				continue;
			}
			if (*p_ == ']') {
				++p_;
				return true;
			}
			return false;
		}
	}

	bool parse_string(JsonValue &out)
	{
		if (p_ >= end_ || *p_ != '"') {
			return false;
		}
		++p_;
		std::string s;
		while (p_ < end_ && *p_ != '"') {
			if (*p_ == '\\') {
				++p_;
				if (p_ >= end_) {
					return false;
				}
				/* Node/dtype names in a TVM deploy.json are plain
				 * identifiers -- no \u escapes to decode -- so an
				 * unrecognised escape just passes the raw byte through. */
				switch (*p_) {
				case '"':
					s += '"';
					break;
				case '\\':
					s += '\\';
					break;
				case '/':
					s += '/';
					break;
				case 'n':
					s += '\n';
					break;
				case 't':
					s += '\t';
					break;
				default:
					s += *p_;
					break;
				}
				++p_;
			} else {
				s += *p_++;
			}
		}
		if (p_ >= end_) {
			return false; /* unterminated string */
		}
		++p_;
		out.kind = JsonValue::Kind::String;
		out.str  = std::move(s);
		return true;
	}

	bool parse_bool(JsonValue &out)
	{
		if (end_ - p_ >= 4 && std::strncmp(p_, "true", 4) == 0) {
			p_ += 4;
			out.kind   = JsonValue::Kind::Bool;
			out.number = 1;
			return true;
		}
		if (end_ - p_ >= 5 && std::strncmp(p_, "false", 5) == 0) {
			p_ += 5;
			out.kind   = JsonValue::Kind::Bool;
			out.number = 0;
			return true;
		}
		return false;
	}

	bool parse_null(JsonValue &out)
	{
		if (end_ - p_ >= 4 && std::strncmp(p_, "null", 4) == 0) {
			p_ += 4;
			out.kind = JsonValue::Kind::Null;
			return true;
		}
		return false;
	}

	bool parse_number(JsonValue &out)
	{
		const char *start = p_;
		if (p_ < end_ && *p_ == '-') {
			++p_;
		}
		while (p_ < end_ && ((*p_ >= '0' && *p_ <= '9') || *p_ == '.' || *p_ == 'e' || *p_ == 'E' ||
		                     *p_ == '+' || *p_ == '-')) {
			++p_;
		}
		if (p_ == start) {
			return false;
		}
		char  *parsed_end = nullptr;
		double v          = std::strtod(start, &parsed_end);
		if (parsed_end != p_) {
			return false;
		}
		out.kind   = JsonValue::Kind::Number;
		out.number = v;
		return true;
	}
};

/** Read @p path whole into @p out.
 *  @return false on any open/read error (leaves @p out unspecified). */
inline bool _read_file(const std::string &path, std::string &out)
{
	FILE *f = std::fopen(path.c_str(), "rb");
	if (f == nullptr) {
		return false;
	}
	out.clear();
	char   buf[4096];
	size_t n;
	while ((n = std::fread(buf, 1, sizeof(buf), f)) > 0) {
		out.append(buf, n);
	}
	const bool ok = (std::feof(f) != 0) && (std::ferror(f) == 0);
	std::fclose(f);
	return ok;
}

/** Per-tensor shapes recovered from deploy.json, in the SAME order as the
 *  file's `arg_nodes`/`heads` -- i.e. TVM graph-input order for inputs,
 *  `GetOutput(idx)` order for outputs (see the correlation comment at the
 *  open() call site).  An empty shape entry means "left unresolved". */
struct DeployShapes {
	std::vector<std::string>           input_names;
	std::vector<std::vector<uint16_t>> input_shapes;
	std::vector<std::vector<uint16_t>> output_shapes;
};

/** Resolve one shape-table row (@p row within @p rows, the parsed
 *  `attrs.shape` list) into @p out.
 *
 *  @return false when the row itself is untrustworthy (out of range, not
 *          an array, or holding something other than a clean 0..65535
 *          integer per dim) -- the caller treats that as "deploy.json
 *          doesn't match the expected shape" and bails the whole parse.
 *          Returns true with @p out left EMPTY for a rank > 4 tensor: that
 *          is a legitimate model shape, not corruption, so it does not
 *          invalidate the rest of the file -- alp_inference_tensor_t.shape
 *          is a frozen uint16_t[4] ([ABI-STABLE] include/alp/inference.h),
 *          and sibling backends silently truncated a rank > 4 tensor to its
 *          first 4 dims (issue #1729); this backend leaves that tensor's
 *          rank at 0 instead of repeating that defect.
 *
 *          Note: a row that IS a clean, empty JSON array (`[]`) -- a
 *          legitimately rank-0 (scalar) tensor -- also returns true with
 *          @p out left empty, and is therefore indistinguishable at this
 *          layer from "unresolved" (missing/mismatched/corrupt).  Callers
 *          only ever see `rank == 0` either way; a real scalar output is
 *          not currently representable as anything other than "no shape
 *          available". */
inline bool
_shape_from_row(const std::vector<JsonValue> &rows, long row, std::vector<uint16_t> &out)
{
	if (row < 0 || static_cast<size_t>(row) >= rows.size() ||
	    rows[row].kind != JsonValue::Kind::Array) {
		return false;
	}
	out.clear();
	if (rows[row].arr.size() > 4) {
		return true; /* rank > 4 -- see #1729 note above; leave unresolved */
	}
	for (auto &d : rows[row].arr) {
		if (d.kind != JsonValue::Kind::Number || d.number < 0 || d.number > 65535 ||
		    d.number != static_cast<double>(static_cast<long>(d.number))) {
			return false; /* not a clean non-negative uint16 dim */
		}
		out.push_back(static_cast<uint16_t>(d.number));
	}
	return true;
}

/** Parse `<model_dir>/deploy.json` (the TVM graph-runtime JSON tarred into
 *  every drpai_dir blob) and resolve each graph input/output's shape.
 *
 *  @return false when the file couldn't be trusted at all -- missing,
 *          unreadable, or not the expected TVM graph-JSON shape (a missing
 *          key, wrong type, or a corrupt dim).  Callers only consult
 *          @p out after a true return, so a false return is equivalent to
 *          "no shapes available for any tensor" -- i.e. today's rank == 0
 *          behaviour, unchanged. */
inline bool _drpai_parse_deploy_shapes(const std::string &model_dir, DeployShapes &out)
{
	std::string text;
	if (!_read_file(model_dir + "/deploy.json", text)) {
		return false;
	}

	JsonParser parser(text.data(), text.size());
	JsonValue  root;
	if (!parser.parse(root) || root.kind != JsonValue::Kind::Object) {
		return false;
	}

	const JsonValue *nodes       = root.find("nodes");
	const JsonValue *row_ptr_v   = root.find("node_row_ptr");
	const JsonValue *arg_nodes_v = root.find("arg_nodes");
	const JsonValue *heads_v     = root.find("heads");
	const JsonValue *attrs_v     = root.find("attrs");
	if (nodes == nullptr || nodes->kind != JsonValue::Kind::Array || row_ptr_v == nullptr ||
	    row_ptr_v->kind != JsonValue::Kind::Array || arg_nodes_v == nullptr ||
	    arg_nodes_v->kind != JsonValue::Kind::Array || heads_v == nullptr ||
	    heads_v->kind != JsonValue::Kind::Array || attrs_v == nullptr ||
	    attrs_v->kind != JsonValue::Kind::Object) {
		return false;
	}

	/* TVM's `list_shape` wrapper: ["list_shape", [[dim,dim,...], ...]],
	 * one row per (node, output-slot) pair, indexed via node_row_ptr. */
	const JsonValue *shape_v = attrs_v->find("shape");
	if (shape_v == nullptr || shape_v->kind != JsonValue::Kind::Array || shape_v->arr.size() != 2 ||
	    shape_v->arr[1].kind != JsonValue::Kind::Array) {
		return false;
	}
	const std::vector<JsonValue> &shape_rows = shape_v->arr[1].arr;

	if (row_ptr_v->arr.size() != nodes->arr.size() + 1) {
		return false;
	}
	std::vector<long> row_ptr;
	row_ptr.reserve(row_ptr_v->arr.size());
	for (auto &v : row_ptr_v->arr) {
		if (v.kind != JsonValue::Kind::Number || v.number < 0) {
			return false;
		}
		row_ptr.push_back(static_cast<long>(v.number));
	}

	/* Inputs: one row per arg_nodes[i].  A TVM placeholder ("null" op)
	 * node always has exactly one output, so its row is row_ptr[node_idx]
	 * -- verify that rather than assume it. */
	for (auto &an : arg_nodes_v->arr) {
		if (an.kind != JsonValue::Kind::Number) {
			return false;
		}
		const long node_idx = static_cast<long>(an.number);
		if (node_idx < 0 || static_cast<size_t>(node_idx) >= nodes->arr.size()) {
			return false;
		}
		if (row_ptr[static_cast<size_t>(node_idx) + 1] - row_ptr[node_idx] != 1) {
			return false; /* not a single-output placeholder node */
		}

		const JsonValue  *name_v = nodes->arr[node_idx].find("name");
		const std::string name   = (name_v != nullptr && name_v->kind == JsonValue::Kind::String)
		                               ? name_v->str
		                               : std::string();

		std::vector<uint16_t> shape;
		if (!_shape_from_row(shape_rows, row_ptr[node_idx], shape)) {
			return false;
		}
		out.input_names.push_back(name);
		out.input_shapes.push_back(std::move(shape));
	}

	/* Outputs: heads[k] is [node_idx, out_idx, version].  GetOutput(idx)
	 * already indexes this same array by position (see get_output() /
	 * invoke() below), so heads order IS the output index order -- no
	 * name to correlate on, just resolve each row. */
	for (auto &head : heads_v->arr) {
		if (head.kind != JsonValue::Kind::Array || head.arr.size() < 2 ||
		    head.arr[0].kind != JsonValue::Kind::Number ||
		    head.arr[1].kind != JsonValue::Kind::Number) {
			return false;
		}
		const long node_idx = static_cast<long>(head.arr[0].number);
		const long out_idx  = static_cast<long>(head.arr[1].number);
		if (node_idx < 0 || static_cast<size_t>(node_idx) >= nodes->arr.size()) {
			return false;
		}
		if (out_idx < 0 ||
		    out_idx >= row_ptr[static_cast<size_t>(node_idx) + 1] - row_ptr[node_idx]) {
			return false;
		}

		std::vector<uint16_t> shape;
		if (!_shape_from_row(shape_rows, row_ptr[node_idx] + out_idx, shape)) {
			return false;
		}
		out.output_shapes.push_back(std::move(shape));
	}

	return true;
}

/** Correlate the runtime's reported input @p names against
 *  _drpai_parse_deploy_shapes()'s @p ds and fill @p out_shapes (already
 *  sized to `names.size()`) with the matched shape per index; an
 *  unmatched slot is left at its existing (default: empty/rank-0) value.
 *
 *  Positional (graph-input order) fallback fires ONLY when NO input
 *  matched by name and the counts agree.  A mixed match -- some names
 *  hit, some don't -- must NOT fall back per-tensor: the unmatched
 *  slot would take `ds.input_shapes[i]`, a slot another tensor already
 *  claimed by name, which is a wrong shape -- worse than the honest
 *  rank 0 this function exists to prefer over guessing (alp-sdk#1635
 *  review finding). */
inline void correlate_input_shapes(const std::vector<std::string>     &names,
                                   const DeployShapes                 &ds,
                                   std::vector<std::vector<uint16_t>> &out_shapes)
{
	bool any_matched = false;
	for (size_t i = 0; i < names.size(); ++i) {
		for (size_t j = 0; j < ds.input_names.size(); ++j) {
			if (ds.input_names[j] == names[i]) {
				out_shapes[i] = ds.input_shapes[j];
				any_matched   = true;
				break;
			}
		}
	}
	if (!any_matched && ds.input_shapes.size() == names.size()) {
		for (size_t i = 0; i < names.size(); ++i) {
			out_shapes[i] = ds.input_shapes[i];
		}
	}
}

} /* namespace alp_drpai */

#endif /* ALP_SDK_YOCTO_DRPAI_DEPLOY_SHAPES_H */
