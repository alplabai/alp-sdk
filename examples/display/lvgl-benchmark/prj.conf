## CMakeLists.txt
```
# SPDX-License-Identifier: Apache-2.0
cmake_minimum_required(VERSION 3.20.0)

# Auto-apply the RK055HDMIPI4MA0 DSI shield on the AEN M55-HP board targets
# (`alp_e1m_aen801_m55_hp/...`, `alp_e1m_aen803_m55_hp/...`): the E1M-EVK
# has no panel on its own, and the shield provides the `zephyr,display`
# chosen node and `alp-display0` alias alp_display_open() binds to (#2885,
# the same panel examples/connectivity/iot-dashboard uses, #2173).  Skipped
# when the caller already set SHIELD, so a different panel can be swapped
# in; inert on every other target, including native_sim.  BOARD is read
# from the environment or the sysbuild cache when it is not a -D entry --
# see examples/connectivity/iot-dashboard/CMakeLists.txt for why.
if(NOT DEFINED BOARD AND DEFINED ENV{BOARD})
    set(BOARD $ENV{BOARD})
endif()
if(NOT DEFINED BOARD AND DEFINED SYSBUILD_CACHE AND EXISTS "${SYSBUILD_CACHE}")
    file(STRINGS "${SYSBUILD_CACHE}" _alp_sysbuild_board_line REGEX "^BOARD:STRING=")
    if(_alp_sysbuild_board_line)
        string(REGEX REPLACE "^BOARD:STRING=" "" BOARD "${_alp_sysbuild_board_line}")
    endif()
endif()
if(DEFINED BOARD AND BOARD MATCHES "^alp_e1m_aen80[13]_m55_hp(/|$)" AND NOT DEFINED SHIELD)
    list(APPEND SHIELD e1m_evk_rk055hdmipi4ma0)
endif()

find_package(Zephyr REQUIRED HINTS $ENV{ZEPHYR_BASE})
project(lvgl_benchmark LANGUAGES C)

set(LVGL_DIR ${ZEPHYR_LVGL_MODULE_DIR})
# The benchmark demo internally calls lv_demo_widgets() to drive
# the same scene set the widgets demo paints, so we pull in the
# full widgets tree alongside the benchmark sources.
file(GLOB LV_BENCH_SRC
    ${LVGL_DIR}/demos/benchmark/*.c
    ${LVGL_DIR}/demos/benchmark/assets/*.c
    ${LVGL_DIR}/demos/widgets/*.c
    ${LVGL_DIR}/demos/widgets/assets/*.c
)
target_sources(app PRIVATE
    src/main.c
    ${LV_BENCH_SRC}
    ${LVGL_DIR}/demos/lv_demos.c
)
target_include_directories(app PRIVATE
    ${LVGL_DIR}/demos
    ${LVGL_DIR}/demos/benchmark
    ${LVGL_DIR}/demos/widgets
)
```

## prj.conf
```kconfig
# SPDX-License-Identifier: Apache-2.0
CONFIG_MAIN_STACK_SIZE=8192
CONFIG_HEAP_MEM_POOL_SIZE=131072

CONFIG_LV_USE_DEMO_BENCHMARK=y

CONFIG_LV_Z_VDB_SIZE=50
CONFIG_LV_COLOR_DEPTH_16=y
# 60 fps target -- benchmark wants the headroom.
CONFIG_LV_DEF_REFR_PERIOD=16

# LVGL's own internal allocator pool -- see lvgl-widgets-demo/prj.conf
# for why the 2048-byte Kconfig default is unsafe (undersizing it
# doesn't fail cleanly, it crashes on the resulting NULL). The
# benchmark scene set is lighter than lv_demo_widgets() but still
# needs headroom beyond the default.
CONFIG_LV_Z_MEM_POOL_SIZE=65536

CONFIG_LOG=y
CONFIG_LOG_PRINTK=y

# Display subsystem.  The actual panel driver is devicetree-specific:
# real silicon binds the ST7789 through Zephyr's display/MIPI DBI
# nodes, while native_sim has no panel and pulls CONFIG_DUMMY_DISPLAY=y
# from the per-example native_sim.conf overlay (wired in testcase.yaml).
CONFIG_DISPLAY=y

# This app binds LVGL to the panel itself via <alp/gui.h>'s
# alp_gui_lvgl_attach() (src/main.c) -- see lvgl-widgets-demo/prj.conf
# for the full rationale on turning Zephyr's own lvgl auto-init off.
CONFIG_LV_Z_AUTO_INIT=n
```

## native_sim.conf
```kconfig
# SPDX-License-Identifier: Apache-2.0
#
# native_sim-only overlay.  native_sim has no real ST7789 panel, so
# bind Zephyr's dummy display driver: it lets the benchmark harness
# link and run the build-only twister check without an SDL/X11
# dependency.  On real silicon this file is NOT applied; the board
# devicetree binds the actual ST7789 display node instead.
CONFIG_DUMMY_DISPLAY=y

# native_sim's DTS also carries a zephyr,sdl-dc node, so CONFIG_DISPLAY=y
# (prj.conf) drags in the SDL display driver by default alongside the
# dummy one above -- see lvgl-widgets-demo/native_sim.conf for why
# that segfaults headless. This app never opens that device, so keep
# SDL out of the build entirely.
CONFIG_SDL_DISPLAY=n
```

## boards/native_sim_native_64.overlay
```dts
/*
 * Copyright 2026 Alp Lab AB
 * SPDX-License-Identifier: Apache-2.0
 *
 * native_sim board overlay -- chooses zephyr's dummy display
 * driver so the LVGL demo links without a real display chip.
 * Real-silicon builds (alif / v2n) bring up the actual panel
 * (ST7789 / ILI9488 / DSI etc.) via the SoM board overlay.
 */

/ {
	chosen {
		zephyr,display = &dummy_dc;
	};

	dummy_dc: dummy_dc {
		compatible = "zephyr,dummy-dc";
		height = <320>;
		width = <240>;
	};
};
```

## src/main.c
```c
/*
 * Copyright 2026 Alp Lab AB
 * SPDX-License-Identifier: Apache-2.0
 *
 * lvgl-benchmark
 * ==============
 *
 * Wraps the upstream `lv_demo_benchmark()` -- the canonical LVGL
 * performance test that walks through a fixed scene set (gradient
 * fills, alpha blends, text rendering, image rotation, ...) and
 * reports per-scene FPS at the end.
 *
 *
 * ── What it measures ───────────────────────────────────────────
 *
 * Run on an E1M-AEN801 (E8 silicon -- GPU2D + DAVE2D + DMA2D
 * populated) vs E1M-AEN301 (E3 -- pure-C blit only) to see the
 * §D.lib.loader's `capabilities:`-driven binding choice land on the
 * frame-rate.  Run on native_sim/native/64 for the CPU-only
 * baseline.
 *
 * Typical results (paper-correct -- v1.0 HiL fills these in):
 *
 *   ┌──────────────────────────────┬──────────┬──────────┬─────────┐
 *   │ Target                        │ Scene A   │ Scene F   │ Total   │
 *   ├──────────────────────────────┼──────────┼──────────┼─────────┤
 *   │ AEN801 (GPU2D + DMA2D)        │ TBD       │ TBD       │ TBD     │
 *   │ AEN301 (pure-C blit, DMA2D)   │ TBD       │ TBD       │ TBD     │
 *   │ native_sim/native/64 (SDL2)   │ TBD       │ TBD       │ TBD     │
 *   └──────────────────────────────┴──────────┴──────────┴─────────┘
 *
 *
 * ── Why this matters ───────────────────────────────────────────
 *
 * Customers picking between Ensemble SKUs care about the cost of
 * rendering: a smart-thermostat UI that runs at 60 fps on E8 may
 * cap at 18 fps on E3.  This demo lets them measure that on their
 * actual board + panel combination without writing benchmark
 * code themselves.
 */

#include <zephyr/kernel.h>
#include <zephyr/logging/log.h>

#include <alp/display.h>
#include <alp/gui.h>

#include <lv_demo_benchmark.h>

LOG_MODULE_REGISTER(lvgl_benchmark, LOG_LEVEL_INF);

int main(void)
{
	LOG_INF("LVGL benchmark starting");

	/* Open the panel through the portable display surface -- see
     * lvgl-widgets-demo/src/main.c for the full rationale on this
     * open -> lv_init -> tick -> attach sequence, and why
     * CONFIG_LV_Z_AUTO_INIT=n (prj.conf) is required alongside it. */
	alp_display_config_t display_cfg = ALP_DISPLAY_CONFIG_DEFAULT(0);
	/* This app owns the panel, so it opts in to driving the mode.
	 * Ignored on Zephyr; on Yocto/Linux it is required, because
	 * opening a display there reprograms a live output (#1143). */
	display_cfg.allow_modeset        = true;
	alp_display_t       *display     = alp_display_open(&display_cfg);
	if (display == NULL) {
		LOG_ERR("display open failed (err=%d)", (int)alp_last_error());
		return 1;
	}

	/* Initialise LVGL (allocates global state -- styles, timers, ...)
     * and wire its millisecond tick source ourselves: with
     * CONFIG_LV_Z_AUTO_INIT=n, Zephyr's lvgl module never runs the
     * SYS_INIT hook that would otherwise do both. */
	lv_init();
	lv_tick_set_cb(k_uptime_get_32);

	/* Bind LVGL's renderer to the panel (src/gui_lvgl.c). */
	alp_status_t attach_status = alp_gui_lvgl_attach(display);
	if (attach_status != ALP_OK) {
		LOG_ERR("alp_gui_lvgl_attach failed (err=%d)", (int)attach_status);
		return 1;
	}

	/* Kick off the benchmark.  The scene set is fixed and lives
     * upstream in LVGL's demos/benchmark/.  Results print to the
     * Zephyr console via LVGL's lv_log() hook, which our prj.conf
     * routes to printk via CONFIG_LOG_PRINTK=y. */
	lv_demo_benchmark();

	/* Drain the LVGL timer queue; the benchmark scene plays through
     * scene-by-scene and emits its summary when the last scene
     * completes.  Same 10 ms slice as the widgets demo. */
	while (1) {
		const uint32_t sleep_ms = lv_timer_handler();
		k_msleep(MIN(sleep_ms, 10u));
	}

	return 0;
}
```
