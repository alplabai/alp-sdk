## CMakeLists.txt
```
# SPDX-License-Identifier: Apache-2.0
cmake_minimum_required(VERSION 3.20.0)

# Auto-apply the RK055HDMIPI4MA0 DSI shield on the AEN M55-HP board targets
# (`alp_e1m_aen801_m55_hp/...`, `alp_e1m_aen803_m55_hp/...`): the E1M-EVK
# has no panel on its own, and the shield provides the `zephyr,display`
# chosen node and `alp-display0` alias alp_display_open() binds to (#2885,
# the same panel examples/connectivity/iot-dashboard uses, #2173).  Skipped
# when the caller already set SHIELD, so a different panel can be swapped
# in; inert on every other target, including native_sim.  BOARD is read
# from the environment or the sysbuild cache when it is not a -D entry --
# see examples/connectivity/iot-dashboard/CMakeLists.txt for why.
if(NOT DEFINED BOARD AND DEFINED ENV{BOARD})
    set(BOARD $ENV{BOARD})
endif()
if(NOT DEFINED BOARD AND DEFINED SYSBUILD_CACHE AND EXISTS "${SYSBUILD_CACHE}")
    file(STRINGS "${SYSBUILD_CACHE}" _alp_sysbuild_board_line REGEX "^BOARD:STRING=")
    if(_alp_sysbuild_board_line)
        string(REGEX REPLACE "^BOARD:STRING=" "" BOARD "${_alp_sysbuild_board_line}")
    endif()
endif()
if(DEFINED BOARD AND BOARD MATCHES "^alp_e1m_aen80[13]_m55_hp(/|$)" AND NOT DEFINED SHIELD)
    list(APPEND SHIELD e1m_evk_rk055hdmipi4ma0)
endif()

find_package(Zephyr REQUIRED HINTS $ENV{ZEPHYR_BASE})
project(drone_hud LANGUAGES C)

target_sources(app PRIVATE
    src/main.c
    src/hud_ui.c
    src/sensors.c
)
```

## prj.conf
```kconfig
# SPDX-License-Identifier: Apache-2.0
CONFIG_MAIN_STACK_SIZE=16384
CONFIG_HEAP_MEM_POOL_SIZE=131072

# LVGL UI knobs -- match the 240x320 ST7789 panel geometry.
CONFIG_LV_Z_VDB_SIZE=50
CONFIG_LV_COLOR_DEPTH_16=y
# 30 fps target.
CONFIG_LV_DEF_REFR_PERIOD=33
# LVGL's own internal allocator pool -- see
# examples/display/lvgl-widgets-demo/prj.conf for why the 2048-byte
# Kconfig default is unsafe.
CONFIG_LV_Z_MEM_POOL_SIZE=131072

CONFIG_LOG=y
CONFIG_LOG_PRINTK=y

# Higher-priority sensor-read thread to keep IMU sampling on time
# even when LVGL is mid-blit.  Madgwick AHRS asks for ~100 Hz IMU
# samples for stable attitude estimation.
CONFIG_NUM_PREEMPT_PRIORITIES=8

# Display subsystem.  The actual panel driver is devicetree-specific:
# real silicon binds the ST7789 through Zephyr's display/MIPI DBI
# nodes, while native_sim has no panel and pulls CONFIG_DUMMY_DISPLAY=y
# from the per-example native_sim.conf overlay (wired in testcase.yaml).
CONFIG_DISPLAY=y

# This app binds LVGL to the panel itself via <alp/gui.h>'s
# alp_gui_lvgl_attach() (src/main.c) -- see
# examples/display/lvgl-widgets-demo/prj.conf for the full rationale
# on turning Zephyr's own lvgl auto-init off.
CONFIG_LV_Z_AUTO_INIT=n
```

## native_sim.conf
```kconfig
# SPDX-License-Identifier: Apache-2.0
#
# native_sim-only overlay.  native_sim has no real ST7789 panel, so
# bind Zephyr's dummy display driver: it lets the LVGL HUD link and
# run the build-only twister check without an SDL/X11 dependency.
# On real silicon this file is NOT applied; the board devicetree
# binds the actual ST7789 display node instead.
CONFIG_DUMMY_DISPLAY=y

# native_sim's DTS also carries a zephyr,sdl-dc node, so CONFIG_DISPLAY=y
# (prj.conf) drags in the SDL display driver by default alongside the
# dummy one above -- see examples/display/lvgl-widgets-demo/native_sim.conf
# for why that segfaults headless. This app never opens that device,
# so keep SDL out of the build entirely.
CONFIG_SDL_DISPLAY=n
```

## src/main.c
```c
/*
 * Copyright 2026 Alp Lab AB
 * SPDX-License-Identifier: Apache-2.0
 *
 * drone-hud
 * =========
 *
 * Marketing-grade demo: an E1M-AEN module renders a full drone
 * telemetry HUD on a 240x320 TFT, sourcing live data from:
 *   - LSM6DSO 6-axis IMU (accel + gyro).
 *   - uBlox NEO-M9N GNSS receiver.
 *   - INA236 battery voltage + current monitor.
 *
 * Showcases the v0.5 SDK story end-to-end: one app drives four
 * different chips through the portable `<alp/...>` peripheral
 * surfaces and LVGL composes the result into an artificial-horizon
 * HUD that wouldn't look out of place on a commercial flight
 * controller.
 *
 * Attitude is real Madgwick fusion.  board.yaml declares the
 * `madgwick-ahrs` library and sensors.c drives it through the
 * `<alp/ahrs.h>` surface: gyro rates plus the accelerometer fuse
 * into a quaternion, so roll/pitch stay pinned to gravity instead
 * of drifting.  The filter owns the quaternion state and the Euler
 * conversion -- the app contributes no fusion maths of its own.
 *
 *
 * ── Thread architecture ────────────────────────────────────────
 *
 *   main thread          -- LVGL render loop (30 fps).
 *   imu sample thread    -- LSM6DSO read + Madgwick fuse @ 100 Hz.
 *   slow telem thread    -- GNSS NMEA parse + INA236 read @ 5 Hz.
 *
 * The slow-telemetry thread sleeps in 200 ms slices, so it never
 * keeps the LVGL renderer waiting.  The IMU thread runs at a
 * higher priority than main so attitude updates land on time.
 *
 * Shared state is the `drone_telemetry_t` struct in sensors.h.
 * Each field has a single writer (one sensor thread) and a single
 * reader (main), and main copies the whole struct once per frame
 * before reading it.  Note this copy is NOT atomic and the struct
 * is NOT volatile, so a frame can in principle catch a half-updated
 * field (a torn read) -- harmless here because the values are only
 * drawn on a HUD, not used for control.  A control loop would guard
 * the snapshot with a mutex or a seqlock; this demo deliberately
 * does not, to keep the render path lock-free and simple.
 *
 *
 * ── What "verified" would mean ─────────────────────────────────
 *
 * Today the chips are paper-correct; lock-in arrives when:
 *  1. The IMU/GPS/battery readings make sense (units + scale).
 *  2. The attitude estimate doesn't drift when the SoM is held
 *     still (Madgwick beta tuning).
 *  3. The frame-rate stays above 25 fps with the full HUD live.
 *  4. The battery-remaining estimator survives a real
 *     charge/discharge cycle without lying.
 * That's the v0.6 AEN HiL story.
 */

#include <zephyr/kernel.h>
#include <zephyr/logging/log.h>

#include <alp/display.h>
#include <alp/gui.h>

#include <lvgl.h>

#include "sensors.h"
#include "hud_ui.h"

LOG_MODULE_REGISTER(drone_hud, LOG_LEVEL_INF);

/* Shared telemetry snapshot, populated by the sensor threads and
 * read by the LVGL render loop in main(). */
static drone_telemetry_t g_telem;

/* IMU thread: ~100 Hz LSM6DSO sample + Madgwick attitude fusion.
 * Higher priority than main so a blocking LVGL blit doesn't shift
 * the IMU's sample timing. */
K_THREAD_STACK_DEFINE(imu_stack, 4096);
static struct k_thread imu_thread;

static void imu_entry(void *p1, void *p2, void *p3)
{
	ARG_UNUSED(p1);
	ARG_UNUSED(p2);
	ARG_UNUSED(p3);
	drone_sensors_run_imu_loop(&g_telem);
}

/* Slow-telemetry thread: 5 Hz GPS NMEA + INA236 read.  Lower
 * priority than main; GPS reads happen in the background while
 * LVGL renders. */
K_THREAD_STACK_DEFINE(telem_stack, 4096);
static struct k_thread telem_thread;

static void telem_entry(void *p1, void *p2, void *p3)
{
	ARG_UNUSED(p1);
	ARG_UNUSED(p2);
	ARG_UNUSED(p3);
	drone_sensors_run_slow_loop(&g_telem);
}

int main(void)
{
	LOG_INF("drone-hud demo starting");

	/* Sensor bring-up.  Returns immediately if a chip is absent so
     * the demo still runs on a partial board (e.g. no GPS lock
     * indoors -- the IMU + battery + UI still work). */
	if (drone_sensors_init(&g_telem) != 0) {
		LOG_WRN("drone_sensors_init returned non-zero; degraded mode");
	}

	/* Display + LVGL bring-up.  Open the panel through the portable
     * <alp/display.h> surface, then bind LVGL to it via <alp/gui.h>
     * -- see examples/display/lvgl-widgets-demo/src/main.c for the
     * full rationale on this open -> lv_init -> tick -> attach
     * sequence, and why CONFIG_LV_Z_AUTO_INIT=n (prj.conf) is
     * required alongside it. */
	alp_display_config_t display_cfg = ALP_DISPLAY_CONFIG_DEFAULT(0);
	/* This app owns the panel, so it opts in to driving the mode.
	 * Ignored on Zephyr; on Yocto/Linux it is required, because
	 * opening a display there reprograms a live output (#1143). */
	display_cfg.allow_modeset        = true;
	alp_display_t       *display     = alp_display_open(&display_cfg);
	if (display == NULL) {
		LOG_ERR("display open failed (err=%d)", (int)alp_last_error());
		return 1;
	}
	lv_init();
	lv_tick_set_cb(k_uptime_get_32);

	alp_status_t attach_status = alp_gui_lvgl_attach(display);
	if (attach_status != ALP_OK) {
		LOG_ERR("alp_gui_lvgl_attach failed (err=%d)", (int)attach_status);
		return 1;
	}

	hud_ui_build(); /* Construct the HUD layout once. */

	/* Spawn the sensor threads after the UI is built so the first
     * frame doesn't show garbage values. */
	k_thread_create(&imu_thread,
	                imu_stack,
	                K_THREAD_STACK_SIZEOF(imu_stack),
	                imu_entry,
	                NULL,
	                NULL,
	                NULL,
	                /* priority */ K_PRIO_PREEMPT(2),
	                /* options  */ 0,
	                K_NO_WAIT);
	k_thread_name_set(&imu_thread, "imu_loop");

	k_thread_create(&telem_thread,
	                telem_stack,
	                K_THREAD_STACK_SIZEOF(telem_stack),
	                telem_entry,
	                NULL,
	                NULL,
	                NULL,
	                /* priority */ K_PRIO_PREEMPT(6),
	                /* options  */ 0,
	                K_NO_WAIT);
	k_thread_name_set(&telem_thread, "slow_telem");

	/* Main loop: drain the LVGL task queue + refresh the on-screen
     * widgets from the shared telemetry snapshot.  We copy the
     * struct once per frame and render from the copy so a field
     * can't change underneath a single hud_ui_apply_telemetry()
     * pass.  The copy itself is a plain (non-atomic) struct
     * assignment, so it can still straddle a concurrent writer --
     * acceptable for a display-only HUD (see the file header). */
	while (1) {
		drone_telemetry_t snapshot = g_telem;
		hud_ui_apply_telemetry(&snapshot);

		const uint32_t sleep_ms = lv_timer_handler();
		k_msleep(MIN(sleep_ms, 10u));
	}

	return 0; /* unreachable. */
}
```

## src/hud_ui.c
```c
/*
 * Copyright 2026 Alp Lab AB
 * SPDX-License-Identifier: Apache-2.0
 *
 * LVGL HUD layout for drone-hud.
 *
 * Renders:
 *   - Top half: artificial horizon (a tilted rectangle representing
 *     the sky/ground line).  Rotates around the screen centre as a
 *     function of roll; shifts vertically as a function of pitch.
 *   - Bottom half: 3 telemetry blocks
 *       * GPS:     lat / lon / sat-count / fix.
 *       * Battery: V / A / minutes remaining.
 *       * Mode:    current flight mode selector.
 *
 * Keeping the layout in C (not a JSON asset) means the demo
 * compiles standalone without an asset-loading step -- builds
 * on native_sim with zero external state.
 */

#include <stdio.h>

#include <lvgl.h>

#include "hud_ui.h"

/* Widget handles updated by apply_telemetry().  File-scope so the
 * update fn doesn't need a context struct. */
static lv_obj_t *s_horizon;
static lv_obj_t *s_lbl_attitude;
static lv_obj_t *s_lbl_gps;
static lv_obj_t *s_lbl_batt;
static lv_obj_t *s_lbl_mode;

void hud_ui_build(void)
{
	lv_obj_t *scr = lv_screen_active();
	lv_obj_set_style_bg_color(scr, lv_color_black(), 0);

	/* ── Artificial horizon ────────────────────────────────────
     *
     * A simple sky / ground line: top half blue, bottom half
     * brown, with a centre crosshair.  Rotates on roll, shifts
     * on pitch.  Real EFIS displays do far more (heading scale,
     * pitch ladder, bank angle indicator) -- this is enough to
     * showcase the data flow.
     */
	s_horizon = lv_obj_create(scr);
	lv_obj_set_size(s_horizon, 240, 120);
	lv_obj_set_pos(s_horizon, 0, 0);
	lv_obj_set_style_bg_color(s_horizon, lv_color_hex(0x3060A0), 0);     /* sky */
	lv_obj_set_style_border_color(s_horizon, lv_color_hex(0x8B4513), 0); /* ground */
	lv_obj_set_style_border_width(s_horizon, 60, 0);
	lv_obj_set_style_border_side(s_horizon, LV_BORDER_SIDE_BOTTOM, 0);

	/* Attitude readout overlay. */
	s_lbl_attitude = lv_label_create(scr);
	lv_obj_set_style_text_color(s_lbl_attitude, lv_color_white(), 0);
	lv_obj_align(s_lbl_attitude, LV_ALIGN_TOP_MID, 0, 5);
	lv_label_set_text(s_lbl_attitude, "R:--.- P:--.- Y:---.-");

	/* ── GPS block ─────────────────────────────────────────────*/
	s_lbl_gps = lv_label_create(scr);
	lv_obj_set_style_text_color(s_lbl_gps, lv_color_hex(0x40FF40), 0);
	lv_obj_set_pos(s_lbl_gps, 4, 130);
	lv_label_set_text(s_lbl_gps, "GPS: no fix");

	/* ── Battery block ─────────────────────────────────────────*/
	s_lbl_batt = lv_label_create(scr);
	lv_obj_set_style_text_color(s_lbl_batt, lv_color_hex(0xFFD060), 0);
	lv_obj_set_pos(s_lbl_batt, 4, 200);
	lv_label_set_text(s_lbl_batt, "BAT: --.--V / --.--A");

	/* ── Mode selector readout ─────────────────────────────────*/
	s_lbl_mode = lv_label_create(scr);
	lv_obj_set_style_text_color(s_lbl_mode, lv_color_hex(0xFFFFFF), 0);
	lv_obj_set_pos(s_lbl_mode, 4, 270);
	lv_label_set_text(s_lbl_mode, "MODE: --");
}

void hud_ui_apply_telemetry(const drone_telemetry_t *t)
{
	char buf[64];

	/* Attitude.  Tilt the horizon widget on roll; shift it on pitch.
	 * LVGL's transform_rotation is expressed in 1/10-degree units, so
	 * roll degrees are scaled by 10 to feed the API.  Pitch maps to a
	 * vertical pixel offset at ~0.5 px/deg -- enough to nudge the
	 * sky/ground split without sliding the widget off the 240x120 box. */
	lv_obj_set_style_transform_rotation(s_horizon, (int16_t)(t->roll_deg * 10), 0);
	lv_obj_set_pos(s_horizon, 0, (int)(t->pitch_deg * 0.5f));

	snprintf(buf,
	         sizeof(buf),
	         "R:%+6.1f P:%+6.1f Y:%6.1f",
	         (double)t->roll_deg,
	         (double)t->pitch_deg,
	         (double)t->yaw_deg);
	lv_label_set_text(s_lbl_attitude, buf);

	/* GPS. */
	if (t->gps_fix) {
		snprintf(buf,
		         sizeof(buf),
		         "GPS %d sats\n%.5f, %.5f",
		         (int)t->sat_count,
		         (double)t->lat_deg,
		         (double)t->lon_deg);
	} else {
		snprintf(buf, sizeof(buf), "GPS: %d sats (no fix)", (int)t->sat_count);
	}
	lv_label_set_text(s_lbl_gps, buf);

	/* Battery. */
	snprintf(buf,
	         sizeof(buf),
	         "BAT %5.2fV %+5.2fA\nremain %3ld min",
	         (double)t->battery_v,
	         (double)t->battery_a,
	         (long)t->battery_remaining_min);
	lv_label_set_text(s_lbl_batt, buf);

	/* Mode. */
	static const char *names[] = {
		[DRONE_MODE_MANUAL]     = "MANUAL",
		[DRONE_MODE_STABILISED] = "STAB",
		[DRONE_MODE_GPS_HOLD]   = "GPS-HOLD",
	};
	snprintf(buf, sizeof(buf), "MODE: %s", names[t->mode <= DRONE_MODE_GPS_HOLD ? t->mode : 0]);
	lv_label_set_text(s_lbl_mode, buf);
}
```

## src/hud_ui.h
```c
/*
 * Copyright 2026 Alp Lab AB
 * SPDX-License-Identifier: Apache-2.0
 *
 * LVGL HUD layout for drone-hud.  Builds the on-screen widgets
 * once + updates them per-frame from a telemetry snapshot.
 */

#ifndef DRONE_HUD_HUD_UI_H
#define DRONE_HUD_HUD_UI_H

#include "sensors.h"

#ifdef __cplusplus
extern "C" {
#endif

/** Build the HUD layout (called once after lv_init()). */
void hud_ui_build(void);

/** Push the latest telemetry into the on-screen widgets.  Called
 *  once per render frame from main()'s LVGL loop. */
void hud_ui_apply_telemetry(const drone_telemetry_t *t);

#ifdef __cplusplus
} /* extern "C" */
#endif

#endif /* DRONE_HUD_HUD_UI_H */
```

## src/sensors.c
```c
/*
 * Copyright 2026 Alp Lab AB
 * SPDX-License-Identifier: Apache-2.0
 *
 * Sensor-loop implementations for drone-hud.  Three discrete
 * jobs:
 *   1. Bring up each chip via its `<alp/chips/X.h>` driver.
 *   2. Run a 100 Hz IMU sample + attitude loop.  Attitude comes
 *      from the `<alp/ahrs.h>` Madgwick filter, which fuses gyro
 *      and accelerometer into a quaternion; the app never
 *      hand-rolls fusion.
 *   3. Run a 5 Hz GPS + battery telemetry loop.
 *
 * All bus access goes through the portable `<alp/...>` surfaces;
 * no vendor symbols appear.  Per the SDK rule "Portable
 * peripheral surfaces only in app + library code".
 */

#include <zephyr/logging/log.h>
#include <string.h>
#include <math.h>

#include "alp/peripheral.h"
#include "alp/ahrs.h"
#include "alp/e1m_pinout.h"
#include "alp/chips/lsm6dso.h"
#include "alp/chips/ublox_neo_m9n.h"
#include "alp/chips/ina236.h"

#include "sensors.h"

LOG_MODULE_REGISTER(drone_sensors, LOG_LEVEL_INF);

/* Driver handles + bus handles -- file-scope so the loop fns can
 * reach them without juggling a struct of pointers. */
static alp_i2c_t      *s_i2c;
static alp_uart_t     *s_gps_uart;
static lsm6dso_t       s_imu;
static ublox_neo_m9n_t s_gps;
static ina236_t        s_batt;
static alp_ahrs_t      s_ahrs; /* Madgwick orientation filter. */

int drone_sensors_init(drone_telemetry_t *telem)
{
	memset(telem, 0, sizeof(*telem));
	telem->mode = DRONE_MODE_STABILISED;

	/* Default-gain Madgwick IMU fusion for the attitude estimate. */
	alp_ahrs_init(&s_ahrs, NULL);

	/* I²C bus shared by IMU + battery monitor.  400 kHz fast-mode
     * is comfortable for both chips. */
	s_i2c = alp_i2c_open(&(alp_i2c_config_t){
	    .bus_id     = ALP_E1M_I2C0,
	    .bitrate_hz = 400000,
	});
	if (s_i2c == NULL) {
		LOG_ERR("alp_i2c_open(I2C0) returned NULL");
		return -1;
	}

	/* GPS UART -- 9600/8N1 is the NEO-M9N factory default. */
	s_gps_uart = alp_uart_open(&(alp_uart_config_t){
	    .port_id  = ALP_E1M_UART0,
	    .baudrate = 9600,
	});
	if (s_gps_uart == NULL) {
		LOG_WRN("GPS UART unavailable; continuing without GNSS");
	}

	int rc = 0;

	/* IMU. */
	if (lsm6dso_init(&s_imu, s_i2c, LSM6DSO_I2C_ADDR_LOW) != ALP_OK) {
		LOG_WRN("LSM6DSO init failed; attitude will read zero");
		rc--;
	}

	/* Battery monitor.  INA236A at 0x40 (A0 = GND) is the default. */
	if (ina236_init(&s_batt,
	                s_i2c,
	                0x40,
	                /*shunt_ohms=*/0.01f,
	                /*max_current_a=*/50.f,
	                INA236_ADCRANGE_81MV) != ALP_OK) {
		LOG_WRN("INA236 init failed; battery telemetry will read zero");
		rc--;
	}

	/* GNSS.  Tolerates missing UART. */
	if (s_gps_uart != NULL && ublox_neo_m9n_init(&s_gps, s_gps_uart) != ALP_OK) {
		LOG_WRN("NEO-M9N init failed; GPS will report no fix");
		rc--;
	}

	return rc;
}

/* Default-FS gyro sensitivity for the LSM6DSO: ±250 dps -> 114.286
 * LSB/dps.  The accel scale cancels -- alp_ahrs normalises the accel
 * vector -- so raw counts feed the fusion directly. */
#define LSM6DSO_GYRO_LSB_PER_DPS 114.286f

void drone_sensors_run_imu_loop(drone_telemetry_t *telem)
{
	const float dt_s    = 0.01f; /* 100 Hz target -- 10 ms slice. */
	const float deg2rad = 3.14159265f / 180.f;
	while (1) {
		lsm6dso_axes_t a = { 0 };
		lsm6dso_axes_t g = { 0 };
		if (lsm6dso_read_accel(&s_imu, &a) == ALP_OK && lsm6dso_read_gyro(&s_imu, &g) == ALP_OK) {
			/* Gyro raw counts -> rad/s (Madgwick expects rad/s).  The
             * accel raw counts feed the fusion directly; unlike the old
             * gyro-only integrator, fusing the accelerometer pins
             * roll/pitch against gravity so the HUD attitude no longer
             * drifts.  alp_ahrs owns the quaternion state + Euler
             * conversion -- no hand-rolled fusion in the app. */
			const float gx = (float)g.x / LSM6DSO_GYRO_LSB_PER_DPS * deg2rad;
			const float gy = (float)g.y / LSM6DSO_GYRO_LSB_PER_DPS * deg2rad;
			const float gz = (float)g.z / LSM6DSO_GYRO_LSB_PER_DPS * deg2rad;
			alp_ahrs_update_imu(&s_ahrs, gx, gy, gz, (float)a.x, (float)a.y, (float)a.z, dt_s);
			alp_ahrs_euler(&s_ahrs, &telem->roll_deg, &telem->pitch_deg, &telem->yaw_deg);
		}
		alp_delay_ms(10);
	}
}

void drone_sensors_run_slow_loop(drone_telemetry_t *telem)
{
	static uint8_t  nmea_line[128];
	static int32_t  remaining_min = 25; /* coarse Coulomb-counter */
	static uint32_t coulomb_ticks = 0;

	while (1) {
		/* Battery read -- INA236 reports bus mV + current uA; convert
         * to volts + amps for the HUD. */
		int32_t mv = 0, ua = 0;
		if (ina236_read_bus_mv(&s_batt, &mv) == ALP_OK &&
		    ina236_read_current_ua(&s_batt, &ua) == ALP_OK) {
			telem->battery_v = mv / 1000.f;
			telem->battery_a = ua / 1000000.f;
			/* Crude estimator: -1 minute every 5 s while drawing
             * more than 1 A.  Real Coulomb-counting + cell model
             * lands in v0.6. */
			if (telem->battery_a > 1.f) {
				coulomb_ticks++;
				if (coulomb_ticks >= 25 && remaining_min > 0) {
					coulomb_ticks = 0;
					remaining_min--;
				}
			}
			telem->battery_remaining_min = remaining_min;
		}

		/* GPS NMEA -- read one line, parse later.  Real NMEA
         * decode lives in an app-level library (e.g. libnmea); the
         * demo just surfaces the line count + sat count so
         * customers see the path is live. */
		if (s_gps_uart != NULL) {
			size_t got = 0;
			if (ublox_neo_m9n_read_nmea_line(&s_gps,
			                                 nmea_line,
			                                 sizeof(nmea_line),
			                                 &got,
			                                 /*timeout_ms=*/100) == ALP_OK) {
				if (got > 0) {
					/* Bump the sat count + flip the fix bit so the
                     * UI shows movement.  Real parse in v0.6. */
					telem->sat_count = (telem->sat_count + 1) % 12;
					telem->gps_fix   = telem->sat_count >= 4;
				}
			}
		}

		alp_delay_ms(200); /* 5 Hz cadence. */
	}
}
```

## src/sensors.h
```c
/*
 * Copyright 2026 Alp Lab AB
 * SPDX-License-Identifier: Apache-2.0
 *
 * Shared telemetry types + sensor-loop entrypoints for drone-hud.
 *
 * Single writer / single reader per field, so the volatile-
 * snapshot read in main() is correct without locks.
 */

#ifndef DRONE_HUD_SENSORS_H
#define DRONE_HUD_SENSORS_H

#include <stdint.h>
#include <stdbool.h>

#include "alp/peripheral.h"

#ifdef __cplusplus
extern "C" {
#endif

/** Live drone telemetry snapshot.  Updated by the IMU + slow
 *  telemetry threads; read once-per-frame by the LVGL render loop. */
typedef struct {
	/* Attitude (Madgwick output, ENU frame). */
	float roll_deg;  /**< Roll about X axis. */
	float pitch_deg; /**< Pitch about Y axis. */
	float yaw_deg;   /**< Yaw about Z axis (compass heading). */

	/* GPS. */
	float   lat_deg;
	float   lon_deg;
	float   altitude_m;
	uint8_t sat_count;
	bool    gps_fix;

	/* Battery (INA236). */
	float   battery_v;
	float   battery_a;
	int32_t battery_remaining_min; /**< Coulomb-counter estimate. */

	/* Flight mode selector (host UI sets, autopilot reads). */
	enum {
		DRONE_MODE_MANUAL     = 0,
		DRONE_MODE_STABILISED = 1,
		DRONE_MODE_GPS_HOLD   = 2,
	} mode;
} drone_telemetry_t;

/** Bring up every chip + library this demo touches.  Tolerates
 *  partially-populated boards (missing chip -> log + continue).
 *  @return 0 on full bring-up, non-zero if any chip failed. */
int drone_sensors_init(drone_telemetry_t *telem);

/** IMU thread entry -- runs forever; ~100 Hz LSM6DSO sample +
 *  Madgwick attitude fusion. */
void drone_sensors_run_imu_loop(drone_telemetry_t *telem);

/** Slow-telemetry thread entry -- runs forever; 5 Hz GPS NMEA
 *  parse + INA236 battery read. */
void drone_sensors_run_slow_loop(drone_telemetry_t *telem);

#ifdef __cplusplus
} /* extern "C" */
#endif

#endif /* DRONE_HUD_SENSORS_H */
```
