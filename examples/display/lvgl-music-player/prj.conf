## CMakeLists.txt
```
# SPDX-License-Identifier: Apache-2.0
cmake_minimum_required(VERSION 3.20.0)

# Auto-apply the RK055HDMIPI4MA0 DSI shield on the AEN M55-HP board targets
# (`alp_e1m_aen801_m55_hp/...`, `alp_e1m_aen803_m55_hp/...`): the E1M-EVK
# has no panel on its own, and the shield provides the `zephyr,display`
# chosen node and `alp-display0` alias alp_display_open() binds to (#2885,
# the same panel examples/connectivity/iot-dashboard uses, #2173).  Skipped
# when the caller already set SHIELD, so a different panel can be swapped
# in; inert on every other target, including native_sim.  BOARD is read
# from the environment or the sysbuild cache when it is not a -D entry --
# see examples/connectivity/iot-dashboard/CMakeLists.txt for why.
if(NOT DEFINED BOARD AND DEFINED ENV{BOARD})
    set(BOARD $ENV{BOARD})
endif()
if(NOT DEFINED BOARD AND DEFINED SYSBUILD_CACHE AND EXISTS "${SYSBUILD_CACHE}")
    file(STRINGS "${SYSBUILD_CACHE}" _alp_sysbuild_board_line REGEX "^BOARD:STRING=")
    if(_alp_sysbuild_board_line)
        string(REGEX REPLACE "^BOARD:STRING=" "" BOARD "${_alp_sysbuild_board_line}")
    endif()
endif()
if(DEFINED BOARD AND BOARD MATCHES "^alp_e1m_aen80[13]_m55_hp(/|$)" AND NOT DEFINED SHIELD)
    list(APPEND SHIELD e1m_evk_rk055hdmipi4ma0)
endif()

find_package(Zephyr REQUIRED HINTS $ENV{ZEPHYR_BASE})
project(lvgl_music_player LANGUAGES C)

set(LVGL_DIR ${ZEPHYR_LVGL_MODULE_DIR})
# The music demo uses lv_demo_args_init() from the top-level
# lv_demos.c shared helper, so include it alongside the music
# sources.  Plain GLOB on demos/*.c would also pull in the
# widgets/benchmark dispatch glue we don't want.
file(GLOB LV_MUSIC_SRC
    ${LVGL_DIR}/demos/music/*.c
    ${LVGL_DIR}/demos/music/assets/*.c
)
target_sources(app PRIVATE
    src/main.c
    ${LV_MUSIC_SRC}
    ${LVGL_DIR}/demos/lv_demos.c
)
target_include_directories(app PRIVATE ${LVGL_DIR}/demos ${LVGL_DIR}/demos/music)
```

## prj.conf
```kconfig
# SPDX-License-Identifier: Apache-2.0
CONFIG_MAIN_STACK_SIZE=8192
# Music demo album-art assets are bigger than the LVGL default.
CONFIG_HEAP_MEM_POOL_SIZE=262144

CONFIG_LV_USE_DEMO_MUSIC=y

CONFIG_LV_Z_VDB_SIZE=50
CONFIG_LV_COLOR_DEPTH_16=y
CONFIG_LV_DEF_REFR_PERIOD=33

# LVGL's own internal allocator pool -- see lvgl-widgets-demo/prj.conf
# for why the 2048-byte Kconfig default is unsafe.  The music demo's
# album-art assets + equaliser animation state need real headroom.
CONFIG_LV_Z_MEM_POOL_SIZE=131072

CONFIG_LOG=y
CONFIG_LOG_PRINTK=y

# Display subsystem.  The actual panel driver is devicetree-specific:
# real silicon binds the ST7789 through Zephyr's display/MIPI DBI
# nodes, while native_sim has no panel and pulls CONFIG_DUMMY_DISPLAY=y
# from the per-example native_sim.conf overlay (wired in testcase.yaml).
CONFIG_DISPLAY=y

# This app binds LVGL to the panel itself via <alp/gui.h>'s
# alp_gui_lvgl_attach() (src/main.c) -- see lvgl-widgets-demo/prj.conf
# for the full rationale on turning Zephyr's own lvgl auto-init off.
CONFIG_LV_Z_AUTO_INIT=n
```

## native_sim.conf
```kconfig
# SPDX-License-Identifier: Apache-2.0
#
# native_sim-only overlay.  native_sim has no real ST7789 panel, so
# bind Zephyr's dummy display driver: it lets the music-player UI
# link and run the build-only twister check without an SDL/X11
# dependency.  On real silicon this file is NOT applied; the board
# devicetree binds the actual ST7789 display node instead.
CONFIG_DUMMY_DISPLAY=y

# native_sim's DTS also carries a zephyr,sdl-dc node, so CONFIG_DISPLAY=y
# (prj.conf) drags in the SDL display driver by default alongside the
# dummy one above -- see lvgl-widgets-demo/native_sim.conf for why
# that segfaults headless. This app never opens that device, so keep
# SDL out of the build entirely.
CONFIG_SDL_DISPLAY=n
```

## boards/native_sim_native_64.overlay
```dts
/*
 * Copyright 2026 Alp Lab AB
 * SPDX-License-Identifier: Apache-2.0
 *
 * native_sim board overlay -- chooses zephyr's dummy display
 * driver so the LVGL demo links without a real display chip.
 * Real-silicon builds (alif / v2n) bring up the actual panel
 * (ST7789 / ILI9488 / DSI etc.) via the SoM board overlay.
 *
 * Two references to the same dummy_dc node -- see
 * lvgl-widgets-demo/boards/native_sim_native_64.overlay for why
 * `chosen { zephyr,display }` and `aliases { alp-display0 }` both
 * point at it (one satisfies the lvgl module's compile-time
 * requirement, the other is what src/main.c actually opens).
 */

/ {
	chosen {
		zephyr,display = &dummy_dc;
	};

	aliases {
		alp-display0 = &dummy_dc;
	};

	dummy_dc: dummy_dc {
		compatible = "zephyr,dummy-dc";
		height = <320>;
		width = <240>;
	};
};
```

## src/main.c
```c
/*
 * Copyright 2026 Alp Lab AB
 * SPDX-License-Identifier: Apache-2.0
 *
 * lvgl-music-player
 * =================
 *
 * Wraps the upstream `lv_demo_music()` -- the most polished of
 * LVGL's bundled demos.  Renders an album-art carousel, time
 * slider, track list, and a real-time equaliser visualiser.
 *
 * This is a DISPLAY-ONLY demo.  lv_demo_music() animates the
 * progress bar + equaliser bands on its own timer; it does not
 * decode or play any audio, and this file makes no alp_i2s_* or
 * codec calls.  A real audio output path (codec over I²S + an MP3
 * decoder) is out of scope -- the point here is the LVGL UI.
 *
 *
 * ── Hardware wiring (E1M-EVK reference) ────────────────────────
 *
 *   ┌──────────────────┐   SPI      ┌────────────────────┐
 *   │  E1M-AEN801 SoM  │ ─────────▶ │ ST7789 240×320 TFT │
 *   │ + Cortex-M55 HP  │   GPIO     │  (display)         │
 *   └──────────────────┘            └────────────────────┘
 */

#include <zephyr/kernel.h>
#include <zephyr/logging/log.h>

#include <alp/display.h>
#include <alp/gui.h>

#include <lv_demo_music.h>

LOG_MODULE_REGISTER(lvgl_music_player, LOG_LEVEL_INF);

int main(void)
{
	LOG_INF("LVGL music-player demo starting");

	/* Open the panel through the portable display surface, then
     * bind LVGL to it via <alp/gui.h> -- see
     * lvgl-widgets-demo/src/main.c for the full rationale on this
     * open -> lv_init -> tick -> attach sequence, and why
     * CONFIG_LV_Z_AUTO_INIT=n (prj.conf) is required alongside it. */
	alp_display_config_t display_cfg = ALP_DISPLAY_CONFIG_DEFAULT(0);
	/* This app owns the panel, so it opts in to driving the mode.
	 * Ignored on Zephyr; on Yocto/Linux it is required, because
	 * opening a display there reprograms a live output (#1143). */
	display_cfg.allow_modeset        = true;
	alp_display_t       *display     = alp_display_open(&display_cfg);
	if (display == NULL) {
		LOG_ERR("display open failed (err=%d)", (int)alp_last_error());
		return 1;
	}

	lv_init();
	lv_tick_set_cb(k_uptime_get_32);

	alp_status_t attach_status = alp_gui_lvgl_attach(display);
	if (attach_status != ALP_OK) {
		LOG_ERR("alp_gui_lvgl_attach failed (err=%d)", (int)attach_status);
		return 1;
	}

	/* Kick off the demo UI.  lv_demo_music() builds the full music-
     * player scene + spawns the periodic animation timer that
     * advances the progress bar + equaliser bands. */
	lv_demo_music();

	/* lv_demo_music() owns its own animation timer; from here on
     * main just pumps the LVGL timer handler.  No audio path -- this
     * is a UI-only demo (see the file header). */
	while (1) {
		const uint32_t sleep_ms = lv_timer_handler();
		k_msleep(MIN(sleep_ms, 10u));
	}

	return 0;
}
```
