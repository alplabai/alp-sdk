## CMakeLists.txt
```
# SPDX-License-Identifier: Apache-2.0
#
# CMakeLists.txt for the lvgl-widgets-demo example.  The generated
# alp.conf (from board.yaml) overlays prj.conf via EXTRA_CONF_FILE.
cmake_minimum_required(VERSION 3.20.0)

# Auto-apply the RK055HDMIPI4MA0 DSI shield on the AEN M55-HP board targets
# (`alp_e1m_aen801_m55_hp/...`, `alp_e1m_aen803_m55_hp/...`): the E1M-EVK
# has no panel on its own, and the shield provides the `zephyr,display`
# chosen node and `alp-display0` alias alp_display_open() binds to (#2885,
# the same panel examples/connectivity/iot-dashboard uses, #2173).  Skipped
# when the caller already set SHIELD, so a different panel can be swapped
# in; inert on every other target, including native_sim.  BOARD is read
# from the environment or the sysbuild cache when it is not a -D entry --
# see examples/connectivity/iot-dashboard/CMakeLists.txt for why.
if(NOT DEFINED BOARD AND DEFINED ENV{BOARD})
    set(BOARD $ENV{BOARD})
endif()
if(NOT DEFINED BOARD AND DEFINED SYSBUILD_CACHE AND EXISTS "${SYSBUILD_CACHE}")
    file(STRINGS "${SYSBUILD_CACHE}" _alp_sysbuild_board_line REGEX "^BOARD:STRING=")
    if(_alp_sysbuild_board_line)
        string(REGEX REPLACE "^BOARD:STRING=" "" BOARD "${_alp_sysbuild_board_line}")
    endif()
endif()
if(DEFINED BOARD AND BOARD MATCHES "^alp_e1m_aen80[13]_m55_hp(/|$)" AND NOT DEFINED SHIELD)
    list(APPEND SHIELD e1m_evk_rk055hdmipi4ma0)
endif()

find_package(Zephyr REQUIRED HINTS $ENV{ZEPHYR_BASE})
project(lvgl_widgets_demo LANGUAGES C)

# The Zephyr lvgl module compiles only the core lvgl/src/ tree; the
# `demos/widgets/` showcase ships in lvgl but isn't auto-linked.
# Pull its sources in here so the prj.conf knob actually wires
# something into the binary.
set(LVGL_DIR ${ZEPHYR_LVGL_MODULE_DIR})
file(GLOB LV_WIDGETS_SRC
    ${LVGL_DIR}/demos/lv_demos.c
    ${LVGL_DIR}/demos/widgets/*.c
    ${LVGL_DIR}/demos/widgets/assets/*.c
)
target_sources(app PRIVATE src/main.c ${LV_WIDGETS_SRC})
target_include_directories(app PRIVATE ${LVGL_DIR}/demos ${LVGL_DIR}/demos/widgets)
```

## prj.conf
```kconfig
# SPDX-License-Identifier: Apache-2.0
#
# Per-app overlay.  The loader-generated alp.conf carries the
# baseline (CONFIG_ALP_SDK=y, CONFIG_LVGL=y, GPU2D/DMA2D backend
# choice).  Everything below is demo-specific: pull in the
# lv_demo_widgets() upstream entrypoint and set the display geometry
# LVGL expects.

CONFIG_MAIN_STACK_SIZE=8192
CONFIG_HEAP_MEM_POOL_SIZE=131072

# LVGL upstream demo entrypoint -- lives under demos/widgets/
# in the LVGL tree.  Zephyr's lvgl module sources it in when
# this Kconfig is set.
CONFIG_LV_USE_DEMO_WIDGETS=y

# LVGL display geometry must match the wired ST7789 panel.  240x320
# is the typical TFT geometry; the 240x240 round variant works too,
# customers swap the macro to suit.
CONFIG_LV_Z_VDB_SIZE=50
CONFIG_LV_COLOR_DEPTH_16=y

# LVGL's own internal allocator pool (lv_malloc) -- separate from
# CONFIG_HEAP_MEM_POOL_SIZE above, which only backs the flush-buffer
# malloc() in src/gui_lvgl.c.  The 2048-byte Kconfig default is far
# too small once lv_demo_widgets() creates its tab view, styles, and
# per-widget draw state; undersizing this doesn't fail cleanly --
# lv_malloc callers that skip the OOM check crash on the resulting
# NULL. Sized generously for the full widgets showcase (charts,
# meters, tables, ...).
CONFIG_LV_Z_MEM_POOL_SIZE=262144

# Render thread + frame-rate cap.
# 30 fps target.
CONFIG_LV_DEF_REFR_PERIOD=33

# Console + log for the smoke message.
CONFIG_LOG=y
CONFIG_LOG_PRINTK=y

# Display subsystem.  The actual panel driver is devicetree-specific:
# real silicon binds the ST7789 through Zephyr's display/MIPI DBI
# nodes, while native_sim has no panel and pulls CONFIG_DUMMY_DISPLAY=y
# from the per-example native_sim.conf overlay (wired in testcase.yaml).
CONFIG_DISPLAY=y

# This app binds LVGL to the panel itself via <alp/gui.h>'s
# alp_gui_lvgl_attach() (src/main.c), not Zephyr's own lvgl module
# auto-init. CONFIG_LV_Z_AUTO_INIT defaults y and would otherwise have
# modules/lvgl/lvgl.c's SYS_INIT hook create a SECOND lv_display_t
# against the `zephyr,display` chosen node -- two independent LVGL
# displays racing to flush the same (or, here, a different aliased)
# panel. Turning it off also means Zephyr's lvgl_init() never runs, so
# it never calls lv_init() or registers the LVGL tick source either --
# src/main.c does both itself.
CONFIG_LV_Z_AUTO_INIT=n
```

## native_sim.conf
```kconfig
# SPDX-License-Identifier: Apache-2.0
#
# native_sim-only overlay.  native_sim has no real ST7789 panel, so
# bind Zephyr's dummy display driver: it lets the LVGL demo link and
# run the build-only twister check without an SDL/X11 dependency.
# On real silicon this file is NOT applied; the board devicetree
# binds the actual ST7789 display node instead.
CONFIG_DUMMY_DISPLAY=y

# native_sim's DTS also carries a zephyr,sdl-dc node, so CONFIG_DISPLAY=y
# (prj.conf) drags in the SDL display driver by default alongside the
# dummy one above.  Its init reaches for a real GL/X11 context that
# doesn't exist on a headless CI runner and segfaults before main()
# even starts (same trap tests/zephyr/gui_lvgl/prj.conf documents).
# This app never opens that device -- alp-display0 (the alias
# alp_display_open resolves) points at dummy_dc only -- so keep SDL
# out of the build entirely.
CONFIG_SDL_DISPLAY=n
```

## boards/native_sim_native_64.overlay
```dts
/*
 * Copyright 2026 Alp Lab AB
 * SPDX-License-Identifier: Apache-2.0
 *
 * native_sim board overlay -- chooses zephyr's dummy display
 * driver so the LVGL demo links without a real display chip.
 * Real-silicon builds (alif / v2n) bring up the actual panel
 * (ST7789 / ILI9488 / DSI etc.) via the SoM board overlay.
 *
 * Two references to the same dummy_dc node, for two different
 * consumers:
 *   - `chosen { zephyr,display }` -- Zephyr's lvgl module
 *     (modules/lvgl/lvgl.c) needs at least one `zephyr,display` node
 *     to COMPILE (it walks DT_ZEPHYR_DISPLAYS_COUNT unconditionally),
 *     even though CONFIG_LV_Z_AUTO_INIT=n (prj.conf) means it never
 *     actually opens/binds it at runtime.
 *   - `aliases { alp-display0 }` -- what src/main.c actually opens,
 *     via alp_display_open() / the zephyr_drv backend
 *     (src/backends/display/zephyr_drv.c resolves DT_ALIAS(alp_display0)).
 * Pointing both at the same node is safe here specifically because
 * AUTO_INIT=n: no second lv_display_t ever gets created against it,
 * so there is only one real writer (see the mipi_dbi_type_c_st7789
 * fixture in tests/zephyr/display/overlays/ for the same pattern on
 * real panel hardware).
 */

/ {
	chosen {
		zephyr,display = &dummy_dc;
	};

	aliases {
		alp-display0 = &dummy_dc;
	};

	dummy_dc: dummy_dc {
		compatible = "zephyr,dummy-dc";
		height = <320>;
		width = <240>;
	};
};
```

## src/main.c
```c
/*
 * Copyright 2026 Alp Lab AB
 * SPDX-License-Identifier: Apache-2.0
 *
 * lvgl-widgets-demo
 * =================
 *
 * Wraps the upstream `lv_demo_widgets()` from LVGL's demos/ tree.
 * Walks through every standard LVGL widget (buttons, sliders,
 * tabs, charts, meters, lists, ...) on a 240 x 320 ST7789 TFT
 * attached to the E1M-EVK SPI0 + a pair of GPIOs (D/C# + reset).
 *
 * This is a teaching artefact: ~50% of the file is comment
 * explaining the data flow + the SDK rules in play.  Customers
 * copy this directory + the matching board.yaml as a starting
 * point for their own LVGL apps.
 *
 *
 * ── Why this layout? ───────────────────────────────────────────
 *
 *   1. `board.yaml` is the only file that names hardware.  It
 *      declares the LVGL library plus the SPI/GPIO resources the
 *      board devicetree binds to Zephyr's MIPI DBI Type C display
 *      path.
 *
 *   2. `src/main.c` (this file) talks to the panel ONLY through
 *      portable Alp surfaces:
 *        - <alp/display.h>  opens the panel (alp_display_open)
 *        - <alp/gui.h>      binds it to LVGL (alp_gui_lvgl_attach)
 *        - <lvgl.h>         the UI API itself
 *      No `gd32g553_*` / `alif_*` / `renesas_*` symbols, and no
 *      direct `<zephyr/drivers/display.h>` calls, appear anywhere
 *      -- per the SDK's "portable peripheral surfaces only in app
 *      + library code" rule.  Board-specific backends live inside
 *      the SDK; this file stays board-portable.
 *
 *   3. Zephyr's own `lvgl` module auto-init is turned OFF
 *      (CONFIG_LV_Z_AUTO_INIT=n in prj.conf).  Left on, it would
 *      create its OWN lv_display_t bound straight to the
 *      `zephyr,display` chosen node the moment CONFIG_LVGL=y is
 *      set -- a second writer racing alp_gui_lvgl_attach()'s
 *      display for the same panel.  With auto-init off, this file
 *      owns the whole sequence: open the panel, `lv_init()`, wire
 *      LVGL's tick source, attach, then run the demo.
 *
 *
 * ── Build matrix ───────────────────────────────────────────────
 *
 *   `west build -b ensemble_e8_dk/ae822fa0e5597ls0/rtss_hp examples/display/lvgl-widgets-demo`
 *   `west build -b native_sim/native/64 examples/display/lvgl-widgets-demo`
 *
 *   native_sim runs the demo against the dummy display driver --
 *   handy for exercising the LVGL + <alp/display.h> plumbing
 *   without touching hardware (no framebuffer is shown on-screen;
 *   see the per-example native_sim.conf for why).
 */

#include <zephyr/kernel.h>
#include <zephyr/logging/log.h>

#include <alp/display.h>
#include <alp/gui.h>

/* Upstream LVGL demo entrypoint -- pulled in by
 * CONFIG_LV_USE_DEMO_WIDGETS=y in prj.conf. */
#include <lv_demo_widgets.h>

LOG_MODULE_REGISTER(lvgl_widgets_demo, LOG_LEVEL_INF);

int main(void)
{
	LOG_INF("LVGL widgets demo starting");

	/* Open the panel through the portable display surface.  On the
     * E1M-EVK this resolves the ST7789 behind the MIPI DBI Type C
     * node; on native_sim it resolves the dummy display driver --
     * both wired via the `alp-display0` devicetree alias the
     * zephyr_drv backend looks up (see board.yaml + the board
     * overlay for each target). */
	alp_display_config_t display_cfg = ALP_DISPLAY_CONFIG_DEFAULT(0);
	/* This app owns the panel, so it opts in to driving the mode.
	 * Ignored on Zephyr; on Yocto/Linux it is required, because
	 * opening a display there reprograms a live output (#1143). */
	display_cfg.allow_modeset        = true;
	alp_display_t       *display     = alp_display_open(&display_cfg);
	if (display == NULL) {
		LOG_ERR("display open failed (err=%d)", (int)alp_last_error());
		return 1;
	}

	/* LVGL initialisation: allocate LVGL's own global state
     * (styles, the default theme, the timer list, ...).  Normally
     * Zephyr's lvgl module does this for us from a SYS_INIT hook,
     * but that hook -- and the tick registration below -- only run
     * under CONFIG_LV_Z_AUTO_INIT=y (modules/lvgl/lvgl.c), which
     * this app turns off so it can bind its OWN display instead of
     * Zephyr's auto-created one. */
	lv_init();

	/* LVGL needs a monotonic millisecond tick to drive animations,
     * timers, and input debouncing.  Zephyr's lvgl module would
     * normally register this same callback from its SYS_INIT hook;
     * with CONFIG_LV_Z_AUTO_INIT=n that hook never runs, so wire it
     * by hand here -- same callback, just moved to the app side of
     * the auto-init boundary. */
	lv_tick_set_cb(k_uptime_get_32);

	/* Bind LVGL's renderer to the panel: allocates an lv_display_t
     * sized to the panel's reported geometry and wires its
     * flush_cb straight to alp_display_blit() (src/gui_lvgl.c). */
	alp_status_t attach_status = alp_gui_lvgl_attach(display);
	if (attach_status != ALP_OK) {
		LOG_ERR("alp_gui_lvgl_attach failed (err=%d)", (int)attach_status);
		return 1;
	}

	/* Render the upstream demo.  lv_demo_widgets() creates a tab
     * view with five tabs (Profile, Analytics, Shop, ...), each
     * exercising a different widget family.  Returns immediately;
     * subsequent UI updates are driven by lv_timer_handler() below. */
	lv_demo_widgets();

	/* Main loop: tick LVGL at the configured refresh rate.  Zephyr
     * gives us a real RTOS so we can sleep precisely between ticks
     * instead of busy-waiting.  The 10 ms slice keeps animations
     * smooth at 30 fps with headroom for input handlers.
     * lv_timer_handler() is LVGL v9's native name for what this
     * file called lv_task_handler() before the migration (the v8
     * name is still available as a compat shim, but the direct
     * name reads clearer here). */
	while (1) {
		const uint32_t sleep_ms = lv_timer_handler();
		k_msleep(MIN(sleep_ms, 10u));
	}

	return 0; /* unreachable. */
}
```
