## CMakeLists.txt
```
# SPDX-License-Identifier: Apache-2.0

cmake_minimum_required(VERSION 3.20)

# Resolve the alp-sdk root.  In-tree the SDK is the example's
# grandparent directory; out-of-tree customers point ALP_SDK_ROOT
# at their checkout.
if(DEFINED ENV{ALP_SDK_ROOT})
    set(ALP_SDK_ROOT $ENV{ALP_SDK_ROOT})
else()
    get_filename_component(ALP_SDK_ROOT ${CMAKE_CURRENT_SOURCE_DIR}/../.. ABSOLUTE)
endif()

find_package(Python3 REQUIRED COMPONENTS Interpreter)

set(_alp_generated ${CMAKE_BINARY_DIR}/generated/alp.conf)
execute_process(
    COMMAND ${Python3_EXECUTABLE} ${ALP_SDK_ROOT}/scripts/alp_project.py
            --input ${CMAKE_CURRENT_SOURCE_DIR}/board.yaml
            --emit zephyr-conf
            --output ${_alp_generated}
    RESULT_VARIABLE _alp_rv
    OUTPUT_VARIABLE _alp_stdout
    ERROR_VARIABLE  _alp_stderr
)
if(NOT _alp_rv EQUAL 0)
    message(FATAL_ERROR
        "alp_project.py failed (rv=${_alp_rv}); "
        "check ${CMAKE_CURRENT_SOURCE_DIR}/board.yaml.\n"
        "stderr: ${_alp_stderr}")
endif()

# Layer generated CONFIG_* over prj.conf via OVERLAY_CONFIG.
list(APPEND OVERLAY_CONFIG ${_alp_generated})

find_package(Zephyr REQUIRED HINTS $ENV{ZEPHYR_BASE})
project(counter_alarm LANGUAGES C)

target_sources(app PRIVATE src/main.c)
```

## prj.conf
```kconfig
# SPDX-License-Identifier: Apache-2.0
#
# Intentionally empty.  Every CONFIG_* this app needs is derived
# from board.yaml by scripts/alp_project.py and layered in via
# OVERLAY_CONFIG (see CMakeLists.txt).  Add app-specific tuning
# knobs (e.g. CONFIG_HEAP_MEM_POOL_SIZE=N) here only when they
# are NOT feature-selection -- everything declarative belongs in
# board.yaml.
```

## src/main.c
```c
/*
 * Copyright 2026 ALP Lab AB
 * SPDX-License-Identifier: Apache-2.0
 *
 * counter-alarm — schedule a one-shot alarm 100 ms ahead.
 */

#include <stdio.h>

#include <zephyr/kernel.h>

#include "alp/counter.h"

static volatile bool fired = false;

static void on_alarm(alp_counter_t *c, uint32_t ticks, void *user) {
    (void)c; (void)user;
    fired = true;
    printk("[counter] alarm fired @ ticks=%u\n", ticks);
}

int main(void) {
    printf("[counter] open id=0\n");

    alp_counter_t *c = alp_counter_open(&(alp_counter_config_t){
        .counter_id = 0,
    });
    if (c == NULL) {
        printf("[counter] open failed: alp_last_error=%d\n",
               (int)alp_last_error());
        printf("[counter] done\n");
        return 0;
    }

    alp_status_t s = alp_counter_start(c);
    printf("[counter] start -> %d\n", (int)s);

    uint32_t ticks_100ms = 0;
    s = alp_counter_us_to_ticks(c, 100000, &ticks_100ms);
    printf("[counter] 100ms = %u ticks (status=%d)\n",
           ticks_100ms, (int)s);

    s = alp_counter_set_alarm(c, ticks_100ms, on_alarm, NULL);
    printf("[counter] set_alarm -> %d\n", (int)s);

    /* Wait up to 250 ms for the callback. */
    for (int i = 0; i < 25 && !fired; i++) k_msleep(10);
    printf("[counter] fired=%d\n", (int)fired);

    alp_counter_close(c);
    printf("[counter] done\n");
    return 0;
}
```
