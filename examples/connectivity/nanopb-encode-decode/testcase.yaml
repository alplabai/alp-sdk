## examples/connectivity/nanopb-encode-decode/testcase.yaml
```yaml
# SPDX-License-Identifier: Apache-2.0

sample:
  name: nanopb-encode-decode
  description: |
    nanopb teaching example. Encodes a small DeviceStatus struct (int32 +
    bounded string) to a protobuf wire blob with pb_encode, decodes it
    back with pb_decode, and asserts the round trip. Builds and runs on
    native_sim; the runtime .c files are compiled directly from the
    upstream nanopb module path (see CMakeLists.txt / README.md).

tests:
  alp_sdk.examples.nanopb_encode_decode.native_sim:
    platform_allow:
      - native_sim
      - native_sim/native/64
    integration_platforms:
      - native_sim/native/64
    tags:
      - alp-sdk
      - example
      - nanopb-encode-decode
    harness: console
    harness_config:
      type: one_line
      regex:
        - "\\[nanopb-encode-decode\\] done"
```

## examples/connectivity/tinygsm-modem-at/testcase.yaml
```yaml
# SPDX-License-Identifier: Apache-2.0
#
# Builds + runs on native_sim.  The example drives the modem AT
# exchange over a mock transcript Stream; it does not link libtinygsm
# (whose AT engine needs Arduino's full String class) -- see README.md
# "Why the real library isn't linked".

sample:
  name: tinygsm-modem-at
  description: |
    Runs the cellular-modem AT bring-up flow TinyGSM drives (AT
    liveness, then ATI / AT+CGMI / AT+GMM for getModemInfo) against a
    mock AT-transcript Stream, and prints the assembled modem info.
    The real TinyGsm modem(stream) call sequence is documented in
    src/main.cpp; linking the upstream library needs a full Arduino
    String, so this example demonstrates the same exchange directly.

tests:
  alp_sdk.example.tinygsm_modem_at:
    platform_allow:
      - native_sim
      - native_sim/native/64
    integration_platforms:
      - native_sim/native/64
    tags:
      - alp-sdk
      - example
      - tinygsm-modem-at
    harness: console
    harness_config:
        type: one_line
        regex:
          - "\\[tinygsm-modem-at\\] done"
```

## examples/connectivity/websocket-frame/testcase.yaml
```yaml
# SPDX-License-Identifier: Apache-2.0

sample:
  name: websocket-frame
  description: |
    libwebsockets teaching example. Masks + encodes a single RFC 6455
    TEXT frame into a buffer and decodes it back out, asserting the
    payload survives the round trip. No socket, no TLS. The real
    libwebsockets library isn't linked (see README "Integration
    reality"): its public header needs a CMake-generated
    lws_config.h, and its lws_write() framing path needs a live
    lws_context/wsi -- both out of scope for this offline teaching
    example, so this hand-rolls the RFC 6455 frame layout instead.

tests:
  alp_sdk.examples.websocket_frame.native_sim:
    platform_allow:
      - native_sim
      - native_sim/native/64
    integration_platforms:
      - native_sim/native/64
    tags:
      - alp-sdk
      - example
      - websocket-frame
    harness: console
    harness_config:
      type: one_line
      regex:
        - "\\[websocket-frame\\] done"
```

## examples/counter-alarm/testcase.yaml
```yaml
# SPDX-License-Identifier: Apache-2.0

sample:
  name: counter-alarm
  description: |
    Per-peripheral example for <alp/counter.h>.  Schedules a
    one-shot alarm 100 ms in the future.

tests:
  alp_sdk.example.counter_alarm:
    platform_allow:
      - native_sim
      - native_sim/native/64
    integration_platforms:
      - native_sim/native/64
    tags:
      - alp-sdk
      - example
      - counter
      harness: console
  harness_config:
      type: one_line
      regex:
        - "\\[counter\\] done"
```

## examples/dac-waveform/testcase.yaml
```yaml
# SPDX-License-Identifier: Apache-2.0

sample:
  name: dac-waveform
  description: |
    Per-peripheral example for DAC.  Generates a sine wave on
    E1M_X_DAC0 (V2N family GD32-bridged output).  Walks a 32-point
    sine LUT at a configurable sample rate.  build_only on
    native_sim -- no DAC controller available.

tests:
  alp_sdk.example.dac_waveform:
    platform_allow:
      - native_sim
      - native_sim/native/64
    integration_platforms:
      - native_sim/native/64
    tags:
      - alp-sdk
      - example
      - dac
      - v2n
    build_only: true
```

## examples/display/gfx-compat-blit/testcase.yaml
```yaml
# SPDX-License-Identifier: Apache-2.0

sample:
  name: gfx-compat-blit
  description: |
    Fills + blits a RGB565 buffer with gfx_compat (the in-tree SW-blit
    shim) and prints a checksum. [UNTESTED] -- native_sim only, no
    bench run.

tests:
  alp_sdk.example.gfx_compat_blit:
    platform_allow:
      - native_sim
      - native_sim/native/64
    integration_platforms:
      - native_sim/native/64
    tags:
      - alp-sdk
      - example
      - gfx-compat-blit
    harness: console
    harness_config:
        type: one_line
        regex:
          - "\\[gfx-compat-blit\\] done"
```

## examples/display/lvgl-music-player/testcase.yaml
```yaml
# SPDX-License-Identifier: Apache-2.0

sample:
  name: lvgl-music-player
  description: |
    Wraps upstream lv_demo_music() (album carousel + time slider
    + equaliser) on ST7789.  Display-only UI demo -- no audio path
    (lv_demo_music() only animates).  native_sim builds the UI
    against the dummy display; AEN target verifies the cross-compile.
common:
  tags: lvgl demo example display
tests:
  alp_sdk.examples.lvgl_music_player.native_sim:
    platform_allow: native_sim/native/64
    build_only: true
    # native_sim has no real panel -- bind the dummy display via the
    # per-example overlay so the dummy-panel knob never reaches the
    # real-silicon build.
    extra_args: EXTRA_CONF_FILE=native_sim.conf
  alp_sdk.examples.lvgl_music_player.aen:
    platform_allow:
      - ensemble_e8_dk/ae402fa0e5597le0/rtss_hp
    build_only: true
```

## examples/display/lvgl-widgets-demo/testcase.yaml
```yaml
# SPDX-License-Identifier: Apache-2.0

sample:
  name: lvgl-widgets-demo
  description: |
    Wraps the upstream lv_demo_widgets() showcase on a 240x320
    ST7789 panel via Zephyr's display subsystem + the lvgl library
    knob.  native_sim builds the UI against the dummy display; AEN
    target build verifies the cross-compile.
common:
  tags: lvgl demo example
tests:
  alp_sdk.examples.lvgl_widgets_demo.native_sim:
    platform_allow: native_sim/native/64
    build_only: true            # LVGL needs an SDL2 host runtime;
                                # twister build-only is enough for v0.5.
    # native_sim has no real panel -- bind the dummy display via the
    # per-example overlay so the dummy-panel knob never reaches the
    # real-silicon build.
    extra_args: EXTRA_CONF_FILE=native_sim.conf
  alp_sdk.examples.lvgl_widgets_demo.aen:
    platform_allow:
      - ensemble_e8_dk/ae402fa0e5597le0/rtss_hp
    build_only: true            # No EVK runner online -- v0.6 HiL fills.
```

## examples/display/u8g2-oled-draw/testcase.yaml
```yaml
# SPDX-License-Identifier: Apache-2.0

sample:
  name: u8g2-oled-draw
  description: |
    Draws a string + frame + filled box with u8g2 against an in-RAM
    null device (no real panel), then dumps the tile buffer as ASCII
    art. [UNTESTED] -- native_sim only, no bench run.

tests:
  alp_sdk.example.u8g2_oled_draw:
    platform_allow:
      - native_sim
      - native_sim/native/64
    integration_platforms:
      - native_sim/native/64
    tags:
      - alp-sdk
      - example
      - u8g2-oled-draw
    harness: console
    harness_config:
        type: one_line
        regex:
          - "\\[u8g2-oled-draw\\] done"
```

## examples/drone-autopilot/testcase.yaml
```yaml
# SPDX-License-Identifier: Apache-2.0

sample:
  name: drone-autopilot
  description: |
    Self-contained quadcopter flight controller on E1M-AEN.
    Cascaded 1 kHz rate / 250 Hz attitude / 25 Hz nav PID loops,
    SBUS RC receiver, motor mixer, flight-mode state machine
    (manual / stabilise / GPS-hold / RTH / failsafe).
    Showcases the SDK's real-time control story.
common:
  tags: autopilot drone uav control marketing showcase
tests:
  alp_sdk.examples.drone_autopilot.native_sim:
    platform_allow: native_sim/native/64
    build_only: true
  alp_sdk.examples.drone_autopilot.aen:
    platform_allow:
      - alif_e7_dk_rtss_hp
    build_only: true
```

## examples/drone-hud/testcase.yaml
```yaml
# SPDX-License-Identifier: Apache-2.0

sample:
  name: drone-hud
  description: |
    Marketing demo: LSM6DSO IMU + uBlox NEO-M9N GNSS + INA236
    battery monitor + ST7789 TFT driven through portable <alp/*>
    surfaces.  Madgwick attitude fusion + LVGL HUD.  native_sim
    runs the UI + the threading model against simulated chip
    NOSUPPORT contracts.
common:
  tags: lvgl demo example marketing showcase drone uav
tests:
  alp_sdk.examples.drone_hud.native_sim:
    platform_allow: native_sim/native/64
    build_only: true
  alp_sdk.examples.drone_hud.aen:
    platform_allow:
      - ensemble_e8_dk/ae402fa0e5597le0/rtss_hp
    build_only: true
```

## examples/edgeai-vision-aen/testcase.yaml
```yaml
# SPDX-License-Identifier: Apache-2.0

sample:
  name: edgeai-vision-aen
  description: |
    EdgeAI vision reference application for the E1M-AEN family.
    v0.1: skeleton — compiles under native_sim and prints the
    pipeline stages with v0.2 stubs.

tests:
  alp_sdk.example.edgeai_vision_aen.skeleton:
    platform_allow:
      - native_sim
      - native_sim/native/64
    integration_platforms:
      - native_sim/native/64
    tags:
      - alp-sdk
      - example
      - edgeai
    build_only: false
    harness: console
    harness_config:
      type: one_line
      regex:
        - "\\[edgeai\\] done"

  # alp_sdk.example.edgeai_vision_aen.evk_aen — HW-in-loop variant
  # for the E1M EVK populated with an E1M-AEN family SoM. Currently
  # parked because the alp_e1m_evk_aen Zephyr board file lives in
  # alpCaner/alp-zephyr-modules (not yet published); twister rejects
  # unknown platforms in platform_allow. Re-enable when that board
  # file lands. The overlay at boards/alp_e1m_evk_aen.overlay is
  # already in place.
```

## examples/gpio-button-led/testcase.yaml
```yaml
# SPDX-License-Identifier: Apache-2.0

sample:
  name: gpio-button-led
  description: |
    Per-peripheral example for the GPIO surface via the
    <alp/blocks/button_led.h> block.  Button = encoder switch
    (E1M_GPIO_IO4); LED = the RGB-red PWM3 pad claimed as a GPIO
    (E1M_GPIO_PWM3, the E1M "GPIO secondary").

tests:
  alp_sdk.example.gpio_button_led:
    platform_allow:
      - native_sim
      - native_sim/native/64
    integration_platforms:
      - native_sim/native/64
    tags:
      - alp-sdk
      - example
      - gpio
    harness: console
    harness_config:
        type: one_line
        regex:
          - "\\[gpio\\] done"
```

## examples/heterogeneous-offload/m33_sm/testcase.yaml
```yaml
# SPDX-License-Identifier: Apache-2.0
#
# Lives under m33_sm/ (not the project root) because this is a
# multi-slice project: the Yocto consumer under linux/ is tested
# by the bitbake CI lane.  Twister sees the Zephyr slice only.

sample:
  name: heterogeneous-offload-m33_sm
  description: |
    Heterogeneous-compute offload demo: the M33-SM core (Zephyr)
    offloads a workload submitted by the A55 cluster (Yocto) via
    `<alp/rpc.h>`.  This testcase covers ONLY the Zephyr/M33-SM
    half; the A55 side is bitbake-only.

tests:
  alp_sdk.examples.heterogeneous_offload.native_sim:
    platform_allow:
      - native_sim/native/64
    tags:
      - alp-sdk
      - example
      - heterogeneous
      - rpc
      - mproc
    build_only: true
    extra_args: CONFIG_ALP_SDK_RPC=y
```

## examples/i2c-master/testcase.yaml
```yaml
# SPDX-License-Identifier: Apache-2.0

sample:
  name: i2c-master
  description: |
    Per-peripheral example for I2C master.  Reads the on-module
    TMP112 temperature sensor at a known 7-bit address.  Contrasts
    with examples/i2c-scanner (discovery vs known-address read).

tests:
  alp_sdk.example.i2c_master:
    platform_allow:
      - native_sim
      - native_sim/native/64
    integration_platforms:
      - native_sim/native/64
    tags:
      - alp-sdk
      - example
      - i2c
      - sensors
    harness: console
    harness_config:
        type: one_line
        regex:
          - "\\[i2c-master\\] done"
```

## examples/i2c-scanner/testcase.yaml
```yaml
# SPDX-License-Identifier: Apache-2.0

sample:
  name: i2c-scanner
  description: |
    Per-peripheral example for I²C.  Walks 7-bit addresses on
    E1M_I2C0 and reports responders.

tests:
  alp_sdk.example.i2c_scanner:
    platform_allow:
      - native_sim
      - native_sim/native/64
    integration_platforms:
      - native_sim/native/64
    tags:
      - alp-sdk
      - example
      - i2c
    harness: console
    harness_config:
        type: one_line
        regex:
          - "\\[i2c\\] done"
```

## examples/iot-connected-camera/testcase.yaml
```yaml
# SPDX-License-Identifier: Apache-2.0

sample:
  name: iot-connected-camera
  description: |
    Connected-camera reference application for the V2N family.
    v0.1: skeleton — compiles under native_sim and prints the
    pipeline stages with v0.2 / v0.3 stubs.

tests:
  alp_sdk.example.iot_connected_camera.skeleton:
    platform_allow:
      - native_sim
      - native_sim/native/64
    integration_platforms:
      - native_sim/native/64
    tags:
      - alp-sdk
      - example
      - iot
    build_only: false
    harness: console
    harness_config:
      type: one_line
      regex:
        - "\\[iotcam\\] done"

  # alp_sdk.example.iot_connected_camera.evk_v2n — HW-in-loop
  # variant for the E1M EVK populated with an E1M-V2N family SoM.
  # Currently parked because the alp_e1m_evk_v2n Zephyr board file
  # lives in alpCaner/alp-zephyr-modules (not yet published).
  # Re-enable when that board file lands.
```

## examples/iot-dashboard/testcase.yaml
```yaml
# SPDX-License-Identifier: Apache-2.0

sample:
  name: iot-dashboard
  description: |
    BME280 environment sensor + OPTIGA Trust M + ST7789 TFT.
    mbedtls + coremqtt_sn library knobs supply TLS + MQTT
    publish.  WiFi via the portable <alp/iot.h> surface so the
    same source builds on AEN (external WiFi) or V2N (on-module
    Murata).  native_sim stubs WiFi + MQTT.
common:
  tags: lvgl iot mqtt tls demo example
  harness: console
tests:
  alp_sdk.examples.iot_dashboard.native_sim:
    platform_allow: native_sim/native/64
    build_only: true
  alp_sdk.examples.iot_dashboard.aen:
    platform_allow:
      - alif_e7_dk_rtss_hp
    build_only: true
```

## examples/lvgl-benchmark/testcase.yaml
```yaml
# SPDX-License-Identifier: Apache-2.0

sample:
  name: lvgl-benchmark
  description: |
    Wraps the upstream lv_demo_benchmark() FPS harness on ST7789.
    Customers run it to compare per-SoM rendering throughput
    (capabilities:'s gpu2d / dave2d / dma2d wiring) without
    writing benchmark code themselves.
common:
  tags: lvgl benchmark demo example performance
tests:
  alp_sdk.examples.lvgl_benchmark.native_sim:
    platform_allow: native_sim/native/64
    build_only: true
  alp_sdk.examples.lvgl_benchmark.aen:
    platform_allow:
      - ensemble_e8_dk/ae402fa0e5597le0/rtss_hp
    build_only: true
```
