## examples/lvgl-widgets-demo/testcase.yaml
```yaml
# SPDX-License-Identifier: Apache-2.0

sample:
  name: lvgl-widgets-demo
  description: |
    Wraps the upstream lv_demo_widgets() showcase on a 240x320
    ST7789 panel via the SDK's chips/st7789/ driver + the lvgl
    library knob.  native_sim builds the UI against LVGL's SDL2
    backend; AEN target build verifies the cross-compile.
common:
  tags: lvgl demo example
  harness: console
tests:
  alp_sdk.examples.lvgl_widgets_demo.native_sim:
    platform_allow: native_sim/native/64
    build_only: true            # LVGL needs an SDL2 host runtime;
                                # twister build-only is enough for v0.5.
  alp_sdk.examples.lvgl_widgets_demo.aen:
    platform_allow:
      - alif_e7_dk_rtss_hp
    build_only: true            # No EVK runner online -- v0.6 HiL fills.
```

## examples/mproc-dual-os-yocto-zephyr/testcase.yaml
```yaml
# SPDX-License-Identifier: Apache-2.0

sample:
  name: mproc-dual-os-yocto-zephyr
  description: |
    Heterogeneous-compute flagship: Yocto Linux on the V2N's
    Cortex-A55 cluster + Zephyr on the same SoC's Cortex-M33,
    communicating via <alp/mproc.h> shmem + mailbox.  This
    testcase covers ONLY the Zephyr/M33 half (build_only under
    native_sim).  The A55/Yocto consumer is tested separately
    by meta-alp-sdk's bitbake CI.

tests:
  alp_sdk.examples.mproc_dual_os.native_sim:
    platform_allow:
      - native_sim/native/64
    tags:
      - alp-sdk
      - example
      - multiprocessor
      - yocto
      - heterogeneous
    build_only: true
    harness: console
    harness_config:
      type: one_line
      regex:
        - "\\[dual-os\\] done"
```

## examples/mproc-mailbox/testcase.yaml
```yaml
# SPDX-License-Identifier: Apache-2.0

sample:
  name: mproc-mailbox
  description: |
    AEN M55-HP side of a Cortex-M55 mailbox + shared-memory
    roundtrip via <alp/mproc.h>.  Under native_sim the example
    exercises the HP-side init + alp_mbox_send framing path and
    exits cleanly (no peer core to talk to).  Real silicon
    waits for the peer firmware to echo the payload back.
common:
  tags: mproc shmem
  harness: console
  harness_config:
    type: one_line
    regex:
      - "\\[mproc\\] done"
tests:
  alp_sdk.examples.mproc_mailbox.native_sim:
    platform_allow: native_sim/native/64
  alp_sdk.examples.mproc_mailbox.aen:
    platform_allow:
      - alif_e7_dk_rtss_he
    extra_args: CONFIG_ALP_SDK_MPROC=y
    build_only: true   # real run needs the peer firmware (v0.4+).
```

## examples/multicore/rpmsg-aen/m55_hp/testcase.yaml
```yaml
# SPDX-License-Identifier: Apache-2.0
#
# Lives under m55_hp/ because rpmsg-aen is a multi-slice project
# (M55-HP + M55-HE peers on the Alif Ensemble).  Twister picks up
# this single self-contained Zephyr slice.

sample:
  name: rpmsg-aen-m55_hp
  description: |
    Heterogeneous-compute on the Alif Ensemble: M55-HP +
    M55-HE peers exchanging messages via `<alp/rpc.h>` over
    RPMsg.  This testcase covers the M55-HP Zephyr slice; the
    M55-HE peer is built separately by the same orchestrator.

tests:
  alp_sdk.examples.rpmsg_aen.native_sim:
    platform_allow:
      - native_sim/native/64
    tags:
      - alp-sdk
      - example
      - aen
      - heterogeneous
      - rpmsg
    build_only: true
    extra_args: CONFIG_ALP_SDK_RPC=y
```

## examples/multicore/rpmsg-v2n/m33_sm/testcase.yaml
```yaml
# SPDX-License-Identifier: Apache-2.0
#
# Lives under m33_sm/ (not the project root) because rpmsg-v2n is a
# multi-slice project: the parent directory carries the orchestrator's
# board.yaml + linux/ Yocto consumer + this m33_sm/ Zephyr app.  Only
# the m33_sm/ tree is a self-contained Zephyr app twister can build,
# so the testcase has to sit next to its CMakeLists.txt — otherwise
# twister picks up the parent directory and tries to configure the
# multi-slice marker as a Zephyr app (no prj.conf, no Zephyr CMake).

sample:
  name: rpmsg-v2n-m33_sm
  description: |
    Heterogeneous-compute flagship: Yocto Linux on the V2N's
    Cortex-A55 cluster + Zephyr on the same SoC's Cortex-M33-SM,
    communicating over a raw OpenAMP/RPMsg link (alp-sdk #683 "Path
    B, Phase 1" -- see src/main.c's file header for why this phase
    bypasses <alp/rpc.h>).  The A55/Yocto consumer is tested
    separately by the bitbake CI lane.

    native_sim dropped (alp-sdk #683): this firmware is no longer a
    portable placeholder -- it requires real RZ/V2N devicetree
    (rsctbl/vring/mhu nodes, see the board overlay) and the Renesas
    MHU mailbox + FSP + OpenAMP/libmetal modules, none of which
    native_sim provides.  build_only against the real board is this
    phase's proof; bench attach/echo verification is a later phase.
    Requires hal_renesas + open-amp + libmetal as west modules (see
    west.yml) -- a CI runner without those groups fetched cannot
    build this test.

tests:
  alp_sdk.examples.rpmsg_v2n.m33_sm:
    platform_allow:
      - alp_e1m_v2n101_m33_sm/r9a09g056n48gbg/cm33
    tags:
      - alp-sdk
      - example
      - multiprocessor
      - yocto
      - heterogeneous
      - rpmsg
      - v2n
    build_only: true
```

## examples/peripheral-io/alp-console/testcase.yaml
```yaml
# SPDX-License-Identifier: Apache-2.0

sample:
  name: alp-console
  description: |
    Teaching example for the Alp SoM interactive console.  Enabling
    CONFIG_ALP_SDK_CONSOLE registers the whole `alp` command tree
    (board / gpio / i2c / adc / pwm / mem / clk / companion / reboot)
    at link time -- main() registers no commands itself.  On Alif the
    CC3501E companion is bound via alp_console_companion_set() so
    `alp companion ver` / ping work.  On native_sim the companion
    guard compiles out and the read-only console builds cleanly.

tests:
  alp_sdk.example.alp_console.native_sim:
    platform_allow:
      - native_sim/native/64
    integration_platforms:
      - native_sim/native/64
    tags:
      - alp-sdk
      - example
      - console
      - aen
    build_only: true
```
