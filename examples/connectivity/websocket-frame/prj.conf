## CMakeLists.txt
```
# SPDX-License-Identifier: Apache-2.0

cmake_minimum_required(VERSION 3.20)

find_package(Zephyr REQUIRED HINTS $ENV{ZEPHYR_BASE})
project(websocket_frame LANGUAGES C)

target_sources(app PRIVATE src/main.c)
```

## prj.conf
```kconfig
# SPDX-License-Identifier: Apache-2.0
#
# Every CONFIG_* this app needs is derived from board.yaml by
# `tan build` and layered in via EXTRA_CONF_FILE (see scripts/gen_example_alp_conf.py).  Nothing app-specific to add: the round trip below
# is pure buffer logic with no socket, no TLS.
```

## src/main.c
```c
/*
 * Copyright 2026 Alp Lab AB
 * SPDX-License-Identifier: Apache-2.0
 *
 * websocket-frame -- libwebsockets WebSocket frame encode/decode
 * teaching example.
 *
 * What this is supposed to show: mask + encode a single unfragmented
 * RFC 6455 TEXT frame into a buffer, then decode (unmask) it back out
 * and assert the payload matches -- the same byte layout a client
 * sends on the wire once a WebSocket handshake has upgraded the TCP
 * connection.
 *
 * [UNTESTED]: this example does not link against the real
 * libwebsockets library. Two compounding reasons, both confirmed by
 * reading the actual checkout at modules/lib/libwebsockets (real
 * files, ~230 KB source tree -- this module fetch
 * DID succeed):
 *
 *  1. libwebsockets ships no `zephyr/module.yml`, so west's module
 *     scanner never adds its include path or wires its CMakeLists.txt
 *     into a Zephyr build automatically -- an app has to do that
 *     itself.
 *
 *  2. Even with the include path added by hand, `include/
 *     libwebsockets.h` unconditionally `#include`s `lws_config.h`
 *     (see its line 42), which does not exist in the raw checkout --
 *     it is generated by libwebsockets' own CMakeLists.txt
 *     `configure_file()` step, which in turn depends on OpenSSL/
 *     mbedTLS/zlib discovery and dozens of `LWS_HAVE_*` feature
 *     probes.  Running that full configure is "more than a small
 *     local CMake source-compile" for a teaching example (see the
 *     work plan) -- out of scope here.
 *
 * Beyond the headers, the library's actual framing path
 * (`include/libwebsockets/lws-write.h`) only exposes `lws_write()`,
 * which takes a live `struct lws *wsi` and can only be called from
 * the connection's WRITEABLE callback -- there is no public function
 * that masks+frames a buffer offline, independent of a live
 * `lws_context`.  So even a from-scratch, no-TLS, no-`lws_config.h`
 * integration would still need a running event loop and a connected
 * `wsi`, not just a source-compile.
 *
 * What we do instead: implement the exact RFC 6455 section 5.2 frame
 * layout libwebsockets produces internally, by hand
 * (ws_frame_encode_text() / ws_frame_decode_text() below).
 *
 * Swapping to the real library once a full CMake-configured
 * libwebsockets build is wired in (see "Integration reality" in
 * README.md): allocate `unsigned char buf[LWS_PRE + payload_len]`,
 * fill `&buf[LWS_PRE]` with the payload, and call
 * `lws_write(wsi, &buf[LWS_PRE], payload_len, LWS_WRITE_TEXT)` from
 * the `LWS_CALLBACK_CLIENT_WRITEABLE` callback -- lws computes the
 * mask key and writes the frame header into the `LWS_PRE` bytes
 * before your payload itself, then sends it out the wsi's socket.
 * `LWS_PRE` is defined in `include/libwebsockets/lws-write.h` (16
 * bytes on most targets); `LWS_WRITE_TEXT` is `enum
 * lws_write_protocol`'s value `0`, matching the opcode this example
 * hand-encodes below.
 *
 * What success looks like:
 *
 *   [websocket-frame] encoding TEXT frame: payload="hello lws" (9 bytes)
 *   [websocket-frame] encoded 15 bytes (2 header + 4 mask key + 9 payload)
 *   [websocket-frame] decoded payload="hello lws" (9 bytes)
 *   [websocket-frame] round trip OK
 *   [websocket-frame] done
 */

#include <stdbool.h>
#include <stdint.h>
#include <stdio.h>
#include <string.h>

#include <alp/peripheral.h>

/* RFC 6455 5.2: byte 0 is FIN(1) | RSV1-3(3, always 0 here -- no
 * extension negotiated) | opcode(4).  A complete, unfragmented TEXT
 * message is FIN=1, opcode=0x1. */
#define WS_OPCODE_TEXT    0x1u
#define WS_BYTE0_FIN_TEXT ((uint8_t)(0x80u | WS_OPCODE_TEXT))

/* RFC 6455 5.2: byte 1 is MASK(1) | payload-len(7).  Client-to-server
 * frames MUST be masked (RFC 6455 5.1); this example only handles the
 * 7-bit length form (payload < 126 bytes) -- the 16-bit/64-bit
 * extended-length forms follow the same idea with 2 or 8 extra length
 * bytes before the mask key. */
#define WS_MASK_BIT     0x80u
#define WS_MAX_7BIT_LEN 125u

/* Frame layout this function produces for a short (<126-byte) masked
 * TEXT frame:
 *
 *   byte 0      FIN|RSV|opcode  -- 0x81
 *   byte 1      MASK|len(7)     -- 0x80 | payload_len
 *   byte 2-5    masking key     -- 4 bytes, XORed into the payload
 *   byte 6..    payload         -- XOR-masked payload bytes
 *
 * `mask_key` is caller-supplied so the round trip is deterministic
 * for this teaching example. RFC 6455 5.3 requires a real client to
 * pick an unpredictable key per frame (a security property, not just
 * a checksum) -- the real libwebsockets fills it from its own CSPRNG
 * inside lws_write(), which is exactly the kind of detail this
 * example can't reach without a live wsi (see the file header).
 *
 * Returns the number of bytes written, or 0 if buf_len is too small
 * or payload_len exceeds the 7-bit length form's 125-byte ceiling. */
static size_t ws_frame_encode_text(uint8_t       *buf,
                                   size_t         buf_len,
                                   const uint8_t  mask_key[4],
                                   const uint8_t *payload,
                                   size_t         payload_len)
{
	size_t total = 6u + payload_len;
	size_t i;

	if (payload_len > WS_MAX_7BIT_LEN || total > buf_len) {
		return 0;
	}

	buf[0] = WS_BYTE0_FIN_TEXT;
	buf[1] = (uint8_t)(WS_MASK_BIT | payload_len);
	memcpy(&buf[2], mask_key, 4u);

	/* RFC 6455 5.3: each payload octet is XORed with
	 * mask_key[i % 4] before it goes on the wire. */
	for (i = 0; i < payload_len; i++) {
		buf[6u + i] = (uint8_t)(payload[i] ^ mask_key[i % 4u]);
	}

	return total;
}

/* Inverse of ws_frame_encode_text().  Unmasks the payload into
 * `payload_out` (caller-supplied, at least `payload_out_cap` bytes).
 * Returns false if the buffer is too short, isn't a masked TEXT
 * frame, uses the 16/64-bit extended-length forms this minimal
 * decoder doesn't implement, or the payload doesn't fit
 * `payload_out_cap`. */
static bool ws_frame_decode_text(const uint8_t *buf,
                                 size_t         buf_len,
                                 uint8_t       *payload_out,
                                 size_t         payload_out_cap,
                                 size_t        *payload_len_out)
{
	uint8_t mask_key[4];
	uint8_t len7;
	size_t  i;

	if (buf_len < 6u) {
		return false;
	}
	if (buf[0] != WS_BYTE0_FIN_TEXT) {
		return false;
	}
	if ((buf[1] & WS_MASK_BIT) == 0u) {
		/* Server-to-client frames are typically unmasked; this
		 * teaching decoder only handles the masked client-frame
		 * shape ws_frame_encode_text() produces. */
		return false;
	}

	len7 = (uint8_t)(buf[1] & 0x7Fu);
	if (len7 > WS_MAX_7BIT_LEN) {
		/* 126/127 would mean the 16-bit/64-bit extended-length
		 * forms are in play -- not implemented here. */
		return false;
	}
	if (6u + (size_t)len7 > buf_len || (size_t)len7 > payload_out_cap) {
		return false;
	}

	memcpy(mask_key, &buf[2], 4u);
	for (i = 0; i < (size_t)len7; i++) {
		payload_out[i] = (uint8_t)(buf[6u + i] ^ mask_key[i % 4u]);
	}

	*payload_len_out = (size_t)len7;
	return true;
}

int main(void)
{
	static const uint8_t payload[]   = "hello lws";
	static const size_t  payload_len = sizeof(payload) - 1u; /* drop NUL */
	/* Fixed, non-random key: fine for a deterministic offline demo,
	 * NOT how a real client should pick one -- see the encode
	 * function's doc comment. */
	static const uint8_t mask_key[4] = { 0x37, 0xFA, 0x21, 0x3D };

	uint8_t buf[32];
	uint8_t decoded_payload[32];
	size_t  encoded_len;
	size_t  decoded_len;
	bool    ok;

	(void)alp_init();

	printf("[websocket-frame] encoding TEXT frame: payload=\"%s\" (%u bytes)\n",
	       payload,
	       (unsigned int)payload_len);

	encoded_len = ws_frame_encode_text(buf, sizeof(buf), mask_key, payload, payload_len);
	if (encoded_len == 0u) {
		printf("[websocket-frame] encode failed (buffer too small)\n");
		printf("[websocket-frame] done\n");
		return 0;
	}
	printf("[websocket-frame] encoded %u bytes (2 header + 4 mask key + %u payload)\n",
	       (unsigned int)encoded_len,
	       (unsigned int)payload_len);

	ok = ws_frame_decode_text(
	    buf, encoded_len, decoded_payload, sizeof(decoded_payload), &decoded_len);
	if (!ok) {
		printf("[websocket-frame] decode failed\n");
		printf("[websocket-frame] done\n");
		return 0;
	}

	/* decoded_payload isn't NUL-terminated -- %.*s bounds the print
	 * to decoded_len instead of relying on a terminator. */
	printf("[websocket-frame] decoded payload=\"%.*s\" (%u bytes)\n",
	       (int)decoded_len,
	       decoded_payload,
	       (unsigned int)decoded_len);

	if (decoded_len == payload_len && memcmp(decoded_payload, payload, payload_len) == 0) {
		printf("[websocket-frame] round trip OK\n");
	} else {
		printf("[websocket-frame] round trip MISMATCH\n");
	}

	printf("[websocket-frame] done\n");
	return 0;
}
```
