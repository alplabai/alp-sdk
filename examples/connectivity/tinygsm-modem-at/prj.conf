## CMakeLists.txt
```
# SPDX-License-Identifier: Apache-2.0
#
# Builds + runs on native_sim.  The example drives the modem AT
# exchange directly over a mock Stream (src/mock_at_stream.h) rather
# than linking libtinygsm, whose AT engine needs Arduino's full
# `String` class -- see README.md "Why the real library isn't linked"
# and the commented real-TinyGsm wiring at the end of this file.

cmake_minimum_required(VERSION 3.20)

# Resolve the alp-sdk root.  In-tree the SDK is the example's
# grandparent directory; out-of-tree customers point ALP_SDK_ROOT
# at their checkout.
if(DEFINED ENV{ALP_SDK_ROOT})
    set(ALP_SDK_ROOT $ENV{ALP_SDK_ROOT})
else()
    get_filename_component(ALP_SDK_ROOT ${CMAKE_CURRENT_SOURCE_DIR}/../../.. ABSOLUTE)
endif()

find_package(Python3 REQUIRED COMPONENTS Interpreter)

set(_alp_generated ${CMAKE_BINARY_DIR}/generated/alp.conf)
execute_process(
    COMMAND ${Python3_EXECUTABLE} ${ALP_SDK_ROOT}/scripts/alp_project.py
            --input ${CMAKE_CURRENT_SOURCE_DIR}/board.yaml
            --emit zephyr-conf
            --output ${_alp_generated}
    RESULT_VARIABLE _alp_rv
    OUTPUT_VARIABLE _alp_stdout
    ERROR_VARIABLE  _alp_stderr
)
if(NOT _alp_rv EQUAL 0)
    message(FATAL_ERROR
        "alp_project.py failed (rv=${_alp_rv}); "
        "check ${CMAKE_CURRENT_SOURCE_DIR}/board.yaml.\n"
        "stderr: ${_alp_stderr}")
endif()

# Layer generated CONFIG_* over prj.conf via OVERLAY_CONFIG.
list(APPEND OVERLAY_CONFIG ${_alp_generated})

find_package(Zephyr REQUIRED HINTS $ENV{ZEPHYR_BASE})
project(tinygsm_modem_at LANGUAGES C CXX)

target_sources(app PRIVATE src/main.cpp)

# The mock Stream (src/mock_at_stream.h) derives from our small
# Arduino-Stream shim (src/ArduinoCompat/ -- Print.h / Stream.h /
# Printable.h); put that dir on the include path.
target_include_directories(app PRIVATE ${CMAKE_CURRENT_SOURCE_DIR}/src/ArduinoCompat)

# Real TinyGSM (ARM/Arduino targets, once you supply a full Arduino
# `String`): fetch the module with
# `west update --group-filter +extras-tier1`, then link it -- it ships
# no zephyr/module.yml, so name its src/ dir explicitly and select the
# modem family + non-Arduino switch:
#
#   target_include_directories(app PRIVATE ${ZEPHYR_TINYGSM_MODULE_DIR}/src)
#   target_compile_definitions(app PRIVATE TINY_GSM_MODEM_SIM800 ARDUINO_DASH)
#
# and switch src/main.cpp to the `TinyGsm modem(stream)` sequence shown
# in its banner.
```

## prj.conf
```kconfig
# SPDX-License-Identifier: Apache-2.0
#
# This example is C++ (src/main.cpp + the Arduino-Stream shim's
# virtual Stream base).  These are C++ toolchain knobs the language
# needs -- not board.yaml feature selection, so they live here rather
# than being loader-derived (see hello-world/prj.conf for the "what
# goes here" rule).
CONFIG_CPP=y
CONFIG_STD_CPP17=y

# The virtual Stream base emits a deleting destructor that references
# operator delete(void*, size_t); Zephyr's minimal C++ library omits
# it, so pull in the host's full libstdc++ via EXTERNAL_LIBCPP
# (native_sim's default once REQUIRES_FULL_LIBCPP is set).  Matches
# the doctest-selftest example's C++ setup.
CONFIG_REQUIRES_FULL_LIBCPP=y
```

## src/main.cpp
```c
/*
 * Copyright 2026 Alp Lab AB
 * SPDX-License-Identifier: Apache-2.0
 *
 * tinygsm-modem-at -- the AT command/response flow TinyGSM drives to
 * bring up a cellular modem, run here against a mock transcript
 * `Stream` (no real UART / modem) so it builds and runs on native_sim.
 *
 * TinyGSM (github.com/vshymanskyy/TinyGSM, LGPL-3.0) is header-heavy
 * C++ written against the Arduino core. Its AT-response engine
 * (`TinyGsmModem.tpp`'s `waitResponse()`, `getModemInfoImpl()`) is
 * built entirely on Arduino's `String` class (`WString.h`) plus
 * `Stream::readStringUntil()` -- reimplementing that surface is a
 * full Arduino-core-compat project, not a small shim (see
 * `src/ArduinoCompat/README.md` + the README's "Why the real library
 * isn't linked" for the exact `-DARDUINO_DASH` error chain). So this
 * example does NOT link libtinygsm; it drives the SAME AT exchange
 * TinyGsm would, directly over the `MockAtStream` (src/mock_at_stream.h),
 * which is the reusable half a hardware-in-the-loop test would keep.
 *
 * The real TinyGSM integration -- identical AT sequence, done by the
 * library -- is one Stream-backed object:
 *
 *   #define TINY_GSM_MODEM_SIM800
 *   #include <TinyGsmClient.h>
 *   TinyGsm modem(uartStream);      // uartStream = an alp/uart.h Stream adapter
 *   modem.init();                   // sends "AT", echo-off, etc.
 *   String info = modem.getModemInfo();   // ATI + AT+CGMI + AT+GMM, concatenated
 *
 * [UNTESTED]: native_sim (mock transcript). Not bench-run against a
 * real modem, and the upstream library is not linked (see above).
 *
 * What success looks like:
 *
 *   [tinygsm-modem-at] alp-sdk tinygsm-modem-at starting
 *   [tinygsm-modem-at] init(): AT -> OK
 *   [tinygsm-modem-at] getModemInfo() -> SIMCOM_SIM800 SIMCOM SIM800
 *   [tinygsm-modem-at] done
 */

#include <cstdio>
#include <cstring>

#include "mock_at_stream.h"

/* What the "modem" replies to each AT command. TinyGsm::init() opens
 * with a bare "AT" liveness probe; TinyGsm::getModemInfo() (the
 * TinyGsmModem.tpp default) sends "ATI", "AT+CGMI", "AT+GMM" in
 * sequence and concatenates the three payload lines. GSM_OK == "OK\r\n"
 * is what TinyGSM's waitResponse() matches on. */
static const AtExchange kTranscript[] = {
	{ "AT", "\r\nOK\r\n" },
	{ "ATI", "\r\nSIMCOM_SIM800\r\nOK\r\n" },
	{ "AT+CGMI", "\r\nSIMCOM\r\nOK\r\n" },
	{ "AT+GMM", "\r\nSIM800\r\nOK\r\n" },
};

/* Send one AT command line (sendAT() appends "\r\n") and collect the
 * modem's raw reply into `out`. Mirrors what TinyGSM's stream.write()
 * + waitResponse() read loop do, minus the String machinery. */
static void send_at(Stream &s, const char *cmd, char *out, size_t outsz)
{
	for (const char *p = cmd; *p != '\0'; p++) {
		s.write(static_cast<uint8_t>(*p));
	}
	s.write(static_cast<uint8_t>('\r'));
	s.write(static_cast<uint8_t>('\n'));

	size_t n = 0;
	int    c;
	while ((c = s.read()) >= 0 && n < outsz - 1) {
		out[n++] = static_cast<char>(c);
	}
	out[n] = '\0';
}

/* Extract the first non-empty payload line of an AT reply (skipping
 * the leading "\r\n" and stopping before the trailing "OK"). This is
 * the value TinyGSM would hand back as a String. */
static void first_line(const char *resp, char *out, size_t outsz)
{
	while (*resp == '\r' || *resp == '\n') {
		resp++;
	}
	size_t n = 0;
	while (*resp != '\0' && *resp != '\r' && *resp != '\n' && n < outsz - 1) {
		out[n++] = *resp++;
	}
	out[n] = '\0';
}

int main()
{
	printf("[tinygsm-modem-at] alp-sdk tinygsm-modem-at starting\n");

	/* On real hardware this Stream is a UART bound to the modem; a
	 * mock transcript stands in on native_sim (same Stream contract,
	 * table-driven instead of silicon). */
	MockAtStream stream(kTranscript, sizeof(kTranscript) / sizeof(kTranscript[0]));

	char resp[256];

	/* init(): liveness probe. A real init() then walks echo-off /
	 * error-mode / SIM-status commands this transcript doesn't model. */
	send_at(stream, "AT", resp, sizeof(resp));
	bool alive = (strstr(resp, "OK") != nullptr);
	printf("[tinygsm-modem-at] init(): AT -> %s\n", alive ? "OK" : "no response");

	/* getModemInfo(): ATI + AT+CGMI + AT+GMM, payload lines joined by
	 * spaces -- exactly what TinyGsmModem.tpp's getModemInfoImpl()
	 * assembles into its returned String. */
	char              info[128] = { 0 };
	char              line[64];
	const char *const info_cmds[] = { "ATI", "AT+CGMI", "AT+GMM" };
	for (size_t i = 0; i < sizeof(info_cmds) / sizeof(info_cmds[0]); i++) {
		send_at(stream, info_cmds[i], resp, sizeof(resp));
		first_line(resp, line, sizeof(line));
		if (i > 0) {
			strncat(info, " ", sizeof(info) - strlen(info) - 1);
		}
		strncat(info, line, sizeof(info) - strlen(info) - 1);
	}
	printf("[tinygsm-modem-at] getModemInfo() -> %s\n", info);

	if (!alive || info[0] == '\0') {
		printf("[tinygsm-modem-at] ERROR: modem did not respond as expected\n");
		return 1;
	}

	printf("[tinygsm-modem-at] done\n");
	return 0;
}
```

## src/mock_at_stream.h
```c
/*
 * Copyright 2026 Alp Lab AB
 * SPDX-License-Identifier: Apache-2.0
 *
 * mock_at_stream.h -- a canned-transcript AT-modem `Stream` stand-in.
 *
 * On real hardware, TinyGSM's `TinyGsm modem(stream)` constructor
 * takes a `Stream&` bound to the UART the modem is wired to (an
 * `alp/uart.h` handle wrapped in a `Stream` adapter, on this SDK's
 * portable API -- see README.md "Swapping in a real UART"). Here on
 * native_sim there's no modem, so `MockAtStream` plays back a
 * pre-recorded AT command/response transcript instead: every
 * `write()` of a command line is matched against the next expected
 * command, and the corresponding response is queued up for
 * subsequent `read()`/`available()` calls -- functionally the same
 * contract a real modem's UART presents, just driven by a table
 * instead of silicon.
 */

#ifndef ALP_TINYGSM_MOCK_AT_STREAM_H_
#define ALP_TINYGSM_MOCK_AT_STREAM_H_

#include <cstdio>
#include <cstring>

#include "ArduinoCompat/Stream.h"

/* One request/response exchange in the canned transcript.  `command`
 * excludes the trailing "\r\n" TinyGSM's sendAT() appends; `response`
 * is the raw bytes a real modem would write back, "\r\n" included. */
struct AtExchange {
	const char *command;
	const char *response;
};

class MockAtStream : public Stream
{
  public:
	MockAtStream(const AtExchange *transcript, size_t count)
	    : transcript_(transcript), count_(count)
	{
	}

	/* --- Print: the modem's TX path (what the app sends TO the "modem") --- */
	size_t write(uint8_t b) override
	{
		/* Buffer the outgoing command line byte-by-byte; on '\n'
		 * (sendAT() always terminates with "\r\n") match it
		 * against the transcript and queue the matching response. */
		if (tx_len_ < sizeof(tx_buf_) - 1) {
			tx_buf_[tx_len_++] = static_cast<char>(b);
		}
		if (b == '\n') {
			tx_buf_[tx_len_] = '\0';
			match_and_queue_response();
			tx_len_ = 0;
		}
		return 1;
	}

	/* --- Stream: the modem's RX path (what the "modem" sends back) --- */
	int available() override
	{
		return static_cast<int>(rx_len_ - rx_pos_);
	}

	int read() override
	{
		if (rx_pos_ >= rx_len_) {
			return -1;
		}
		return static_cast<unsigned char>(rx_buf_[rx_pos_++]);
	}

	int peek() override
	{
		if (rx_pos_ >= rx_len_) {
			return -1;
		}
		return static_cast<unsigned char>(rx_buf_[rx_pos_]);
	}

	void flush() override
	{
		/* Nothing buffered to drain in a mock -- a real UART
		 * backend would block here until the TX FIFO empties. */
	}

  private:
	void match_and_queue_response()
	{
		/* tx_buf_ holds "<command>\r\n"; strip the CRLF before
		 * comparing against the table's bare command text. */
		size_t cmd_len = tx_len_;
		while (cmd_len > 0 && (tx_buf_[cmd_len - 1] == '\n' || tx_buf_[cmd_len - 1] == '\r')) {
			cmd_len--;
		}

		for (size_t i = 0; i < count_; i++) {
			if (strlen(transcript_[i].command) == cmd_len &&
			    strncmp(transcript_[i].command, tx_buf_, cmd_len) == 0) {
				const char *resp = transcript_[i].response;
				rx_len_          = strlen(resp);
				if (rx_len_ >= sizeof(rx_buf_)) {
					rx_len_ = sizeof(rx_buf_) - 1;
				}
				memcpy(rx_buf_, resp, rx_len_);
				rx_pos_ = 0;
				return;
			}
		}
		/* Unrecognised command -- leave the RX buffer empty; a
		 * real modem would eventually time out the same way. */
		printf("[tinygsm-modem-at] mock: no canned response for \"%.*s\"\n", (int)cmd_len, tx_buf_);
	}

	const AtExchange *transcript_;
	size_t            count_;

	char   tx_buf_[128];
	size_t tx_len_ = 0;

	char   rx_buf_[256];
	size_t rx_len_ = 0;
	size_t rx_pos_ = 0;
};

#endif /* ALP_TINYGSM_MOCK_AT_STREAM_H_ */
```
