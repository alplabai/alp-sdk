## CMakeLists.txt
```
# SPDX-License-Identifier: Apache-2.0

cmake_minimum_required(VERSION 3.20)

find_package(Zephyr REQUIRED HINTS $ENV{ZEPHYR_BASE})
project(production_deployment LANGUAGES C)

target_sources(app PRIVATE src/main.c)
```

## prj.conf
```kconfig
# SPDX-License-Identifier: Apache-2.0
#
# Empty by design.  The build's effective Kconfig is
# generated/alp.conf -- emitted from this app's board.yaml
# by `tan build` and layered over this file via
# EXTRA_CONF_FILE (see scripts/gen_example_alp_conf.py).
#
# mbedtls used to be forced OFF here (and in native_sim.conf), because
# the pinned mbedtls' ssl_misc.h uses `mbedtls_error_pair_t` with PSA
# crypto off and does not compile.  That is fixed at its root -- the SDK
# now turns mbedtls' PSA core on with mbedtls itself, see
# ALP_SDK_MBEDTLS_PSA_CRYPTO in zephyr/Kconfig.alp-libraries (#2173) --
# so the attestation / OTA-poll call sites build against the real
# library on every target, native_sim included.
```

## native_sim.conf
```kconfig
# SPDX-License-Identifier: Apache-2.0
#
# Native-sim Kconfig overlay for production-deployment.
#
# Loaded LAST via twister's `extra_args: EXTRA_CONF_FILE=...`
# (see ../testcase.yaml), so the settings here win over the
# alp.conf-emitted config.
#
# The mbedtls-off block that used to live here is gone: it worked around
# the ssl_misc.h break, which is fixed at its root (#2173), so this
# target now builds the same TLS-enabled configuration the SoM does.

# CONFIG_FILE_SYSTEM_LITTLEFS requires a backing flash device or a
# block device declared in DT (CONFIG_FS_LITTLEFS_BLK_DEV).  native_sim
# carries neither, so upstream `subsys/fs/littlefs_fs.c` trips its
# BUILD_ASSERT (no flash/block-device backend visible) and the build
# aborts with "static assertion failed" before main.c even compiles.
# Real-silicon (.aen) builds keep LFS on -- the AEN MRAM is wired
# into DT as the chosen `zephyr,flash-controller` for the storage
# partitions, so the assertion passes.
CONFIG_FILE_SYSTEM_LITTLEFS=n
CONFIG_FILE_SYSTEM=n

# native_sim's only entropy driver is FAKE_ENTROPY_NATIVE_SIM, whose own
# Kconfig help says it "does not generate real entropy". mbedTLS' PSA crypto
# core is on here (ALP_SDK_MBEDTLS_PSA_CRYPTO, #2173), so the weak-RNG
# refusal in zephyr/CMakeLists.txt applies and a simulator run has to
# acknowledge it (#2192). This file is native_sim-only and is NOT applied to
# a real-silicon build, so a scaffolded copy built for a SoM still refuses
# until a real entropy driver exists.
CONFIG_ALP_SDK_ALLOW_TEST_ENTROPY=y
```

## src/main.c
```c
/*
 * Copyright 2026 Alp Lab AB
 * SPDX-License-Identifier: Apache-2.0
 *
 * production-deployment -- the v1.0 reference application for a
 * field-deployable IoT product.  Demonstrates the full
 * "manufactured -> deployed -> updated -> recovered" lifecycle on
 * a single app, so customers see how the SDK's secure-boot, OTA,
 * EEPROM-provisioning, and remote-attestation pieces fit together.
 *
 * The four lifecycle stages the example shows
 * ===========================================
 *
 *   1. Factory-provisioning read-back.
 *      On boot, `alp_hw_info_*` reads the manufacturer EEPROM
 *      manifest programmed at factory test.  The manifest carries
 *      the board's per-unit identity: SKU, serial number, HW
 *      revision, factory-burn date.  Production-grade firmware
 *      treats this as authoritative -- never derive identity from
 *      the SoC's internal UID alone.
 *
 *   2. Secure-boot evidence.
 *      MCUboot has already validated the running image against the
 *      ECDSA-P256 boot key by the time `main()` runs (the
 *      bootloader rejects unsigned / wrong-key images at boot).
 *      This app reads back the active slot + image revision so the
 *      cloud-side fleet console can confirm the deployed firmware
 *      matches what the signing service produced.  See
 *      `docs/secure-boot.md` for the signing-service contract.
 *
 *   3. OTA polling + apply.
 *      `alp_iot_*` opens a TLS-mutual-auth connection to the
 *      Mender server and polls for a deployment.  On a two-slot
 *      AEN target, a pending deployment would be downloaded,
 *      verified against the same ECDSA-P256 boot key, written to
 *      the inactive slot, and applied on reboot.  On this SKU
 *      (E1M-AEN801) MCUboot boots single-app (#1069/#1413, see
 *      docs/secure-boot.md): OTA apply is DEFERRED -- there is no
 *      inactive slot to stage a new image in, and self-overwriting
 *      the running slot0 is not a supported flow, so this app polls
 *      and verifies but does not apply.  A rejected signature at
 *      boot halts rather than rolling back to a previous image.
 *
 *   4. Remote attestation.
 *      Per the threat model (`docs/threat-model.md` §asset 8), a
 *      cloud-side fleet operator needs evidence that the device
 *      hasn't been physically tampered with.  This app publishes
 *      a periodic heartbeat that includes the OPTIGA-signed boot
 *      log + the running slot0 image's identity.  An attacker who
 *      swapped the flash chip itself sees the OPTIGA signature
 *      break.
 *
 * Why this is a "reference application" not a "library example"
 * =============================================================
 *
 * Every previous flagship example shows one SDK surface
 * (PWM, I²C, audio, inference, ...).  This one shows the
 * *production deployment lifecycle* the SDK is designed for --
 * the integration of all the security + connectivity pieces into
 * a single field-deployable app.  Customers ship variants of
 * this skeleton to production rather than writing the
 * EEPROM-readback / Mender / OPTIGA glue from scratch.
 *
 * What runs under native_sim
 * ==========================
 *
 * The four pieces above need real silicon to verify (EEPROM
 * I²C reads, MCUboot slot inspection, TLS to a real Mender
 * server, OPTIGA signature).  Under native_sim the app reaches
 * each stage's open() call, observes the documented NOSUPPORT /
 * NOT_READY return, prints the stage transition, and proceeds.
 * The framing is what tests; the substantive verification gates
 * on HiL per `docs/test-plan.md`.
 *
 * What runs on HiL
 * ================
 *
 * Full lifecycle, end-to-end:
 *   - Boot from a factory-signed image.
 *   - Read manufacturer EEPROM, print serial + SKU + rev.
 *   - Inspect the MCUboot slot0 image, print image revision.
 *   - Connect to a Mender server (board-staged
 *     production-test rig), poll for an update.
 *   - When a deployment lands: download + verify it (real on this
 *     SKU).  Apply is DEFERRED (#1069, see [STATUS] in board.yaml)
 *     -- there is no inactive slot to stage into, so the demo
 *     stops after verification rather than writing or rebooting.
 *   - On every boot, a passing re-verify of slot0 *is* the
 *     confirmation -- there is no swap state to keep.
 *   - Publish OPTIGA-signed attestation every 60 s thereafter.
 */

#include <stdio.h>
#include <string.h>

#include "alp/peripheral.h"

#include "alp/hw_info.h"
#include "alp/iot.h"
#include "alp/security.h"
#include "alp/storage.h"

#define MENDER_POLL_INTERVAL_S 600u
#define HEARTBEAT_INTERVAL_S   60u

/* ----------------------------------------------------------------- */
/* Stage 1: factory-provisioning read-back                            */
/* ----------------------------------------------------------------- */

static void stage_factory_identity(void)
{
	printf("[prod] stage 1: reading manufacturer EEPROM manifest\n");
	alp_hw_info_t      info = { 0 };
	const alp_status_t s    = alp_hw_info_read(&info);
	if (s != ALP_OK) {
		printf("[prod]   alp_hw_info_read -> %d -- continuing with no identity\n", (int)s);
		return;
	}
	printf("[prod]   SoM SKU=%s\n", info.som_sku);
	printf("[prod]   SoM serial=%s\n", info.som_serial);
	printf("[prod]   SoM hw_rev=%s\n", info.som_hw_rev);
	printf("[prod]   SoM mfg date=%u-%02u-%02u\n",
	       (unsigned)info.som_mfg_year,
	       (unsigned)info.som_mfg_month,
	       (unsigned)info.som_mfg_day);
	if (info.board_name[0] != '\0') {
		printf("[prod]   board=%s rev=%s\n", info.board_name, info.board_hw_rev);
	}
}

/* ----------------------------------------------------------------- */
/* Stage 2: secure-boot evidence                                       */
/* ----------------------------------------------------------------- */

static void stage_secure_boot_evidence(void)
{
	printf("[prod] stage 2: reading MCUboot slot info\n");
	/* alp_storage_open(INTERNAL_FLASH) lets us inspect slot0.  On a
     * two-slot AEN target the swap-state byte + image_ok flag would
     * live in the active slot's trailer sector; on this SKU
     * (E1M-AEN801) MCUboot boots single-app (see [STATUS] in
     * board.yaml) and there is no swap trailer at all -- a passing
     * re-verify of slot0 on every boot *is* the confirmation.  This
     * example just demonstrates the flash-info read path. */
	alp_storage_t *s = alp_storage_open(&(alp_storage_config_t){
	    .kind        = ALP_STORAGE_KIND_INTERNAL_FLASH,
	    .instance_id = 0u,
	});
	if (s == NULL) {
		printf("[prod]   internal flash open -> last_err=%d\n", (int)alp_last_error());
		return;
	}
	alp_storage_info_t info = { 0 };
	const alp_status_t rc   = alp_storage_get_info(s, &info);
	if (rc == ALP_OK) {
		printf("[prod]   internal flash: %llu bytes total, block=%u erase=%u\n",
		       (unsigned long long)info.total_bytes,
		       (unsigned)info.block_size,
		       (unsigned)info.erase_size);
		printf("[prod]   (slot inspection + image_ok read happens here on HiL)\n");
	}
	alp_storage_close(s);
}

/* ----------------------------------------------------------------- */
/* Stage 3: OTA polling                                                */
/* ----------------------------------------------------------------- */

static void stage_ota_poll(void)
{
	printf("[prod] stage 3: connecting to Mender server\n");
	/* The real Mender stack:
     *   1. alp_iot_wifi_open + alp_iot_wifi_connect to associate.
     *   2. alp_iot_mqtt_open against the broker carrying the
     *      Mender deployment commands (or HTTPS poll, depending
     *      on the Mender flavour).
     *   3. On a deployment event, a two-slot AEN target would
     *      alp_storage_open(OSPI) the OTA staging partition, write
     *      chunks there, alp_iot_publish a deployment-accepted
     *      status, and reboot into the newly-staged image.  This
     *      SKU (E1M-AEN801) boots single-app (see [STATUS] in
     *      board.yaml): OTA apply is DEFERRED (#1069) -- E1M-AEN801
     *      has no OSPI flash fitted at all (`ospi0`/`ospi1` are both
     *      `assembled: false` in its SoM preset), so `ps_storage`
     *      backs to the same on-die MRAM (`mram_main`) that holds
     *      slot0.
     *
     * On native_sim every step returns NOSUPPORT; the example
     * prints the transitions but doesn't actually move bytes. */
	alp_wifi_t *wifi = alp_wifi_open();
	if (wifi == NULL) {
		printf("[prod]   wifi open -> NOSUPPORT (native_sim) or NOT_READY (HiL pre-DT)\n");
		return;
	}
	alp_wifi_close(wifi);
}

/* ----------------------------------------------------------------- */
/* Stage 4: remote attestation                                         */
/* ----------------------------------------------------------------- */

static void stage_remote_attestation_tick(void)
{
	/* alp_aead_open(AES_GCM, derived-key) wrapped around an
     * OPTIGA-signed payload would be the production shape; under
     * native_sim we exercise the framing path so the code-path
     * coverage stays meaningful in CI. */
	uint8_t            payload[64];
	const alp_status_t s = alp_random_bytes(payload, sizeof payload);
	if (s != ALP_OK) {
		printf("[prod]   attestation: alp_random_bytes -> %d\n", (int)s);
		return;
	}
	printf("[prod]   attestation: 64-byte nonce drawn from TRNG\n");
	/* On HiL: alp_optiga_sign(payload, sizeof payload, signature)
     * then alp_iot_mqtt_publish(topic, signature, ...). */
}

int main(void)
{
	printf("[prod] alp-sdk production-deployment flagship\n");

	stage_factory_identity();
	stage_secure_boot_evidence();
	stage_ota_poll();

	/* Steady-state loop -- this is the production shape.  On HiL
     * the heartbeat publishes every HEARTBEAT_INTERVAL_S; the
     * OTA poll fires every MENDER_POLL_INTERVAL_S.  Under
     * native_sim the loop exits after one iteration so the
     * Twister harness sees a clean "done". */
	uint32_t ota_countdown_s = MENDER_POLL_INTERVAL_S;
	for (;;) {
		stage_remote_attestation_tick();
		if (ota_countdown_s <= HEARTBEAT_INTERVAL_S) {
			stage_ota_poll();
			ota_countdown_s = MENDER_POLL_INTERVAL_S;
		} else {
			ota_countdown_s -= HEARTBEAT_INTERVAL_S;
		}
#ifdef CONFIG_BOARD_NATIVE_SIM
		break; /* one iteration is enough for the framing test */
#else
		alp_delay_ms(HEARTBEAT_INTERVAL_S * 1000u);
#endif
	}

	printf("[prod] done\n");
	return 0;
}
```
