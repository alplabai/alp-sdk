## examples/multicore/microros-ros2-v2n/m33_sm/testcase.yaml
```yaml
# SPDX-License-Identifier: Apache-2.0
#
# Sits next to m33_sm/CMakeLists.txt for the same reason rpmsg-v2n's does:
# only this subtree is a self-contained Zephyr app twister can build.

sample:
  name: microros-ros2-v2n-m33_sm
  description: |
    micro-ROS node on the RZ/V2N Cortex-M33 publishing std_msgs/Int32 over
    a custom Micro XRCE-DDS transport backed by the ADR 0016 RPMsg
    endpoint (docs/adr/0035-micro-ros-cross-core-transport.md, Option B).
    build_only against the real board: like ../rpmsg-v2n/m33_sm it needs
    the V2N devicetree, the Renesas MHU/FSP driver and open-amp/libmetal,
    and additionally micro_ros_zephyr_module, whose colcon cross-build
    needs network access and a ROS 2 build toolchain at configure time.
    No native_sim variant: the value of this example is the RPMsg link.

tests:
  alp_sdk.examples.microros_ros2_v2n.m33_sm:
    extra_args: EXTRA_CONF_FILE=generated/alp.conf
    platform_allow:
      - alp_e1m_v2n101_m33_sm/r9a09g056n48gbg/cm33
    tags:
      - alp-sdk
      - example
      - multiprocessor
      - yocto
      - heterogeneous
      - rpmsg
      - micro-ros
      - v2n
    build_only: true
```

## examples/peripheral-io/blink/testcase.yaml
```yaml
# SPDX-License-Identifier: Apache-2.0

sample:
  name: blink
  description: |
    The canonical first Alp SDK program: toggle the RGB-red LED pad
    (the PWM3/PWM5 pad claimed as plain digital GPIO) via the
    portable BOARD_PIN_LED_RED alias.  Builds on both EVKs: E1M EVK
    uses ALP_E1M_GPIO_PWM3; E1M-X EVK uses ALP_E1M_X_GPIO_PWM5.

tests:
  alp_sdk.example.blink.e1m_x_evk:
    platform_allow:
      - native_sim
      - native_sim/native/64
    integration_platforms:
      - native_sim/native/64
    extra_configs:
      - 'CONFIG_COMPILER_OPT="-DALP_BOARD_E1M_X_EVK"'
    tags:
      - alp-sdk
      - example
      - gpio
      - v2n
    harness: console
    harness_config:
        type: one_line
        regex:
          - "\\[blink\\] done"
  alp_sdk.example.blink.e1m_evk:
    platform_allow:
      - native_sim
      - native_sim/native/64
    integration_platforms:
      - native_sim/native/64
    extra_configs:
      - 'CONFIG_COMPILER_OPT="-DALP_BOARD_E1M_EVK"'
    tags:
      - alp-sdk
      - example
      - gpio
      - aen
    harness: console
    harness_config:
        type: one_line
        regex:
          - "\\[blink\\] done"
```

## examples/v2n/v2n-alp-rpc-responder/testcase.yaml
```yaml
# SPDX-License-Identifier: Apache-2.0

sample:
  name: v2n-alp-rpc-responder
  description: |
    <alp/rpc.h> responder on the V2N / V2M Cortex-M33 system manager: opens
    the channel, subscribes to "echo" and sends every request straight back.
    The Linux A55 attaches through src/backends/rpc/yocto_uio_drv.c; the
    transport is the ipc_service backend in zephyr/drivers/ipc.  Build-only:
    the attach/echo round trip is a V2M/V2N bench check.

tests:
  alp_sdk.examples.v2n.alp_rpc_responder:
    extra_args: EXTRA_CONF_FILE=generated/alp.conf
    platform_allow:
      - alp_e1m_v2n101_m33_sm/r9a09g056n48gbg/cm33
      - alp_e1m_v2m101_m33_sm/r9a09g056n48gbg/cm33
    tags:
      - alp-sdk
      - example
      - v2n
      - rpc
      - rpmsg
    build_only: true
```

## examples/v2n/v2n-cm33-deepx-rail/testcase.yaml
```yaml
# SPDX-License-Identifier: Apache-2.0

sample:
  name: v2n-cm33-deepx-rail
  description: |
    CM33-boot-mode DEEPX 0.75 V core-rail sequencer.  Calls the portable
    da9292_ch2_sequence() chip driver directly over BRD_I2C/RIIC8, which
    this app's own board overlay re-enables (the default AMP board
    config -- CA55 cold boot -- leaves it disabled; see board.yaml).
    build_only: native_sim has no RZ/V2N RIIC8 or the app's board
    overlay, same as every other V2N CM33 example -- this checks the
    app compiles + links, not that it runs.

tests:
  alp_sdk.examples.v2n.cm33_deepx_rail.native_sim:
    platform_allow:
      - native_sim/native/64
    tags:
      - alp-sdk
      - example
      - v2n
      - power
      - deepx
      - cm33-boot
    build_only: true
```
