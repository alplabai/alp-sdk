## CMakeLists.txt
```
# SPDX-License-Identifier: Apache-2.0
#
# CMakeLists.txt for the lvgl-widgets-demo example.  Invokes the
# SDK's project loader at configure time so the generated alp.conf
# overlays prj.conf.
cmake_minimum_required(VERSION 3.20.0)

# Run the SDK project loader BEFORE find_package(Zephyr ...) so the
# generated overlay is in OVERLAY_CONFIG when Zephyr starts parsing
# Kconfig.  See examples/i2c-scanner/CMakeLists.txt for the canonical
# pattern this example follows.
#
# PYTHON_EXECUTABLE is only set after find_package(Zephyr); we need a
# Python interpreter at configure time *before* that, so resolve one
# ourselves here.
find_package(Python3 REQUIRED COMPONENTS Interpreter)

execute_process(
    COMMAND ${Python3_EXECUTABLE}
            ${CMAKE_CURRENT_SOURCE_DIR}/../../scripts/alp_project.py
            --input  ${CMAKE_CURRENT_SOURCE_DIR}/board.yaml
            --output ${CMAKE_CURRENT_BINARY_DIR}/alp.conf
            --emit zephyr-conf
    RESULT_VARIABLE rc
)
if(NOT rc EQUAL 0)
    message(FATAL_ERROR "alp_project.py failed (rc=${rc})")
endif()
set(OVERLAY_CONFIG ${CMAKE_CURRENT_BINARY_DIR}/alp.conf)

find_package(Zephyr REQUIRED HINTS $ENV{ZEPHYR_BASE})
project(lvgl_widgets_demo LANGUAGES C)

# The Zephyr lvgl module compiles only the core lvgl/src/ tree; the
# `demos/widgets/` showcase ships in lvgl but isn't auto-linked.
# Pull its sources in here so the prj.conf knob actually wires
# something into the binary.
set(LVGL_DIR ${ZEPHYR_LVGL_MODULE_DIR})
file(GLOB LV_WIDGETS_SRC
    ${LVGL_DIR}/demos/lv_demos.c
    ${LVGL_DIR}/demos/widgets/*.c
    ${LVGL_DIR}/demos/widgets/assets/*.c
)
target_sources(app PRIVATE src/main.c ${LV_WIDGETS_SRC})
target_include_directories(app PRIVATE ${LVGL_DIR}/demos ${LVGL_DIR}/demos/widgets)
```

## prj.conf
```kconfig
# SPDX-License-Identifier: Apache-2.0
#
# Per-app overlay.  The loader-generated alp.conf carries the
# baseline (CONFIG_ALP_SDK=y, CONFIG_LVGL=y, the ST7789 driver
# gate, GPU2D/DMA2D backend choice).  Everything below is demo-
# specific: pull in the lv_demo_widgets() upstream entrypoint and
# set the display geometry LVGL expects.

CONFIG_MAIN_STACK_SIZE=8192
CONFIG_HEAP_MEM_POOL_SIZE=131072

# LVGL upstream demo entrypoint -- lives under demos/widgets/
# in the LVGL tree.  Zephyr's lvgl module sources it in when
# this Kconfig is set.
CONFIG_LV_USE_DEMO_WIDGETS=y

# LVGL display geometry must match the wired ST7789 panel.  240x320
# is the typical TFT geometry; the 240x240 round variant works too,
# customers swap the macro to suit.
CONFIG_LV_Z_VDB_SIZE=50
CONFIG_LV_COLOR_DEPTH_16=y

# Render thread + frame-rate cap.
CONFIG_LV_DISP_DEF_REFR_PERIOD=33     # 30 fps target
CONFIG_LV_INDEV_DEF_READ_PERIOD=33

# Console + log for the smoke message.
CONFIG_LOG=y
CONFIG_LOG_PRINTK=y
```

## src/main.c
```c
/*
 * Copyright 2026 ALP Lab AB
 * SPDX-License-Identifier: Apache-2.0
 *
 * lvgl-widgets-demo
 * =================
 *
 * Wraps the upstream `lv_demo_widgets()` from LVGL's demos/ tree.
 * Walks through every standard LVGL widget (buttons, sliders,
 * tabs, charts, meters, lists, ...) on a 240 x 320 ST7789 TFT
 * attached to the E1M-EVK SPI0 + a pair of GPIOs (D/C# + reset).
 *
 * This is a teaching artefact: ~50% of the file is comment
 * explaining the data flow + the SDK rules in play.  Customers
 * copy this directory + the matching board.yaml as a starting
 * point for their own LVGL apps.
 *
 *
 * ── Why this layout? ───────────────────────────────────────────
 *
 *   1. `board.yaml` is the only file that names hardware.  It
 *      lists `chips: [st7789]` so the SDK's project loader pulls
 *      in chips/st7789/st7789.c, and `libraries: [lvgl]` so
 *      Zephyr's LVGL module gets enabled with the right include
 *      path + compile-time config.
 *
 *   2. `src/main.c` (this file) talks to the panel ONLY through
 *      the portable surfaces:
 *        - <alp/peripheral.h>  for SPI / GPIO open
 *        - <alp/chips/st7789.h> for the chip-specific init
 *        - <alp/gui.h>         (optional) for the LVGL bind glue
 *      No `gd32g553_*` / `alif_*` / `renesas_*` symbols appear
 *      anywhere -- per the SDK's "Portable peripheral surfaces
 *      only in app + library code" rule.  Board-specific
 *      backends live inside the SDK; this file stays board-
 *      portable.
 *
 *   3. Zephyr's `lvgl` module handles the display-driver registration
 *      automatically once CONFIG_LVGL + the right display alias are
 *      set in the devicetree overlay.  We just call lv_init() then
 *      hand off to the upstream demo.
 *
 *
 * ── Build matrix ───────────────────────────────────────────────
 *
 *   `west build -b ensemble_e8_dk/ae402fa0e5597le0/rtss_hp examples/lvgl-widgets-demo`
 *   `west build -b native_sim/native/64 examples/lvgl-widgets-demo`
 *
 *   native_sim runs the demo in a desktop window via SDL2 -- handy
 *   for UI iteration without touching hardware.
 */

#include <zephyr/kernel.h>
#include <zephyr/logging/log.h>
#include <zephyr/drivers/display.h>

#include <lvgl.h>

/* Upstream LVGL demo entrypoint -- pulled in by
 * CONFIG_LV_USE_DEMO_WIDGETS=y in prj.conf. */
#include <lv_demo_widgets.h>

LOG_MODULE_REGISTER(lvgl_widgets_demo, LOG_LEVEL_INF);

int main(void)
{
    LOG_INF("LVGL widgets demo starting");

    /* Zephyr's display subsystem is the bedrock LVGL renders into.
     * The DEVICE_DT_GET path resolves whichever node devicetree
     * marks as the default display -- on the E1M-EVK that's the
     * ST7789 we declared in board.yaml's `chips:`. */
    const struct device *display = DEVICE_DT_GET(DT_CHOSEN(zephyr_display));
    if (!device_is_ready(display)) {
        LOG_ERR("display %s not ready", display->name);
        return 1;
    }

    /* LVGL initialisation: allocate the framebuffer + draw context,
     * register the Zephyr display driver as LVGL's render target.
     * Zephyr's lvgl module ties these into lv_init() automatically
     * when CONFIG_LVGL=y; this call sets the global state. */
    lv_init();

    /* Render the upstream demo.  lv_demo_widgets() creates a tab
     * view with five tabs (Profile, Analytics, Shop, ...), each
     * exercising a different widget family.  Returns immediately;
     * subsequent UI updates are driven by lv_task_handler() below. */
    lv_demo_widgets();

    /* Turn the backlight on (board-specific GPIO; the Zephyr
     * display driver handles it via the `backlight-gpios` property
     * in the devicetree overlay if one is declared).  The display
     * starts off blank either way until LVGL renders the first
     * frame on the next handler tick. */
    display_blanking_off(display);

    /* Main loop: tick LVGL at the configured refresh rate.  Zephyr
     * gives us a real RTOS so we can sleep precisely between ticks
     * instead of busy-waiting.  The 10 ms slice keeps animations
     * smooth at 30 fps with headroom for input handlers. */
    while (1) {
        const uint32_t sleep_ms = lv_task_handler();
        k_msleep(MIN(sleep_ms, 10u));
    }

    return 0; /* unreachable. */
}
```
