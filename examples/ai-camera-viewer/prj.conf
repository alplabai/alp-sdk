## CMakeLists.txt
```
# SPDX-License-Identifier: Apache-2.0
cmake_minimum_required(VERSION 3.20.0)

# PYTHON_EXECUTABLE is only set after find_package(Zephyr);
# we need a Python interpreter at configure time *before*
# that, so resolve one ourselves here.
find_package(Python3 REQUIRED COMPONENTS Interpreter)

execute_process(
    COMMAND ${Python3_EXECUTABLE}
            ${CMAKE_CURRENT_SOURCE_DIR}/../../scripts/alp_project.py
            --input  ${CMAKE_CURRENT_SOURCE_DIR}/board.yaml
            --output ${CMAKE_CURRENT_BINARY_DIR}/alp.conf
            --emit zephyr-conf
    RESULT_VARIABLE rc
)
if(NOT rc EQUAL 0)
    message(FATAL_ERROR "alp_project.py failed (rc=${rc})")
endif()
set(OVERLAY_CONFIG ${CMAKE_CURRENT_BINARY_DIR}/alp.conf)

find_package(Zephyr REQUIRED HINTS $ENV{ZEPHYR_BASE})
project(ai_camera_viewer LANGUAGES C)

target_sources(app PRIVATE
    src/main.c
    src/viewer_ui.c
    src/inference_loop.c
)
```

## prj.conf
```kconfig
# SPDX-License-Identifier: Apache-2.0
CONFIG_MAIN_STACK_SIZE=16384
# Heap sized for camera frame + tensor arena.
CONFIG_HEAP_MEM_POOL_SIZE=524288

CONFIG_LV_Z_VDB_SIZE=50
CONFIG_LV_COLOR_DEPTH_16=y
CONFIG_LV_DEF_REFR_PERIOD=33

CONFIG_LOG=y
CONFIG_LOG_PRINTK=y

# Inference subsystem.
CONFIG_ALP_SDK_INFERENCE_TFLM=y

# Display driver: native_sim has no real panel; the dummy
# display lets the demo link without an SDL/X11 dep.
CONFIG_DISPLAY=y
CONFIG_DUMMY_DISPLAY=y
```

## src/main.c
```c
/*
 * Copyright 2026 ALP Lab AB
 * SPDX-License-Identifier: Apache-2.0
 *
 * ai-camera-viewer
 * ================
 *
 * Headline edge-AI demo on the E1M-AEN family.
 *
 *   ┌──────────────────┐                ┌──────────────────────┐
 *   │  E1M-AEN701 SoM  │  MIPI / DVP    │ OmniVision OV5640    │
 *   │ + Cortex-M55 HP  │ ◀──── frames ──│ camera (RGB565 / VGA)│
 *   └────────┬─────────┘                └──────────────────────┘
 *            │   <alp/camera.h> hands the frame to the inference
 *            │   pipeline:
 *            ▼
 *      ┌──────────────────────┐
 *      │ TFLM + Ethos-U55      │  ── person_detect.tflite
 *      │ (CONFIG_ALP_TFLM_     │     compiled with Vela for
 *      │  ETHOS_U55=y on E7)   │     ethos-u55-256.
 *      └─────────┬─────────────┘
 *                │  ── bounding-box list + per-class score
 *                ▼
 *           ┌──────────┐
 *           │  LVGL    │  draws the latest preview frame on the
 *           │  UI      │  ST7789 + overlays the boxes + a stats
 *           └──────────┘  strip (latency + class confidence).
 *
 *
 * ── Why this demo matters for customers ───────────────────────
 *
 * Three customer questions get answered side-by-side:
 *   1. "Can I run real inference on the AEN's on-die NPU?"  --
 *      yes, the dispatch path is alp_inference_open(..., backend
 *      = ALP_INFERENCE_BACKEND_ETHOS_U).  The §D.lib.loader picks
 *      the U85 vs U55 vs U65 driver shim from the SKU's
 *      `capabilities:` block, no app-source changes.
 *   2. "How fast?"  --  the per-frame latency strip prints the
 *      microseconds from `alp_inference_invoke()` entry to exit.
 *      Customers compare AEN701 (U55) vs AEN801 (U85) by
 *      flipping `som.sku` in `board.yaml`.
 *   3. "Does it run portably?"  --  the app source uses zero
 *      vendor-specific symbols; the SoC-family routing is in the
 *      loader, not the source.  Re-targeting from AEN to NX9101
 *      (Ethos-U65) is a one-line board.yaml change.
 *
 *
 * ── What's stubbed in v0.5 ─────────────────────────────────────
 *
 * - The actual `person_detect.tflite` model isn't checked in --
 *   customers drop their own Vela-compiled .tflite into
 *   `models/` and the loader picks it up via the include mount.
 * - The camera capture path falls back to NOSUPPORT on
 *   native_sim (no real OV5640 connected), and the UI shows a
 *   solid-colour placeholder + the inference latency for the
 *   built-in dummy bytes.
 * - Real bounding-box decode is paper-correct -- v0.6 AEN HiL
 *   fills in the post-process kernel that turns the model output
 *   tensor into a `viewer_box_t[]` array.
 */

#include <zephyr/kernel.h>
#include <zephyr/logging/log.h>
#include <zephyr/drivers/display.h>

#include <lvgl.h>

#include "alp/peripheral.h"
#include "alp/e1m_pinout.h"
#include "alp/camera.h"
#include "alp/inference.h"
#include "alp/chips/ov5640.h"

#include "viewer_ui.h"
#include "inference_loop.h"

LOG_MODULE_REGISTER(ai_camera_viewer, LOG_LEVEL_INF);

static viewer_state_t  g_state;

K_THREAD_STACK_DEFINE(infer_stack, 8192);
static struct k_thread infer_thread;

static void infer_entry(void *p1, void *p2, void *p3)
{
    ARG_UNUSED(p1); ARG_UNUSED(p2); ARG_UNUSED(p3);
    inference_loop_run(&g_state);
}

int main(void)
{
    LOG_INF("ai-camera-viewer demo starting");

    /* The camera SCCB + capture path are bring-up duties for the
     * inference loop -- this thread owns the chip handle so it
     * can re-init on failure.  Pass our shared state pointer in
     * via the thread arg slot (NULL above; the loop fetches it
     * from main's stack via g_state directly). */

    /* Display + LVGL bring-up. */
    const struct device *display = DEVICE_DT_GET(DT_CHOSEN(zephyr_display));
    if (!device_is_ready(display)) {
        LOG_ERR("display %s not ready", display->name);
        return 1;
    }
    lv_init();
    viewer_ui_build();
    display_blanking_off(display);

    /* Spawn the inference thread.  Higher priority than main so
     * the model gets timely CPU even when LVGL is mid-blit. */
    k_thread_create(&infer_thread, infer_stack, K_THREAD_STACK_SIZEOF(infer_stack),
                    infer_entry, NULL, NULL, NULL,
                    K_PRIO_PREEMPT(3), 0, K_NO_WAIT);
    k_thread_name_set(&infer_thread, "infer_loop");

    /* Render loop: 30 fps, sample the shared state once per
     * frame to avoid tearing the bounding-box overlay mid-update. */
    while (1) {
        viewer_state_t snap = g_state;
        viewer_ui_apply(&snap);

        const uint32_t sleep_ms = lv_task_handler();
        k_msleep(MIN(sleep_ms, 10u));
    }

    return 0;
}
```

## src/inference_loop.c
```c
/*
 * Copyright 2026 ALP Lab AB
 * SPDX-License-Identifier: Apache-2.0
 *
 * Capture -> infer -> decode loop.
 *
 *   1. Open the camera at startup; on failure tolerate it and
 *      run with a synthetic frame so the UI still renders.
 *   2. Open the inference backend (ALP_INFERENCE_BACKEND_AUTO --
 *      let the dispatcher pick the on-chip NPU on AEN / V2N /
 *      NX9101, or fall back to CPU on native_sim).
 *   3. Per loop iteration:
 *        - alp_camera_capture(...) returns a frame.
 *        - alp_inference_invoke(...) runs the model.
 *        - decode_boxes(...) turns the output tensor into a
 *          viewer_box_t array.
 *        - publish via the shared viewer_state_t snapshot.
 *
 * The model itself isn't checked in -- this example expects a
 * Vela-compiled `person_detect.tflite` at models/.  Customers
 * drop their own model + edit the input pre-processing as
 * needed.
 */

#include <zephyr/kernel.h>
#include <zephyr/logging/log.h>
#include <string.h>

#include "alp/peripheral.h"
#include "alp/e1m_pinout.h"
#include "alp/camera.h"
#include "alp/inference.h"
#include "alp/chips/ov5640.h"

#include "inference_loop.h"

LOG_MODULE_REGISTER(infer_loop, LOG_LEVEL_INF);

/* Placeholder Vela-compiled model bytes.  Real customers replace
 * this with #include "models/person_detect_vela.h" generated by
 * the upstream Vela compiler. */
static const uint8_t s_model[] = {0x00};

/* Tensor arena -- the buffer TFLM uses for intermediate
 * activations.  Sized to match `default_arena_kib` in
 * board.yaml's `inference:` block. */
static uint8_t s_arena[256 * 1024] __aligned(16);

/* Captured camera frame -- 240×240 RGB565 == 115200 bytes.  Real
 * pipelines reuse a pool of frames; this single-buffer demo is
 * the simplest customer-facing baseline. */
static uint8_t s_frame[240 * 240 * 2] __aligned(16);

void inference_loop_run(viewer_state_t *state)
{
    memset(state, 0, sizeof(*state));

    /* Camera setup.  Open <alp/camera.h>, ask for VGA-ish frames.
     * On native_sim the open returns NOSUPPORT; the loop carries
     * on with the placeholder frame data and the UI shows that
     * the camera is offline. */
    alp_camera_t *cam = alp_camera_open(&(alp_camera_config_t){
        .camera_id = 0,
        .width     = 240,
        .height    = 240,
        .fps       = 30,
        .format    = ALP_PIXFMT_RGB565,
    });
    state->camera_ok = (cam != NULL);
    if (!state->camera_ok) {
        LOG_WRN("camera open failed; running with synthetic frame");
    } else {
        /* TODO(v0.6): inspect alp_camera_start() return -- v0.5
         * tolerates NOSUPPORT silently so native_sim still runs. */
        (void)alp_camera_start(cam);
    }

    /* Inference setup.  AUTO routes to the best available backend
     * for the active SoM (ETHOS_U55 on AEN701, ETHOS_U85 on
     * AEN401 / AEN601 / AEN801, U65 on NX9101, DRPAI on V2N,
     * CPU on native_sim). */
    alp_inference_t *inf = alp_inference_open(&(alp_inference_config_t){
        .backend     = ALP_INFERENCE_BACKEND_AUTO,
        .format      = ALP_INFERENCE_MODEL_VELA,
        .model_data  = s_model,
        .model_size  = sizeof(s_model),
        .arena       = s_arena,
        .arena_bytes = sizeof(s_arena),
    });
    state->inference_ok = (inf != NULL);
    if (!state->inference_ok) {
        LOG_WRN("inference open failed; UI will render zero boxes");
    }

    uint32_t frames_in_window = 0;
    uint32_t window_start_ms  = k_uptime_get_32();

    while (1) {
        /* Capture.  Backend owns the frame buffer; we copy out and
         * release immediately so the next capture can reuse it. */
        if (state->camera_ok) {
            alp_camera_frame_t frame = {0};
            if (alp_camera_capture(cam, &frame, /*timeout_ms=*/100) == ALP_OK) {
                size_t n = frame.size < sizeof(s_frame) ? frame.size : sizeof(s_frame);
                if (frame.data) {
                    memcpy(s_frame, frame.data, n);
                }
                (void)alp_camera_release(cam, &frame);
            }
        }

        /* Invoke. */
        uint32_t t0_us = k_cycle_get_32();
        if (state->inference_ok) {
            /* TODO(v0.6): copy s_frame into the model's input tensor
             * via alp_inference_get_input(), then invoke.  v0.5 just
             * times the empty invoke so the UI shows the latency floor. */
            (void)alp_inference_invoke(inf);
        }
        uint32_t t1_us = k_cycle_get_32();
        state->last_invoke_us = k_cyc_to_us_floor32(t1_us - t0_us);

        /* Decode bounding boxes.  v0.5 emits a synthetic box so
         * the UI renders one rectangle; v0.6 wires the real
         * post-process. */
        state->n_boxes = 1;
        state->boxes[0] = (viewer_box_t){
            .x = 60, .y = 60, .w = 120, .h = 120,
            .class_id = 0, .score = 0.92f,
        };

        /* FPS estimate over a rolling 1 s window. */
        frames_in_window++;
        uint32_t now_ms = k_uptime_get_32();
        if (now_ms - window_start_ms >= 1000) {
            state->fps_x10 = (frames_in_window * 10);
            frames_in_window = 0;
            window_start_ms = now_ms;
        }

        /* No explicit sleep -- the inference invoke + render loop
         * is the pacing.  If the model runs faster than the
         * display can render, LVGL's render thread naturally
         * limits the frame rate. */
        k_yield();
    }
}
```

## src/inference_loop.h
```c
/*
 * Copyright 2026 ALP Lab AB
 * SPDX-License-Identifier: Apache-2.0
 */

#ifndef AI_CAMERA_VIEWER_INFERENCE_LOOP_H
#define AI_CAMERA_VIEWER_INFERENCE_LOOP_H

#include "viewer_ui.h"

#ifdef __cplusplus
extern "C" {
#endif

/** Inference thread entrypoint.  Owns the camera + inference
 *  handles, captures one frame per cycle, runs the model,
 *  decodes the output tensor, and updates the shared state. */
void inference_loop_run(viewer_state_t *state);

#ifdef __cplusplus
} /* extern "C" */
#endif

#endif /* AI_CAMERA_VIEWER_INFERENCE_LOOP_H */
```
