## examples/peripheral-io/spi-loopback/testcase.yaml
```yaml
# SPDX-License-Identifier: Apache-2.0

sample:
  name: spi-loopback
  description: |
    Per-peripheral example for SPI.  Open / transceive / close on
    BOARD_SPI_ARDUINO with no CS GPIO.  Builds on both EVKs:
    E1M EVK uses E1M_SPI1; E1M-X EVK uses E1M_X_SPI1.

tests:
  alp_sdk.example.spi_loopback.e1m_x_evk:
    platform_allow:
      - native_sim
      - native_sim/native/64
    integration_platforms:
      - native_sim/native/64
    extra_configs:
      - 'CONFIG_COMPILER_OPT="-DALP_BOARD_E1M_X_EVK"'
    tags:
      - alp-sdk
      - example
      - spi
      - v2n
    harness: console
    harness_config:
        type: one_line
        regex:
          - "\\[spi\\] done"
  alp_sdk.example.spi_loopback.e1m_evk:
    platform_allow:
      - native_sim
      - native_sim/native/64
    integration_platforms:
      - native_sim/native/64
    extra_configs:
      - 'CONFIG_COMPILER_OPT="-DALP_BOARD_E1M_EVK"'
    tags:
      - alp-sdk
      - example
      - spi
      - aen
    harness: console
    harness_config:
        type: one_line
        regex:
          - "\\[spi\\] done"
```

## examples/peripheral-io/spi-master/boards/native_sim_native_64.conf
```kconfig
# SPDX-License-Identifier: Apache-2.0
#
# native_sim has no real SPI controller; pull in the emul SPI
# driver so the bus enumerates at boot.  Auto-loaded by Zephyr
# when building for native_sim/native/64.

CONFIG_EMUL=y
CONFIG_SPI_EMUL=y
```

## examples/peripheral-io/spi-master/testcase.yaml
```yaml
# SPDX-License-Identifier: Apache-2.0

sample:
  name: spi-master
  description: |
    Per-peripheral example for SPI master.  Send a known byte pattern
    via write / transceive / read on BOARD_SPI_ARDUINO.  Builds on both
    EVKs: E1M EVK uses E1M_SPI1; E1M-X EVK uses E1M_X_SPI1.
    Contrasts with examples/peripheral-io/spi-loopback (which exercises both
    ends on the same chip).

tests:
  alp_sdk.example.spi_master.e1m_x_evk:
    platform_allow:
      - native_sim
      - native_sim/native/64
    integration_platforms:
      - native_sim/native/64
    extra_configs:
      - 'CONFIG_COMPILER_OPT="-DALP_BOARD_E1M_X_EVK"'
    tags:
      - alp-sdk
      - example
      - spi
      - v2n
    harness: console
    harness_config:
        type: one_line
        regex:
          - "\\[spi-master\\] done"
  alp_sdk.example.spi_master.e1m_evk:
    platform_allow:
      - native_sim
      - native_sim/native/64
    integration_platforms:
      - native_sim/native/64
    extra_configs:
      - 'CONFIG_COMPILER_OPT="-DALP_BOARD_E1M_EVK"'
    tags:
      - alp-sdk
      - example
      - spi
      - aen
    harness: console
    harness_config:
        type: one_line
        regex:
          - "\\[spi-master\\] done"
```

## examples/peripheral-io/spi-slave/testcase.yaml
```yaml
# SPDX-License-Identifier: Apache-2.0

sample:
  name: spi-slave
  description: |
    Per-peripheral example for SPI target (slave) mode via
    alp_spi_target_open: transfer-based request/response protocol
    (preload reply, bounded wait on the controller's clock).  On
    native_sim BOARD_SPI_ARDUINO is not wired (only the alp-spi0
    loader alias exists), so the open degrades cleanly with the
    NOT_READY diagnostic.  Builds on both EVKs: BOARD_SPI_ARDUINO
    resolves to ALP_E1M_SPI1 on E1M EVK and ALP_E1M_X_SPI1 on
    E1M-X EVK.

tests:
  alp_sdk.example.spi_slave.e1m_x_evk:
    platform_allow:
      - native_sim
      - native_sim/native/64
    integration_platforms:
      - native_sim/native/64
    extra_configs:
      - 'CONFIG_COMPILER_OPT="-DALP_BOARD_E1M_X_EVK"'
    tags:
      - alp-sdk
      - example
      - spi
      - v2n
    harness: console
    harness_config:
        type: one_line
        regex:
          - "\\[spi-slave\\] done"
  alp_sdk.example.spi_slave.e1m_evk:
    platform_allow:
      - native_sim
      - native_sim/native/64
    integration_platforms:
      - native_sim/native/64
    extra_configs:
      - 'CONFIG_COMPILER_OPT="-DALP_BOARD_E1M_EVK"'
    tags:
      - alp-sdk
      - example
      - spi
      - aen
    harness: console
    harness_config:
        type: one_line
        regex:
          - "\\[spi-slave\\] done"
```

## examples/peripheral-io/uart-rx-ringbuf/testcase.yaml
```yaml
# SPDX-License-Identifier: Apache-2.0

sample:
  name: uart-rx-ringbuf
  description: |
    Per-feature example for <alp/peripheral.h>'s opt-in
    interrupt-driven RX ring buffer (CONFIG_ALP_SDK_UART_RX_RINGBUF).
    Attaches an LwRB-backed ring to BOARD_UART_DEBUG, polls the
    drain count + pops batched bytes, then detaches.  Builds on
    both EVKs: E1M EVK uses E1M_UART0; E1M-X EVK uses E1M_X_UART0.

tests:
  alp_sdk.example.uart_rx_ringbuf.e1m_x_evk:
    platform_allow:
      - native_sim
      - native_sim/native/64
    integration_platforms:
      - native_sim/native/64
    extra_configs:
      - 'CONFIG_COMPILER_OPT="-DALP_BOARD_E1M_X_EVK"'
    tags:
      - alp-sdk
      - example
      - uart
      - lwrb
      - v2n
    harness: console
    harness_config:
        type: one_line
        regex:
          - "\\[ringbuf\\] done"
  alp_sdk.example.uart_rx_ringbuf.e1m_evk:
    platform_allow:
      - native_sim
      - native_sim/native/64
    integration_platforms:
      - native_sim/native/64
    extra_configs:
      - 'CONFIG_COMPILER_OPT="-DALP_BOARD_E1M_EVK"'
    tags:
      - alp-sdk
      - example
      - uart
      - lwrb
      - aen
    harness: console
    harness_config:
        type: one_line
        regex:
          - "\\[ringbuf\\] done"
```

## examples/peripheral-io/vendor-ext-composability/testcase.yaml
```yaml
# SPDX-License-Identifier: Apache-2.0

sample:
  name: vendor-ext-composability
  description: |
    Proves the <alp/ext/<vendor>> layer is additive: one pad
    (E1M_ADC1) is exercised as a plain GPIO, as the portable
    <alp/adc.h> peripheral, and with an Alif vendor extension on
    the same handle.  native_sim runs Way 1 (GPIO) and gracefully
    skips the ADC-controller-dependent Ways 2/3.

tests:
  alp_sdk.example.vendor_ext_composability:
    platform_allow:
      - native_sim
      - native_sim/native/64
    integration_platforms:
      - native_sim/native/64
    tags:
      - alp-sdk
      - example
      - vendor-ext
      - composability
    harness: console
    harness_config:
        type: one_line
        regex:
          - "\\[flex\\] done"
```

## examples/power-timing/counter-alarm/testcase.yaml
```yaml
# SPDX-License-Identifier: Apache-2.0

sample:
  name: counter-alarm
  description: |
    Per-peripheral example for <alp/counter.h>.  Schedules a
    one-shot alarm 100 ms in the future.  Builds for both E1M EVK
    and E1M-X EVK: no board-specific pins are used (board-agnostic).

tests:
  alp_sdk.example.counter_alarm.e1m_evk:
    extra_configs:
      - 'CONFIG_COMPILER_OPT="-DALP_BOARD_E1M_EVK"'
    platform_allow:
      - native_sim
      - native_sim/native/64
    integration_platforms:
      - native_sim/native/64
    tags:
      - alp-sdk
      - example
      - counter
      - aen
    harness: console
    harness_config:
        type: one_line
        regex:
          - "\\[counter\\] done"

  alp_sdk.example.counter_alarm.e1m_x_evk:
    extra_configs:
      - 'CONFIG_COMPILER_OPT="-DALP_BOARD_E1M_X_EVK"'
    platform_allow:
      - native_sim
      - native_sim/native/64
    integration_platforms:
      - native_sim/native/64
    tags:
      - alp-sdk
      - example
      - counter
      - v2n
    harness: console
    harness_config:
        type: one_line
        regex:
          - "\\[counter\\] done"
```

## examples/power-timing/littlefs-keyvalue/testcase.yaml
```yaml
# SPDX-License-Identifier: Apache-2.0

sample:
  name: littlefs-keyvalue
  description: |
    Mounts a RAM-backed littlefs partition (native_sim's
    `zephyr,sim-flash` storage_partition), writes a key/value pair to
    a file, reads it back, lists the mount-point directory, and
    asserts the read matches the write.  Teaches the Zephyr fs
    subsystem's fs_mount/fs_open/fs_read/fs_write/fs_readdir API.

tests:
  alp_sdk.example.littlefs_keyvalue.e1m_x_evk:
    platform_allow:
      - native_sim
      - native_sim/native/64
    integration_platforms:
      - native_sim/native/64
    extra_configs:
      - 'CONFIG_COMPILER_OPT="-DALP_BOARD_E1M_X_EVK"'
    tags:
      - alp-sdk
      - example
      - littlefs-keyvalue
      - v2n
    harness: console
    harness_config:
        type: one_line
        regex:
          - "\\[littlefs-keyvalue\\] done"
  alp_sdk.example.littlefs_keyvalue.e1m_evk:
    platform_allow:
      - native_sim
      - native_sim/native/64
    integration_platforms:
      - native_sim/native/64
    extra_configs:
      - 'CONFIG_COMPILER_OPT="-DALP_BOARD_E1M_EVK"'
    tags:
      - alp-sdk
      - example
      - littlefs-keyvalue
      - aen
    harness: console
    harness_config:
        type: one_line
        regex:
          - "\\[littlefs-keyvalue\\] done"
```

## examples/power-timing/power-managed-sensor/testcase.yaml
```yaml
# SPDX-License-Identifier: Apache-2.0

sample:
  name: power-managed-sensor
  description: |
    Reference for the v0.6 `cores.<id>.power:` declarative block on
    the AEN301 M55-HE core: sleep_mode plus the rtc / gpio_int /
    uart wakeup_sources set.  Framing demo -- it narrates the duty
    cycle via printf and does not drive a sensor or enter a real
    sleep state.

tests:
  alp_sdk.example.power_managed_sensor:
    platform_allow:
      - native_sim
      - native_sim/native/64
    integration_platforms:
      - native_sim/native/64
    tags:
      - alp-sdk
      - example
      - power
      - sensor
    harness: console
    harness_config:
      type: one_line
      regex:
        - "\\[pm\\] done"
```

## examples/power-timing/rtc-clock/testcase.yaml
```yaml
# SPDX-License-Identifier: Apache-2.0

sample:
  name: rtc-clock
  description: |
    Per-peripheral example for <alp/rtc.h>.  Demonstrates set/get
    round-trip with the human-readable alp_rtc_time_t struct.
    Builds for both E1M EVK and E1M-X EVK via the cross-EVK
    BOARD_* alias layer.

tests:
  alp_sdk.example.rtc_clock.e1m_evk:
    extra_configs:
      - 'CONFIG_COMPILER_OPT="-DALP_BOARD_E1M_EVK"'
    platform_allow:
      - native_sim
      - native_sim/native/64
    integration_platforms:
      - native_sim/native/64
    tags:
      - alp-sdk
      - example
      - rtc
      - aen
    harness: console
    harness_config:
        type: one_line
        regex:
          - "\\[rtc\\] done"

  alp_sdk.example.rtc_clock.e1m_x_evk:
    extra_configs:
      - 'CONFIG_COMPILER_OPT="-DALP_BOARD_E1M_X_EVK"'
    platform_allow:
      - native_sim
      - native_sim/native/64
    integration_platforms:
      - native_sim/native/64
    tags:
      - alp-sdk
      - example
      - rtc
      - v2n
    harness: console
    harness_config:
        type: one_line
        regex:
          - "\\[rtc\\] done"
```

## examples/power-timing/timer-periodic-interrupt/testcase.yaml
```yaml
# SPDX-License-Identifier: Apache-2.0

sample:
  name: timer-periodic-interrupt
  description: |
    Per-peripheral example for Counter (timer) + GPIO.  Schedules
    a re-arming alarm every 100 ms; ISR sets a flag, main thread
    drains the flag and toggles the user LED via BOARD_PIN_LED_RED.
    Demonstrates the recommended ISR-safety pattern (no printf from
    ISR -- defer via a flag).  Builds for both E1M EVK and E1M-X EVK.
    The counter-alarm ISR path works on AEN and native_sim; on V2N
    (E1M-X EVK) the GD32 IO MCU has no host IRQ line so set_alarm
    returns NOSUPPORT and the example exits with a diagnostic.

tests:
  alp_sdk.example.timer_periodic_interrupt.e1m_evk:
    extra_configs:
      - 'CONFIG_COMPILER_OPT="-DALP_BOARD_E1M_EVK"'
    platform_allow:
      - native_sim
      - native_sim/native/64
    integration_platforms:
      - native_sim/native/64
    tags:
      - alp-sdk
      - example
      - counter
      - gpio
      - aen
    harness: console
    harness_config:
        type: one_line
        regex:
          - "\\[timer\\] done"

  alp_sdk.example.timer_periodic_interrupt.e1m_x_evk:
    extra_configs:
      - 'CONFIG_COMPILER_OPT="-DALP_BOARD_E1M_X_EVK"'
    platform_allow:
      - native_sim
      - native_sim/native/64
    integration_platforms:
      - native_sim/native/64
    tags:
      - alp-sdk
      - example
      - counter
      - gpio
      - v2n
    harness: console
    harness_config:
        type: one_line
        regex:
          - "\\[timer\\] done"
```

## examples/power-timing/wdt-feed/testcase.yaml
```yaml
# SPDX-License-Identifier: Apache-2.0

sample:
  name: wdt-feed
  description: |
    Per-peripheral example for <alp/wdt.h>.  Installs a 5 second
    watchdog timeout and demonstrates the feed loop.  Builds for
    both E1M EVK and E1M-X EVK: no board-specific pins are used
    (board-agnostic).

tests:
  alp_sdk.example.wdt_feed.e1m_evk:
    extra_configs:
      - 'CONFIG_COMPILER_OPT="-DALP_BOARD_E1M_EVK"'
    platform_allow:
      - native_sim
      - native_sim/native/64
    integration_platforms:
      - native_sim/native/64
    tags:
      - alp-sdk
      - example
      - wdt
      - aen
    harness: console
    harness_config:
        type: one_line
        regex:
          - "\\[wdt\\] done"

  alp_sdk.example.wdt_feed.e1m_x_evk:
    extra_configs:
      - 'CONFIG_COMPILER_OPT="-DALP_BOARD_E1M_X_EVK"'
    platform_allow:
      - native_sim
      - native_sim/native/64
    integration_platforms:
      - native_sim/native/64
    tags:
      - alp-sdk
      - example
      - wdt
      - v2n
    harness: console
    harness_config:
        type: one_line
        regex:
          - "\\[wdt\\] done"
```
