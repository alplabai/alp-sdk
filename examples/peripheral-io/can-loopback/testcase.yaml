## examples/peripheral-io/can-loopback/testcase.yaml
```yaml
# SPDX-License-Identifier: Apache-2.0

sample:
  name: can-loopback
  description: |
    Per-peripheral example for <alp/can.h>.  Brings up BOARD_CAN0 in
    loopback mode, sends a frame, demonstrates the rx callback.
    Builds on both EVKs: E1M EVK uses E1M_CAN0 (TCAN1044A, header J9);
    E1M-X EVK uses E1M_X_CAN0 (TCAN1044 U51).

tests:
  alp_sdk.example.can_loopback.e1m_x_evk:
    platform_allow:
      - native_sim
      - native_sim/native/64
    integration_platforms:
      - native_sim/native/64
    extra_configs:
      - 'CONFIG_COMPILER_OPT="-DALP_BOARD_E1M_X_EVK"'
    tags:
      - alp-sdk
      - example
      - can
      - v2n
    harness: console
    harness_config:
        type: one_line
        regex:
          - "\\[can\\] done"
  alp_sdk.example.can_loopback.e1m_evk:
    platform_allow:
      - native_sim
      - native_sim/native/64
    integration_platforms:
      - native_sim/native/64
    extra_configs:
      - 'CONFIG_COMPILER_OPT="-DALP_BOARD_E1M_EVK"'
    tags:
      - alp-sdk
      - example
      - can
      - aen
    harness: console
    harness_config:
        type: one_line
        regex:
          - "\\[can\\] done"
```

## examples/peripheral-io/dac-waveform/testcase.yaml
```yaml
# SPDX-License-Identifier: Apache-2.0

sample:
  name: dac-waveform
  description: |
    Per-peripheral example for DAC.  Generates a sine wave on
    BOARD_DAC0.  Builds for both EVKs: E1M EVK uses the Alif
    Ensemble's native DAC; E1M-X EVK uses the V2N GD32-bridged
    output.  Walks a 32-point sine LUT at a configurable sample
    rate.  build_only on native_sim -- no DAC controller available.

tests:
  alp_sdk.example.dac_waveform.e1m_x_evk:
    platform_allow:
      - native_sim
      - native_sim/native/64
    integration_platforms:
      - native_sim/native/64
    extra_configs:
      - 'CONFIG_COMPILER_OPT="-DALP_BOARD_E1M_X_EVK"'
    tags:
      - alp-sdk
      - example
      - dac
      - v2n
    build_only: true
  alp_sdk.example.dac_waveform.e1m_evk:
    platform_allow:
      - native_sim
      - native_sim/native/64
    integration_platforms:
      - native_sim/native/64
    extra_configs:
      - 'CONFIG_COMPILER_OPT="-DALP_BOARD_E1M_EVK"'
    tags:
      - alp-sdk
      - example
      - dac
      - aen
    build_only: true
```

## examples/peripheral-io/etl-fixed-containers/testcase.yaml
```yaml
# SPDX-License-Identifier: Apache-2.0

sample:
  name: etl-fixed-containers
  description: |
    Builds an etl::vector<int, 8> and an etl::map<const char *, int, 4>
    -- the Embedded Template Library's fixed-capacity, no-heap
    STL-like containers. push_back/insert + lookup, printing size and
    a looked-up value, demonstrating ETL's compile-time-capacity /
    no-allocation property.

tests:
  alp_sdk.example.etl_fixed_containers.e1m_x_evk:
    platform_allow:
      - native_sim
      - native_sim/native/64
    integration_platforms:
      - native_sim/native/64
    extra_configs:
      - 'CONFIG_COMPILER_OPT="-DALP_BOARD_E1M_X_EVK"'
    tags:
      - alp-sdk
      - example
      - etl-fixed-containers
      - v2n
    harness: console
    harness_config:
        type: one_line
        regex:
          - "\\[etl-fixed-containers\\] done"
  alp_sdk.example.etl_fixed_containers.e1m_evk:
    platform_allow:
      - native_sim
      - native_sim/native/64
    integration_platforms:
      - native_sim/native/64
    extra_configs:
      - 'CONFIG_COMPILER_OPT="-DALP_BOARD_E1M_EVK"'
    tags:
      - alp-sdk
      - example
      - etl-fixed-containers
      - aen
    harness: console
    harness_config:
        type: one_line
        regex:
          - "\\[etl-fixed-containers\\] done"
```

## examples/peripheral-io/fmt-formatting/testcase.yaml
```yaml
# SPDX-License-Identifier: Apache-2.0

sample:
  name: fmt-formatting
  description: |
    fmt::format_to() into a fixed char[64] buffer, no allocation, no
    <iostream> -- formats an int + a float + a string in one call and
    prints the resulting buffer. Teaches the header-only {fmt}
    library's caller-owned-buffer formatting API.

tests:
  alp_sdk.example.fmt_formatting.e1m_x_evk:
    platform_allow:
      - native_sim
      - native_sim/native/64
    integration_platforms:
      - native_sim/native/64
    extra_configs:
      - 'CONFIG_COMPILER_OPT="-DALP_BOARD_E1M_X_EVK"'
    tags:
      - alp-sdk
      - example
      - fmt-formatting
      - v2n
    harness: console
    harness_config:
        type: one_line
        regex:
          - "\\[fmt-formatting\\] done"
  alp_sdk.example.fmt_formatting.e1m_evk:
    platform_allow:
      - native_sim
      - native_sim/native/64
    integration_platforms:
      - native_sim/native/64
    extra_configs:
      - 'CONFIG_COMPILER_OPT="-DALP_BOARD_E1M_EVK"'
    tags:
      - alp-sdk
      - example
      - fmt-formatting
      - aen
    harness: console
    harness_config:
        type: one_line
        regex:
          - "\\[fmt-formatting\\] done"
```

## examples/peripheral-io/gpio-button-led/testcase.yaml
```yaml
# SPDX-License-Identifier: Apache-2.0

sample:
  name: gpio-button-led
  description: |
    Per-peripheral example for the GPIO surface via the
    <alp/blocks/button_led.h> block.  Button = encoder switch
    (BOARD_PIN_ENCODER_SW); LED = the RGB-red PWM pad claimed as a
    GPIO (BOARD_PIN_LED_RED).  Builds on both EVKs: E1M EVK uses
    E1M_GPIO_IO4 + E1M_GPIO_PWM3; E1M-X EVK uses E1M_X_GPIO_IO28
    + E1M_X_GPIO_PWM5.

tests:
  alp_sdk.example.gpio_button_led.e1m_x_evk:
    platform_allow:
      - native_sim
      - native_sim/native/64
    integration_platforms:
      - native_sim/native/64
    extra_configs:
      - 'CONFIG_COMPILER_OPT="-DALP_BOARD_E1M_X_EVK"'
    tags:
      - alp-sdk
      - example
      - gpio
      - v2n
    harness: console
    harness_config:
        type: one_line
        regex:
          - "\\[gpio\\] done"
  alp_sdk.example.gpio_button_led.e1m_evk:
    platform_allow:
      - native_sim
      - native_sim/native/64
    integration_platforms:
      - native_sim/native/64
    extra_configs:
      - 'CONFIG_COMPILER_OPT="-DALP_BOARD_E1M_EVK"'
    tags:
      - alp-sdk
      - example
      - gpio
      - aen
    harness: console
    harness_config:
        type: one_line
        regex:
          - "\\[gpio\\] done"
```

## examples/peripheral-io/hello-world/testcase.yaml
```yaml
# SPDX-License-Identifier: Apache-2.0

sample:
  name: hello-world
  description: |
    Minimal "first program" example.  Prints a periodic heartbeat
    so customers can verify their toolchain + flash flow + log
    console before tackling peripheral wiring.  Builds on both
    EVKs: no board-specific macros required.

tests:
  alp_sdk.example.hello_world.e1m_x_evk:
    platform_allow:
      - native_sim
      - native_sim/native/64
    integration_platforms:
      - native_sim/native/64
    extra_configs:
      - 'CONFIG_COMPILER_OPT="-DALP_BOARD_E1M_X_EVK"'
    tags:
      - alp-sdk
      - example
      - hello-world
      - v2n
    harness: console
    harness_config:
        type: one_line
        regex:
          - "\\[hello\\] done"
  alp_sdk.example.hello_world.e1m_evk:
    platform_allow:
      - native_sim
      - native_sim/native/64
    integration_platforms:
      - native_sim/native/64
    extra_configs:
      - 'CONFIG_COMPILER_OPT="-DALP_BOARD_E1M_EVK"'
    tags:
      - alp-sdk
      - example
      - hello-world
      - aen
    harness: console
    harness_config:
        type: one_line
        regex:
          - "\\[hello\\] done"
```

## examples/peripheral-io/i2c-device-hub/testcase.yaml
```yaml
# SPDX-License-Identifier: Apache-2.0

sample:
  name: i2c-device-hub
  description: |
    Functional read-out of every populated device on the EVK
    sensor/power I2C bus, each through its real chip driver
    (IMU, barometer, 6x INA236 rail monitors, 2x TAS2563 amps,
    EEPROM).  On native_sim there is no real bus, so every device
    is reported absent and the run still completes cleanly -- this
    is a silicon example; the value is in the on-bench RESULT line.

tests:
  alp_sdk.example.i2c_device_hub.e1m_evk:
    platform_allow:
      - native_sim
      - native_sim/native/64
    integration_platforms:
      - native_sim/native/64
    extra_configs:
      - 'CONFIG_COMPILER_OPT="-DALP_BOARD_E1M_EVK"'
    tags:
      - alp-sdk
      - example
      - i2c
      - aen
    harness: console
    harness_config:
      type: one_line
      regex:
        - "\\[devhub\\] done"
```

## examples/peripheral-io/i2c-master/testcase.yaml
```yaml
# SPDX-License-Identifier: Apache-2.0

sample:
  name: i2c-master
  description: |
    Per-peripheral example for I2C master.  Reads the on-module
    TMP112 temperature sensor at a known 7-bit address via
    BOARD_I2C_SENSORS.  Builds on both EVKs: E1M EVK uses E1M_I2C0;
    E1M-X EVK uses E1M_X_I2C0.  Contrasts with
    examples/peripheral-io/i2c-scanner (discovery vs known-address read).

tests:
  alp_sdk.example.i2c_master.e1m_x_evk:
    platform_allow:
      - native_sim
      - native_sim/native/64
    integration_platforms:
      - native_sim/native/64
    extra_configs:
      - 'CONFIG_COMPILER_OPT="-DALP_BOARD_E1M_X_EVK"'
    tags:
      - alp-sdk
      - example
      - i2c
      - sensors
      - v2n
    harness: console
    harness_config:
        type: one_line
        regex:
          - "\\[i2c-master\\] done"
  alp_sdk.example.i2c_master.e1m_evk:
    platform_allow:
      - native_sim
      - native_sim/native/64
    integration_platforms:
      - native_sim/native/64
    extra_configs:
      - 'CONFIG_COMPILER_OPT="-DALP_BOARD_E1M_EVK"'
    tags:
      - alp-sdk
      - example
      - i2c
      - sensors
      - aen
    harness: console
    harness_config:
        type: one_line
        regex:
          - "\\[i2c-master\\] done"
```

## examples/peripheral-io/i2c-scanner/testcase.yaml
```yaml
# SPDX-License-Identifier: Apache-2.0

sample:
  name: i2c-scanner
  description: |
    Per-peripheral example for I2C.  Walks 7-bit addresses on
    BOARD_I2C_SENSORS and reports responders.  Builds on both EVKs:
    E1M EVK uses E1M_I2C0; E1M-X EVK uses E1M_X_I2C0.

tests:
  alp_sdk.example.i2c_scanner.e1m_x_evk:
    platform_allow:
      - native_sim
      - native_sim/native/64
    integration_platforms:
      - native_sim/native/64
    extra_configs:
      - 'CONFIG_COMPILER_OPT="-DALP_BOARD_E1M_X_EVK"'
    tags:
      - alp-sdk
      - example
      - i2c
      - v2n
    harness: console
    harness_config:
        type: one_line
        regex:
          - "\\[i2c\\] done"
  alp_sdk.example.i2c_scanner.e1m_evk:
    platform_allow:
      - native_sim
      - native_sim/native/64
    integration_platforms:
      - native_sim/native/64
    extra_configs:
      - 'CONFIG_COMPILER_OPT="-DALP_BOARD_E1M_EVK"'
    tags:
      - alp-sdk
      - example
      - i2c
      - aen
    harness: console
    harness_config:
        type: one_line
        regex:
          - "\\[i2c\\] done"
```

## examples/peripheral-io/i2c-slave/testcase.yaml
```yaml
# SPDX-License-Identifier: Apache-2.0

sample:
  name: i2c-slave
  description: |
    Per-peripheral example for I2C target (slave) mode via the
    <alp/i2c_regfile.h> helper: the register-file pattern shipped
    as one open() call over the byte-granular target callbacks,
    plus write-window + stats niceties.  On native_sim the emulated
    controller accepts the registration but nothing drives the
    bus, so ticks show writes_seen=0; drivers without target
    support degrade cleanly with the NOSUPPORT diagnostic.
    Builds on both EVKs: E1M EVK uses ALP_E1M_I2C0 via
    BOARD_I2C_SENSORS; E1M-X EVK uses ALP_E1M_X_I2C0.

tests:
  alp_sdk.example.i2c_slave.e1m_x_evk:
    platform_allow:
      - native_sim
      - native_sim/native/64
    integration_platforms:
      - native_sim/native/64
    extra_configs:
      - 'CONFIG_COMPILER_OPT="-DALP_BOARD_E1M_X_EVK"'
    tags:
      - alp-sdk
      - example
      - i2c
      - v2n
    harness: console
    harness_config:
        type: one_line
        regex:
          - "\\[i2c-slave\\] done"
  alp_sdk.example.i2c_slave.e1m_evk:
    platform_allow:
      - native_sim
      - native_sim/native/64
    integration_platforms:
      - native_sim/native/64
    extra_configs:
      - 'CONFIG_COMPILER_OPT="-DALP_BOARD_E1M_EVK"'
    tags:
      - alp-sdk
      - example
      - i2c
      - aen
    harness: console
    harness_config:
        type: one_line
        regex:
          - "\\[i2c-slave\\] done"
```

## examples/peripheral-io/pwm-led-fade/testcase.yaml
```yaml
# SPDX-License-Identifier: Apache-2.0

sample:
  name: pwm-led-fade
  description: |
    Per-peripheral example for <alp/pwm.h>.  Fades the board's green
    LED on BOARD_PWM_LED_GREEN.  Builds on both EVKs: E1M EVK uses
    E1M_PWM0; E1M-X EVK uses E1M_X_PWM7.  On native_sim there's no
    PWM emul controller so the example prints the alp_last_error()
    diagnostic and exits -- proves the open / last_error / close path works.

tests:
  alp_sdk.example.pwm_led_fade.e1m_x_evk:
    platform_allow:
      - native_sim
      - native_sim/native/64
    integration_platforms:
      - native_sim/native/64
    extra_configs:
      - 'CONFIG_COMPILER_OPT="-DALP_BOARD_E1M_X_EVK"'
    tags:
      - alp-sdk
      - example
      - pwm
      - v2n
    harness: console
    harness_config:
        type: one_line
        regex:
          - "\\[pwm\\] done"
  alp_sdk.example.pwm_led_fade.e1m_evk:
    platform_allow:
      - native_sim
      - native_sim/native/64
    integration_platforms:
      - native_sim/native/64
    extra_configs:
      - 'CONFIG_COMPILER_OPT="-DALP_BOARD_E1M_EVK"'
    tags:
      - alp-sdk
      - example
      - pwm
      - aen
    harness: console
    harness_config:
        type: one_line
        regex:
          - "\\[pwm\\] done"
```

## examples/peripheral-io/qenc-readout/testcase.yaml
```yaml
# SPDX-License-Identifier: Apache-2.0

sample:
  name: qenc-readout
  description: |
    Per-peripheral example for the quadrature-decoder side of
    <alp/counter.h>.  Polls BOARD_ENC_ROTARY's accumulated position.
    Builds on both EVKs: E1M EVK uses E1M_ENC0; E1M-X EVK uses E1M_X_ENC0.

tests:
  alp_sdk.example.qenc_readout.e1m_x_evk:
    platform_allow:
      - native_sim
      - native_sim/native/64
    integration_platforms:
      - native_sim/native/64
    extra_configs:
      - 'CONFIG_COMPILER_OPT="-DALP_BOARD_E1M_X_EVK"'
    tags:
      - alp-sdk
      - example
      - qenc
      - v2n
    harness: console
    harness_config:
        type: one_line
        regex:
          - "\\[qenc\\] done"
  alp_sdk.example.qenc_readout.e1m_evk:
    platform_allow:
      - native_sim
      - native_sim/native/64
    integration_platforms:
      - native_sim/native/64
    extra_configs:
      - 'CONFIG_COMPILER_OPT="-DALP_BOARD_E1M_EVK"'
    tags:
      - alp-sdk
      - example
      - qenc
      - aen
    harness: console
    harness_config:
        type: one_line
        regex:
          - "\\[qenc\\] done"
```

## examples/peripheral-io/spi-loopback/boards/native_sim_native_64.conf
```kconfig
# SPDX-License-Identifier: Apache-2.0
#
# native_sim has no real SPI controller; pull in the emul SPI
# driver so the loopback path works.  Auto-loaded by Zephyr when
# building for native_sim/native/64.

CONFIG_EMUL=y
CONFIG_SPI_EMUL=y
```
