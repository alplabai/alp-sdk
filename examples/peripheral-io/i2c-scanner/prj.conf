## CMakeLists.txt
```
# SPDX-License-Identifier: Apache-2.0

cmake_minimum_required(VERSION 3.20)

find_package(Zephyr REQUIRED HINTS $ENV{ZEPHYR_BASE})
project(i2c_scanner LANGUAGES C)

target_sources(app PRIVATE src/main.c)
```

## prj.conf
```kconfig
# SPDX-License-Identifier: Apache-2.0
#
# Intentionally empty.  Every CONFIG_* this app needs is derived
# from board.yaml by `tan build` and layered in via
# EXTRA_CONF_FILE (see scripts/gen_example_alp_conf.py).  Add app-specific tuning
# knobs (e.g. CONFIG_HEAP_MEM_POOL_SIZE=N) here only when they
# are NOT feature-selection -- everything declarative belongs in
# board.yaml.
```

## boards/native_sim_native_64.conf
```kconfig
# SPDX-License-Identifier: Apache-2.0
#
# native_sim has no real I2C controller; pull in the emul I2C
# driver so the bus enumerates at boot for the scanner to walk.
# Auto-loaded by Zephyr when building for native_sim/native/64.

CONFIG_EMUL=y
CONFIG_I2C_EMUL=y
```

## boards/native_sim_native_64.overlay
```dts
/*
 * Copyright 2026 Alp Lab AB
 * SPDX-License-Identifier: Apache-2.0
 *
 * One emulated I²C bus exposed via the alp-i2c0 alias.  No emul
 * targets are attached so every scan returns "no response" — but
 * the scanner runs end-to-end and exercises the open / write /
 * close path.
 */

#include <zephyr/dt-bindings/i2c/i2c.h>

/ {
    aliases {
        alp-i2c0 = &i2c0_emul;
    };

    soc {
        i2c0_emul: i2c@100 {
            compatible = "zephyr,i2c-emul-controller";
            status = "okay";
            reg = <0 0x100 4>;
            #address-cells = <1>;
            #size-cells = <0>;
            clock-frequency = <I2C_BITRATE_STANDARD>;
        };
    };
};
```

## src/main.c
```c
/*
 * Copyright 2026 Alp Lab AB
 * SPDX-License-Identifier: Apache-2.0
 *
 * i2c-scanner — open the EVK sensor bus and probe every 7-bit
 * address.  The canonical "any device on this bus?" pattern.
 */

#include <stdio.h>

#include "alp/peripheral.h"

/* BOARD_I2C_SENSORS is a portable cross-EVK alias from <alp/board.h>:
 *   E1M EVK  -> EVK_I2C_BUS_SENSORS  -> ALP_E1M_I2C0
 *   E1M-X EVK -> XEVK_I2C_BUS_SENSORS -> ALP_E1M_X_I2C0
 * Rebind it in board.yaml `pins:` to port to another board. */
#include "alp/board.h"

int main(void)
{
	/* Bring up the SDK runtime before anything else -- thin today,
	 * but future backends rely on it (see <alp/peripheral.h>). */
	(void)alp_init();

	printf("[i2c] open BOARD_I2C_SENSORS @ 100 kHz\n");

	alp_i2c_t *bus = alp_i2c_open(&(alp_i2c_config_t){
	    .bus_id     = BOARD_I2C_SENSORS, /* E1M EVK: ALP_E1M_I2C0; E1M-X EVK: ALP_E1M_X_I2C0 */
	    .bitrate_hz = 100000,
	});
	if (bus == NULL) {
		printf("[i2c] open failed: alp_last_error=%d\n", (int)alp_last_error());
		printf("[i2c] done\n");
		return 0;
	}

	int responders = 0;
	for (uint8_t addr = 0x08; addr < 0x78; addr++) {
		/* Probe with a 1-byte read: a present chip ACKs its address
         * byte (we discard the data), an empty address NACKs.  We use a
         * read rather than a zero-length write because some controllers
         * — e.g. the DesignWare i2c_dw on Alif Ensemble — put nothing on
         * the bus for a zero-length transfer, so no device ever ACKs and
         * the scan finds nothing.  A 1-byte read is the portable probe. */
		uint8_t      scratch;
		alp_status_t s = alp_i2c_read(bus, addr, &scratch, 1);
		if (s == ALP_OK) {
			printf("[i2c] addr 0x%02x acked\n", addr);
			responders++;
		}
	}
	printf("[i2c] scan complete, %d responder(s)\n", responders);

	alp_i2c_close(bus);
	printf("[i2c] done\n");
	return 0;
}
```
