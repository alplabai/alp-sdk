## CMakeLists.txt
```
# SPDX-License-Identifier: Apache-2.0

cmake_minimum_required(VERSION 3.20)

# Resolve the alp-sdk root.  In-tree the SDK is the example's
# grandparent directory; out-of-tree customers point ALP_SDK_ROOT
# at their checkout.
if(DEFINED ENV{ALP_SDK_ROOT})
    set(ALP_SDK_ROOT $ENV{ALP_SDK_ROOT})
else()
    get_filename_component(ALP_SDK_ROOT ${CMAKE_CURRENT_SOURCE_DIR}/../../.. ABSOLUTE)
endif()

find_package(Python3 REQUIRED COMPONENTS Interpreter)

set(_alp_generated ${CMAKE_BINARY_DIR}/generated/alp.conf)
execute_process(
    COMMAND ${Python3_EXECUTABLE} ${ALP_SDK_ROOT}/scripts/alp_project.py
            --input ${CMAKE_CURRENT_SOURCE_DIR}/board.yaml
            --emit zephyr-conf --core m55_hp
            --output ${_alp_generated}
    RESULT_VARIABLE _alp_rv
    OUTPUT_VARIABLE _alp_stdout
    ERROR_VARIABLE  _alp_stderr
)
if(NOT _alp_rv EQUAL 0)
    message(FATAL_ERROR
        "alp_project.py failed (rv=${_alp_rv}); "
        "check ${CMAKE_CURRENT_SOURCE_DIR}/board.yaml.\n"
        "stderr: ${_alp_stderr}")
endif()

# Layer generated CONFIG_* over prj.conf via EXTRA_CONF_FILE.
list(APPEND EXTRA_CONF_FILE ${_alp_generated})

find_package(Zephyr REQUIRED HINTS $ENV{ZEPHYR_BASE})
project(fmt_formatting LANGUAGES C CXX)

target_sources(app PRIVATE src/main.cpp)
```

## prj.conf
```kconfig
# SPDX-License-Identifier: Apache-2.0
#
# fmt is C++; the app source is main.cpp. These are C++ toolchain
# knobs the library needs -- not board.yaml feature selection, so
# they live here rather than being loader-derived (see
# hello-world/prj.conf for the "what goes here" rule). Modelled on
# examples/testing/doctest-selftest/prj.conf, the SDK's existing
# native_sim precedent for a header-only C++ library that needs more
# than Zephyr's minimal C++ library provides.
CONFIG_CPP=y
CONFIG_STD_CPP17=y

# fmt/format.h pulls in <string_view>, <type_traits>, <limits>, and
# friends well beyond the three headers Zephyr's minimal C++ library
# ships (cstdint/cstddef/a <new> stub -- see
# examples/peripheral-io/etl-fixed-containers/CMakeLists.txt for the
# gap that stub causes for a *different* library).  Pull in the
# host's real libstdc++ via EXTERNAL_LIBCPP (native_sim's default
# once REQUIRES_FULL_LIBCPP is set) so those headers resolve.
CONFIG_REQUIRES_FULL_LIBCPP=y
```

## src/main.cpp
```c
/*
 * Copyright 2026 Alp Lab AB
 * SPDX-License-Identifier: Apache-2.0
 *
 * fmt-formatting -- teaches {fmt} (https://github.com/fmtlib/fmt)'s
 * `fmt::format_to` API: formatting into a caller-owned fixed buffer,
 * with NO heap allocation and NO <iostream>.
 *
 * What success looks like:
 *
 *   [fmt-formatting] buffer: "count=7 ratio=3.14 label=sensor-a"
 *   [fmt-formatting] done
 *
 * Where this runs: native_sim.  `board.yaml`'s `libraries: [fmt]`
 * adds vendors/fmt/include (the vendored fmt 11.0.2 headers) and
 * metadata/library-profiles/fmt/fmt_config.h (FMT_HEADER_ONLY=1,
 * FMT_USE_IOSTREAM=0, FMT_EXCEPTIONS=0) to the include path. This
 * example's prj.conf sets CONFIG_REQUIRES_FULL_LIBCPP=y because
 * fmt/format.h needs <string_view>/<type_traits>/<limits> that
 * Zephyr's minimal C++ library doesn't ship -- see prj.conf.
 *
 * No allocation, no <iostream>:
 *
 *   fmt::format_to() writes formatted output directly through an
 *   output iterator the caller supplies -- here, a raw `char*` into
 *   a stack-allocated `char[64]`.  Nothing is heap-allocated, and
 *   nothing pulls in <iostream>'s ~30 KB of static-init code (that's
 *   what FMT_USE_IOSTREAM=0 in the profile buys). Compare this to
 *   fmt::format(), which returns an owning std::string -- the right
 *   choice on a host build, the wrong one on a heap-less firmware
 *   build.
 */

/* metadata/library-profiles/fmt/fmt_config.h MUST be included before
 * any <fmt/...> header -- unlike ETL (which probes for
 * "etl_profile.h" itself via #include from inside its own headers),
 * fmt has no such auto-include hook; the profile's FMT_HEADER_ONLY /
 * FMT_USE_IOSTREAM / FMT_EXCEPTIONS #defines only take effect if
 * they're visible before fmt/base.h's own `#ifndef FMT_HEADER_ONLY`
 * checks run.  Same pattern as
 * examples/testing/doctest-selftest/src/main.cpp's
 * `#include "doctest_config.h"` line. */
#include "fmt_config.h"

#include <fmt/format.h>

#include <cstdio>

int main(void)
{
	/* Stack storage, sized generously for this format string --
	 * fmt::format_to does NOT null-terminate or bounds-check on
	 * its own (unlike fmt::format_to_n, which takes an explicit
	 * size limit); the caller is responsible for both, exactly
	 * like snprintf() with a size you trust rather than measure. */
	char buf[64];

	int         count = 7;
	float       ratio = 3.14F;
	const char *label = "sensor-a";

	/* fmt::format_to returns an iterator ONE PAST the last
	 * character written -- here that's just `buf + N`, since the
	 * output iterator is a plain `char*`. We use it to know exactly
	 * where to place the NUL terminator ourselves. */
	char *end = fmt::format_to(buf, "count={} ratio={:.2f} label={}", count, ratio, label);
	*end      = '\0';

	printf("[fmt-formatting] buffer: \"%s\"\n", buf);

	printf("[fmt-formatting] done\n");
	return 0;
}
```
