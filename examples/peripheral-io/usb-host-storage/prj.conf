## CMakeLists.txt
```
# SPDX-License-Identifier: Apache-2.0

cmake_minimum_required(VERSION 3.20)

# Resolve the alp-sdk root.  In-tree the SDK is the example's
# grandparent directory; out-of-tree customers point ALP_SDK_ROOT
# at their checkout.
if(DEFINED ENV{ALP_SDK_ROOT})
    set(ALP_SDK_ROOT $ENV{ALP_SDK_ROOT})
else()
    get_filename_component(ALP_SDK_ROOT ${CMAKE_CURRENT_SOURCE_DIR}/../../.. ABSOLUTE)
endif()

find_package(Python3 REQUIRED COMPONENTS Interpreter)

set(_alp_generated ${CMAKE_BINARY_DIR}/generated/alp.conf)
execute_process(
    COMMAND ${Python3_EXECUTABLE} ${ALP_SDK_ROOT}/scripts/alp_project.py
            --input ${CMAKE_CURRENT_SOURCE_DIR}/board.yaml
            --emit zephyr-conf --core m55_hp
            --output ${_alp_generated}
    RESULT_VARIABLE _alp_rv
    OUTPUT_VARIABLE _alp_stdout
    ERROR_VARIABLE  _alp_stderr
)
if(NOT _alp_rv EQUAL 0)
    message(FATAL_ERROR
        "alp_project.py failed (rv=${_alp_rv}); "
        "check ${CMAKE_CURRENT_SOURCE_DIR}/board.yaml.\n"
        "stderr: ${_alp_stderr}")
endif()

# Layer generated CONFIG_* over prj.conf via EXTRA_CONF_FILE.
list(APPEND EXTRA_CONF_FILE ${_alp_generated})

find_package(Zephyr REQUIRED HINTS $ENV{ZEPHYR_BASE})
project(usb_host_storage LANGUAGES C)

target_sources(app PRIVATE src/main.c)
```

## prj.conf
```kconfig
# SPDX-License-Identifier: Apache-2.0
#
# USB host stack + ALP SDK.  The alp_usb_host_* backend wires to Zephyr's
# usbh_* subsystem when CONFIG_USB_HOST_STACK=y and an alif,xhci-uhc DT
# node is present (label zephyr_uhc0) in the board.
#
# Bring-up note: the xHCI uhc driver (uhc_xhci_alif) implements the full
# uhc_api (see Kconfig.xhci_alif); only *_enable()'s controller bring-up
# (DWC3 host-mode init, xHCI reset, command/event-ring round trip) has
# actually been bench-run.  Everything past that -- ep_enqueue/ep_dequeue,
# bus suspend/resume, disable/shutdown, the event-ring ISR -- follows the
# same register sequencing but still needs its own bench pass (issue #388).
CONFIG_ALP_SDK=y
CONFIG_USB_HOST_STACK=y
CONFIG_UHC_DRIVER=y
CONFIG_UHC_XHCI_ALIF=y
```

## src/main.c
```c
/*
 * Copyright (c) 2026 Alp Lab AB
 * SPDX-License-Identifier: Apache-2.0
 *
 * usb-host-storage -- open the USB host role via the portable <alp/usb.h>
 * surface and enumerate an attached USB mass-storage device on the
 * E1M-AEN401 M55-HP.
 *
 * Build:
 *   west build -b alp_e1m_aen401_m55_hp/ae402fa0e5597le0/rtss_hp \
 *       examples/peripheral-io/usb-host-storage -d /tmp/usb_host
 *
 * Bring-up status:
 *   The xHCI uhc driver (uhc_xhci_alif) implements the full uhc_api --
 *   register bring-up, ring/transfer processing, root-hub enumeration,
 *   bus ops, and an event-ring IRQ (see the driver's own header comment).
 *   This example only drives the open/enable/disable/close lifecycle
 *   through the portable <alp/usb.h> surface, which does not yet wire
 *   endpoint I/O through to a mass-storage class driver (issue #388 is
 *   the software-completion tracking issue; that class-driver wiring is
 *   separate follow-on work).  Register bring-up was bench-proven on an
 *   E8 EVK; everything past that (transfers, bus suspend/resume, the
 *   ISR) has not itself been bench-run, and end-to-end enumeration on
 *   this EVK also needs a D+/D- signal-path fix -- see issue #388.
 */
#include <stdio.h>

#include <zephyr/kernel.h>

#include <alp/usb.h>

int main(void)
{
	printf("== usb-host-storage (E1M-AEN401 M55) ==\n");

	alp_usb_host_t *host = alp_usb_host_open();
	if (host == NULL) {
		printf("alp_usb_host_open: no host backend available "
		       "(check CONFIG_USB_HOST_STACK + alif,xhci-uhc DT node)\n");
		return 1;
	}

	if (alp_usb_host_enable(host) != ALP_OK) {
		printf("alp_usb_host_enable failed\n");
		alp_usb_host_close(host);
		return 1;
	}

	printf("USB host enabled -- attach a mass-storage device\n");
	printf("(this example doesn't mount it yet -- see the file header)\n");

	/*
	 * Not yet wired: mounting the MSC LUN via Zephyr's usb_host MSC class
	 * driver and listing the root directory needs the <alp/usb.h>
	 * surface's own endpoint I/O, which does not exist yet (separate
	 * follow-on work from issue #388 -- see the file header comment).
	 */
	k_sleep(K_SECONDS(2));

	alp_usb_host_disable(host);
	alp_usb_host_close(host);

	printf("USB host closed.\n");
	return 0;
}
```
