## CMakeLists.txt
```
# SPDX-License-Identifier: Apache-2.0

cmake_minimum_required(VERSION 3.20)

# Resolve the alp-sdk root.  In-tree the SDK is the example's
# grandparent directory; out-of-tree customers point ALP_SDK_ROOT
# at their checkout.
if(DEFINED ENV{ALP_SDK_ROOT})
    set(ALP_SDK_ROOT $ENV{ALP_SDK_ROOT})
else()
    get_filename_component(ALP_SDK_ROOT ${CMAKE_CURRENT_SOURCE_DIR}/../.. ABSOLUTE)
endif()

find_package(Python3 REQUIRED COMPONENTS Interpreter)

set(_alp_generated ${CMAKE_BINARY_DIR}/generated/alp.conf)
execute_process(
    COMMAND ${Python3_EXECUTABLE} ${ALP_SDK_ROOT}/scripts/alp_project.py
            --input ${CMAKE_CURRENT_SOURCE_DIR}/board.yaml
            --emit zephyr-conf
            --output ${_alp_generated}
    RESULT_VARIABLE _alp_rv
    OUTPUT_VARIABLE _alp_stdout
    ERROR_VARIABLE  _alp_stderr
)
if(NOT _alp_rv EQUAL 0)
    message(FATAL_ERROR
        "alp_project.py failed (rv=${_alp_rv}); "
        "check ${CMAKE_CURRENT_SOURCE_DIR}/board.yaml.\n"
        "stderr: ${_alp_stderr}")
endif()

# Layer generated CONFIG_* over prj.conf via OVERLAY_CONFIG.
list(APPEND OVERLAY_CONFIG ${_alp_generated})

find_package(Zephyr REQUIRED HINTS $ENV{ZEPHYR_BASE})
project(rtc_clock LANGUAGES C)

target_sources(app PRIVATE src/main.c)
```

## prj.conf
```kconfig
# SPDX-License-Identifier: Apache-2.0

CONFIG_ALP_SDK=y
CONFIG_RTC=y
CONFIG_LOG=y
CONFIG_PRINTK=y
CONFIG_THREAD_LOCAL_STORAGE=y
```

## src/main.c
```c
/*
 * Copyright 2026 ALP Lab AB
 * SPDX-License-Identifier: Apache-2.0
 *
 * rtc-clock — set the RTC, sleep, read it back.
 */

#include <stdio.h>

#include <zephyr/kernel.h>

#include "alp/rtc.h"

int main(void) {
    printf("[rtc] open instance 0\n");
    alp_rtc_t *rtc = alp_rtc_open(0);
    if (rtc == NULL) {
        printf("[rtc] open failed: alp_last_error=%d "
               "(expected NOT_READY = -2 on native_sim)\n",
               (int)alp_last_error());
        printf("[rtc] done\n");
        return 0;
    }

    alp_rtc_time_t set_t = {
        .year = 2026, .month = 5, .day = 10,
        .hour = 14,   .minute = 30, .second = 0,
    };
    alp_status_t s = alp_rtc_set_time(rtc, &set_t);
    printf("[rtc] set_time(2026-05-10 14:30:00) -> %d\n", (int)s);

    k_msleep(250);

    alp_rtc_time_t got;
    s = alp_rtc_get_time(rtc, &got);
    printf("[rtc] get_time -> status=%d, %04u-%02u-%02u %02u:%02u:%02u\n",
           (int)s, got.year, got.month, got.day,
           got.hour, got.minute, got.second);

    alp_rtc_close(rtc);
    printf("[rtc] done\n");
    return 0;
}
```
