## CMakeLists.txt
```
# SPDX-License-Identifier: Apache-2.0

cmake_minimum_required(VERSION 3.20)

# --------------------------------------------------------------------
# board.yaml -> build/generated/alp.conf at configure time.
# --------------------------------------------------------------------
#
# Customers who copy this example out of the SDK tree point the
# ALP_SDK_ROOT env var at their checkout; in-tree we resolve it as
# the example's grandparent directory.

if(DEFINED ENV{ALP_SDK_ROOT})
    set(ALP_SDK_ROOT $ENV{ALP_SDK_ROOT})
else()
    get_filename_component(ALP_SDK_ROOT ${CMAKE_CURRENT_SOURCE_DIR}/../.. ABSOLUTE)
endif()

find_package(Python3 REQUIRED COMPONENTS Interpreter)

set(_alp_generated ${CMAKE_BINARY_DIR}/generated/alp.conf)
execute_process(
    COMMAND ${Python3_EXECUTABLE} ${ALP_SDK_ROOT}/scripts/alp_project.py
            --input ${CMAKE_CURRENT_SOURCE_DIR}/board.yaml
            --emit zephyr-conf
            --output ${_alp_generated}
    RESULT_VARIABLE _alp_rv
    OUTPUT_VARIABLE _alp_stdout
    ERROR_VARIABLE  _alp_stderr
)
if(NOT _alp_rv EQUAL 0)
    message(FATAL_ERROR
        "alp_project.py failed (rv=${_alp_rv}); "
        "check ${CMAKE_CURRENT_SOURCE_DIR}/board.yaml.\n"
        "stderr: ${_alp_stderr}")
endif()

# Layer the generated CONFIG_* lines over prj.conf via Zephyr's
# OVERLAY_CONFIG mechanism.  Must be set before find_package(Zephyr).
# `rsource` is NOT valid in .conf files (it is a Kconfig-source
# directive only), which is why prj.conf can't pull the generated
# fragment in itself.
list(APPEND OVERLAY_CONFIG ${_alp_generated})

find_package(Zephyr REQUIRED HINTS $ENV{ZEPHYR_BASE})
project(gpio_button_led LANGUAGES C)

target_sources(app PRIVATE src/main.c)
```

## prj.conf
```kconfig
# SPDX-License-Identifier: Apache-2.0
#
# Intentionally empty.  Every CONFIG_* this app needs is derived
# from board.yaml by scripts/alp_project.py and layered in as
# `OVERLAY_CONFIG` via CMakeLists.txt -- the board.yaml is the
# single source of truth.  If you want a hand-set override, add a
# new prj-override.conf and `list(APPEND OVERLAY_CONFIG ...)` it.
```

## boards/native_sim_native_64.overlay
```dts
/*
 * Copyright 2026 ALP Lab AB
 * SPDX-License-Identifier: Apache-2.0
 *
 * Host-emulated alp,pin-array for gpio-button-led under native_sim.
 *
 * The array is POSITIONAL: alp_z_gpio_resolve(pin_id) indexes it by
 * the E1M GPIO index, so entry N must be E1M pad N in the e1m_pinout.h
 * canonical order (IO0..IO25 = 0..25, PWM0..PWM7 = 26..33, ...).  This
 * overlay covers indices 0..29 -- enough for the two pads this demo
 * uses:
 *   - index  4 = E1M_GPIO_IO4   -> the encoder push switch (button)
 *   - index 29 = E1M_GPIO_PWM3  -> the RGB-red pad, claimed as GPIO
 * The PWM3 pad as a plain GPIO is exactly the e1m-spec "GPIO secondary"
 * capability the example demonstrates.
 *
 * (gpio-emul controllers are limited to 32 pins, so a real 52-slot
 * board file would span two controllers; native_sim only needs the
 * range the demo touches.)
 */

#include <zephyr/dt-bindings/gpio/gpio.h>

/ {
    gpio_emul0: gpio_emul0 {
        compatible = "zephyr,gpio-emul";
        status = "okay";
        gpio-controller;
        rising-edge;
        falling-edge;
        #gpio-cells = <2>;
        ngpios = <32>;
    };

    alp_pins: alp-pins {
        compatible = "alp,pin-array";
        gpios = <&gpio_emul0  0 GPIO_ACTIVE_HIGH>,   /* [ 0] E1M_GPIO_IO0  */
                <&gpio_emul0  1 GPIO_ACTIVE_HIGH>,   /* [ 1] E1M_GPIO_IO1  */
                <&gpio_emul0  2 GPIO_ACTIVE_HIGH>,   /* [ 2] E1M_GPIO_IO2  */
                <&gpio_emul0  3 GPIO_ACTIVE_HIGH>,   /* [ 3] E1M_GPIO_IO3  */
                <&gpio_emul0  4 (GPIO_ACTIVE_LOW | GPIO_PULL_UP)>,  /* [ 4] E1M_GPIO_IO4 -- button */
                <&gpio_emul0  5 GPIO_ACTIVE_HIGH>,   /* [ 5] E1M_GPIO_IO5  */
                <&gpio_emul0  6 GPIO_ACTIVE_HIGH>,   /* [ 6] E1M_GPIO_IO6  */
                <&gpio_emul0  7 GPIO_ACTIVE_HIGH>,   /* [ 7] E1M_GPIO_IO7  */
                <&gpio_emul0  8 GPIO_ACTIVE_HIGH>,   /* [ 8] E1M_GPIO_IO8  */
                <&gpio_emul0  9 GPIO_ACTIVE_HIGH>,   /* [ 9] E1M_GPIO_IO9  */
                <&gpio_emul0 10 GPIO_ACTIVE_HIGH>,   /* [10] E1M_GPIO_IO10 */
                <&gpio_emul0 11 GPIO_ACTIVE_HIGH>,   /* [11] E1M_GPIO_IO11 */
                <&gpio_emul0 12 GPIO_ACTIVE_HIGH>,   /* [12] E1M_GPIO_IO12 */
                <&gpio_emul0 13 GPIO_ACTIVE_HIGH>,   /* [13] E1M_GPIO_IO13 */
                <&gpio_emul0 14 GPIO_ACTIVE_HIGH>,   /* [14] E1M_GPIO_IO14 */
                <&gpio_emul0 15 GPIO_ACTIVE_HIGH>,   /* [15] E1M_GPIO_IO15 */
                <&gpio_emul0 16 GPIO_ACTIVE_HIGH>,   /* [16] E1M_GPIO_IO16 */
                <&gpio_emul0 17 GPIO_ACTIVE_HIGH>,   /* [17] E1M_GPIO_IO17 */
                <&gpio_emul0 18 GPIO_ACTIVE_HIGH>,   /* [18] E1M_GPIO_IO18 */
                <&gpio_emul0 19 GPIO_ACTIVE_HIGH>,   /* [19] E1M_GPIO_IO19 */
                <&gpio_emul0 20 GPIO_ACTIVE_HIGH>,   /* [20] E1M_GPIO_IO20 */
                <&gpio_emul0 21 GPIO_ACTIVE_HIGH>,   /* [21] E1M_GPIO_IO21 */
                <&gpio_emul0 22 GPIO_ACTIVE_HIGH>,   /* [22] E1M_GPIO_IO22 */
                <&gpio_emul0 23 GPIO_ACTIVE_HIGH>,   /* [23] E1M_GPIO_IO23 */
                <&gpio_emul0 24 GPIO_ACTIVE_HIGH>,   /* [24] E1M_GPIO_IO24 */
                <&gpio_emul0 25 GPIO_ACTIVE_HIGH>,   /* [25] E1M_GPIO_IO25 */
                <&gpio_emul0 26 GPIO_ACTIVE_HIGH>,   /* [26] E1M_GPIO_PWM0 */
                <&gpio_emul0 27 GPIO_ACTIVE_HIGH>,   /* [27] E1M_GPIO_PWM1 */
                <&gpio_emul0 28 GPIO_ACTIVE_HIGH>,   /* [28] E1M_GPIO_PWM2 */
                <&gpio_emul0 29 GPIO_ACTIVE_HIGH>;   /* [29] E1M_GPIO_PWM3 -- LED (RGB-red pad as GPIO) */
    };
};
```

## src/main.c
```c
/*
 * Copyright 2026 ALP Lab AB
 * SPDX-License-Identifier: Apache-2.0
 *
 * gpio-button-led -- read a button and toggle an LED, both as plain
 * GPIO, through the <alp/blocks/button_led.h> helper.
 *
 * This demo opens its pins by their BOARD-MACRO names rather than raw
 * E1M indices: `EVK_PIN_ENCODER_SW` (the user button) and
 * `EVK_PIN_LED_RED` (the status LED) come from the board's generated
 * routes header, <alp/boards/alp_e1m_evk_routes.h>.  The loader emits
 * one `#define EVK_<NAME> E1M_<...>` per `e1m_routes:` entry, so the
 * macro is the readable, app-facing pin name -- copy this example to
 * your own board, rebind those names in your board.yaml `pins:` block,
 * and the code below is unchanged.
 *
 * The macros resolve to E1M instance IDs under the hood:
 *   EVK_PIN_ENCODER_SW = E1M_GPIO_IO4   -- the encoder push switch.
 *   EVK_PIN_LED_RED    = E1M_GPIO_PWM3  -- the RGB-red PWM pad claimed
 *                                          as a digital GPIO (the
 *                                          e1m-spec "GPIO secondary";
 *                                          the EVK has no plain GPIO
 *                                          LED, so the LED rides a PWM
 *                                          pad driven as GPIO).
 *
 * native_sim wires a GPIO-emul controller in boards/, so the open /
 * configure / read / write path runs and the harness latches `done`.
 */

#include <stdio.h>

#include <zephyr/kernel.h>

#include "alp/blocks/button_led.h"
#include "alp/boards/alp_e1m_evk_routes.h"

int main(void)
{
    printf("[gpio] init button=EVK_PIN_ENCODER_SW, led=EVK_PIN_LED_RED\n");

    alp_button_led_t bl;
    alp_status_t     s = alp_button_led_init(&bl, &(alp_button_led_config_t){
                                                      .button_pin_id     = EVK_PIN_ENCODER_SW,
                                                      .led_pin_id        = EVK_PIN_LED_RED,
                                                      .active_low_button = true,
                                              });
    if (s != ALP_OK) {
        printf("[gpio] init failed: status=%d\n", (int)s);
        printf("[gpio] done\n");
        return 0;
    }

    /* Quick lifecycle exercise: toggle 4 times and read the button
     * state once. */
    for (int i = 0; i < 4; i++) {
        bool on = (i & 1);
        s       = alp_button_led_set(&bl, on);
        printf("[gpio] led=%d status=%d\n", (int)on, (int)s);
        k_msleep(50);
    }

    bool pressed = false;
    s            = alp_button_led_is_pressed(&bl, &pressed);
    printf("[gpio] is_pressed -> status=%d pressed=%d\n", (int)s, (int)pressed);

    alp_button_led_deinit(&bl);
    printf("[gpio] done\n");
    return 0;
}
```
