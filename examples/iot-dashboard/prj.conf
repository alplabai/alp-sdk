## CMakeLists.txt
```
# SPDX-License-Identifier: Apache-2.0
cmake_minimum_required(VERSION 3.20.0)

# PYTHON_EXECUTABLE is only set after find_package(Zephyr);
# we need a Python interpreter at configure time *before*
# that, so resolve one ourselves here.
find_package(Python3 REQUIRED COMPONENTS Interpreter)

# Place alp.conf in the build-tree `generated/` subdir, NOT at the
# build-dir root.  Zephyr's kconfig.cmake greps ${APPLICATION_BINARY_DIR}/*.conf
# at the END of the merge-config-files list (cmake/modules/kconfig.cmake line 303
# in v4.4.0), so any .conf file dropped in the build-root wins over every
# `EXTRA_CONF_FILE=...` / `OVERLAY_CONFIG=...` overlay passed via
# `extra_args` in testcase.yaml -- including the native_sim.conf overlay
# that disables CONFIG_MBEDTLS to side-step the Zephyr v4.4 / mbedtls 3.6
# `ssl_misc.h` include-order bug.  Burying the file one level deeper keeps
# the overlay chain working as expected.
set(_alp_generated ${CMAKE_CURRENT_BINARY_DIR}/generated/alp.conf)
execute_process(
    COMMAND ${Python3_EXECUTABLE}
            ${CMAKE_CURRENT_SOURCE_DIR}/../../scripts/alp_project.py
            --input  ${CMAKE_CURRENT_SOURCE_DIR}/board.yaml
            --output ${_alp_generated}
            --emit zephyr-conf
    RESULT_VARIABLE rc
)
if(NOT rc EQUAL 0)
    message(FATAL_ERROR "alp_project.py failed (rc=${rc})")
endif()
set(OVERLAY_CONFIG ${_alp_generated})

find_package(Zephyr REQUIRED HINTS $ENV{ZEPHYR_BASE})
project(iot_dashboard LANGUAGES C)

target_sources(app PRIVATE
    src/main.c
    src/dashboard_ui.c
)
```

## prj.conf
```kconfig
# SPDX-License-Identifier: Apache-2.0
CONFIG_MAIN_STACK_SIZE=16384
CONFIG_HEAP_MEM_POOL_SIZE=262144

CONFIG_LV_Z_VDB_SIZE=50
CONFIG_LV_COLOR_DEPTH_16=y
CONFIG_LV_DEF_REFR_PERIOD=33
# LVGL doesn't ship the larger Montserrat sizes by default; the
# dashboard's big-number tiles use the 28-pt face.
CONFIG_LV_FONT_MONTSERRAT_28=y

CONFIG_LOG=y
CONFIG_LOG_PRINTK=y

# Networking + MQTT + TLS knobs.  Real WiFi credentials come in
# via a build-time KConfig override or a CMake -D flag; the demo
# stubs out the connect step on native_sim.
CONFIG_NETWORKING=y
CONFIG_NET_IPV4=y
CONFIG_NET_TCP=y
CONFIG_NET_SOCKETS=y
CONFIG_MQTT_LIB=y
# MQTT-TLS off on native_sim: Zephyr v4.4 + mbedtls 3.6 PSA wiring
# is the same v0.6 work item production-deployment / iot-fleet-ota
# carry.  Real-silicon builds re-enable via TF-M-on-HE.
CONFIG_MQTT_LIB_TLS=n
CONFIG_DNS_RESOLVER=y

# Display driver: native_sim has no real panel; the dummy
# display lets the demo link without an SDL/X11 dep.
CONFIG_DISPLAY=y
CONFIG_DUMMY_DISPLAY=y
```

## native_sim.conf
```kconfig
# SPDX-License-Identifier: Apache-2.0
#
# Native-sim Kconfig overlay for iot-dashboard.
#
# Loaded LAST via twister's `extra_args: EXTRA_CONF_FILE=...`
# (see ../testcase.yaml), so the settings here win over the
# alp.conf-emitted CONFIG_MBEDTLS=y that `libraries: [mbedtls]`
# pulls into every iot-dashboard build.
#
# Why: Zephyr v4.4 ships mbedtls 3.6 + the new tf-psa-crypto
# split.  The upstream library-internal header
# `mbedtls/library/ssl_misc.h` references `mbedtls_error_pair_t`
# before including the type's declaring header, which makes
# every TU that compiles against the SSL portion of mbedtls
# fail with `unknown type name 'mbedtls_error_pair_t'`.  Full
# integration is a v0.6 (TF-M-on-HE + tf-psa-crypto wiring)
# work item, same as the production-deployment / iot-fleet-ota
# native_sim build paths.
#
# On native_sim the framing path is what we want to exercise
# (open(), publish(), TLS-config call sites); turning mbedtls
# off keeps the build green without losing that coverage.  Real-
# silicon (.aen) builds keep mbedtls on -- they follow the
# TF-M-on-HE config stack that doesn't hit the same upstream
# include-order bug.
CONFIG_MBEDTLS=n
CONFIG_MBEDTLS_BUILTIN=n
CONFIG_MQTT_LIB_TLS=n
```

## boards/native_sim_native_64.overlay
```dts
/*
 * Copyright 2026 ALP Lab AB
 * SPDX-License-Identifier: Apache-2.0
 *
 * native_sim board overlay -- chooses zephyr's dummy display
 * driver so the LVGL demo links without a real display chip.
 * Real-silicon builds (alif / v2n) bring up the actual panel
 * (ST7789 / ILI9488 / DSI etc.) via the SoM board overlay.
 */

/ {
	chosen {
		zephyr,display = &dummy_dc;
	};

	dummy_dc: dummy_dc {
		compatible = "zephyr,dummy-dc";
		height = <320>;
		width = <240>;
	};
};
```

## src/main.c
```c
/*
 * Copyright 2026 ALP Lab AB
 * SPDX-License-Identifier: Apache-2.0
 *
 * iot-dashboard
 * =============
 *
 * Customer-facing IoT demo: an E1M-AEN module reads BME280
 * environment samples (temperature, humidity, pressure), publishes
 * them to an MQTT broker over TLS, and renders the live values +
 * connection state on a 240×320 LVGL dashboard.
 *
 *
 * ── End-to-end SDK demo ────────────────────────────────────────
 *
 *   ┌──────────────────┐  I²C0   ┌─────────┐
 *   │  E1M-AEN701 SoM  │ ──────▶ │ BME280  │ (T / H / P)
 *   │ + Cortex-M55 HP  │         └─────────┘
 *   └────────┬─────────┘
 *            │  SDIO  ┌─────────────────────────┐
 *            ├──────▶ │ Murata LBEE5HY2FY WiFi  │ ── TLS ─▶ broker.example
 *            │        └─────────────────────────┘
 *            │  I²C0  ┌─────────────────────────┐
 *            ├──────▶ │ OPTIGA Trust M          │  handshake offload
 *            │        └─────────────────────────┘
 *            │  SPI1  ┌─────────────────────────┐
 *            └──────▶ │ ST7789 240×320 TFT      │ ── LVGL dashboard
 *                     └─────────────────────────┘
 *
 *
 * ── What "verified" would mean ─────────────────────────────────
 *
 * Today the path is paper-correct; HiL flips it to verified when:
 *   1. WiFi associates with a real AP.
 *   2. TLS handshake completes through OPTIGA in < 1 s.
 *   3. The dashboard refreshes within 250 ms of a BME280 sample.
 *   4. The publish/connect cycle survives a 24h soak.
 * That's the v0.6 AEN HiL story.
 *
 * native_sim builds end-to-end but stubs WiFi/TLS -- runs the
 * UI logic against simulated sensor values.
 */

#include <zephyr/kernel.h>
#include <zephyr/logging/log.h>
#include <zephyr/drivers/display.h>
#include <stdio.h>

#include <lvgl.h>

#include "alp/peripheral.h"
#include "alp/iot.h"
#include "alp/chips/bme280.h"

/* EVK_I2C_BUS_SENSORS is a board-macro from the generated routes header
 * (= E1M_I2C0); rebind it in board.yaml `pins:` to port to another board. */
#include "alp/boards/alp_e1m_evk_routes.h"

#include "dashboard_ui.h"

LOG_MODULE_REGISTER(iot_dashboard, LOG_LEVEL_INF);

static bme280_t        s_env;
static alp_i2c_t      *s_i2c;
static alp_mqtt_t     *s_mqtt;

/* The shared dashboard snapshot.  Single-writer (sensor thread)
 * single-reader (main UI thread); volatile-snapshot read in
 * main() is correct without locks. */
static dashboard_state_t g_state;

K_THREAD_STACK_DEFINE(sensor_stack, 4096);
static struct k_thread   sensor_thread;

static void sensor_entry(void *p1, void *p2, void *p3)
{
    ARG_UNUSED(p1); ARG_UNUSED(p2); ARG_UNUSED(p3);
    /* Sample at 1 Hz -- BME280 is slow + customers want a
     * comfortable refresh rate on the dashboard. */
    while (1) {
        bme280_raw_t raw = {0};
        if (bme280_read_raw(&s_env, &raw) == ALP_OK) {
            bme280_compensated_t cc = {0};
            bme280_compensate(&s_env, &raw, &cc);
            g_state.temp_c       = cc.temperature_c100   / 100.f;
            g_state.humid_pct    = cc.humidity_milli_pct / 1024.f;
            g_state.pressure_hpa = cc.pressure_pa        / 100.f;
            g_state.last_update_ms = k_uptime_get_32();

            /* Push the same sample to MQTT if connected. */
            if (s_mqtt != NULL) {
                char payload[96];
                int  n = snprintf(payload, sizeof(payload),
                                  "{\"t\":%.2f,\"h\":%.1f,\"p\":%.1f}",
                                  (double)g_state.temp_c,
                                  (double)g_state.humid_pct,
                                  (double)g_state.pressure_hpa);
                if (n > 0) {
                    (void)alp_mqtt_publish(s_mqtt, "alp/env",
                                           (const uint8_t *)payload,
                                           (size_t)n,
                                           ALP_MQTT_QOS_0,
                                           /*retain=*/false);
                }
            }
        }
        k_msleep(1000);
    }
}

int main(void)
{
    LOG_INF("iot-dashboard demo starting");

    /* Sensor bus + chip bring-up. */
    s_i2c = alp_i2c_open(&(alp_i2c_config_t){
        .bus_id     = EVK_I2C_BUS_SENSORS, /* = E1M_I2C0 */
        .bitrate_hz = 400000,
    });
    if (s_i2c == NULL || bme280_init(&s_env, s_i2c, BME280_I2C_ADDR_LOW) != ALP_OK) {
        LOG_WRN("BME280 unavailable; dashboard will show zero readings");
    } else {
        bme280_set_sampling(&s_env,
                            BME280_OVERSAMPLING_X1,
                            BME280_OVERSAMPLING_X1,
                            BME280_OVERSAMPLING_X1,
                            BME280_MODE_NORMAL,
                            BME280_STANDBY_125_MS,
                            BME280_FILTER_OFF);
    }

    /* WiFi + MQTT connect.  On native_sim this drops to the
     * <alp/iot.h> NOSUPPORT stub -- the UI still runs against
     * the in-memory dashboard_state_t. */
    alp_wifi_t *wifi = alp_wifi_open();
    if (wifi) {
        (void)alp_wifi_connect(wifi, &(alp_wifi_credentials_t){
            .ssid = "alp-demo-ssid",
            .psk  = "demo-password",
        }, /*timeout_ms=*/5000);
    }
    static const alp_mqtt_tls_config_t s_tls = {0};  /* defaults: OS CA, verify peer. */
    s_mqtt = alp_mqtt_open(&(alp_mqtt_config_t){
        .broker_uri = "mqtts://broker.example.com:8883",
        .client_id  = "alp-iot-dashboard-demo",
        .tls        = &s_tls,
    });
    if (s_mqtt == NULL) {
        LOG_WRN("MQTT broker unreachable; running standalone");
    }

    /* Display + LVGL bring-up. */
    const struct device *display = DEVICE_DT_GET(DT_CHOSEN(zephyr_display));
    if (!device_is_ready(display)) {
        LOG_ERR("display %s not ready", display->name);
        return 1;
    }
    lv_init();
    dashboard_ui_build();
    display_blanking_off(display);

    /* Spawn the sensor thread. */
    k_thread_create(&sensor_thread, sensor_stack,
                    K_THREAD_STACK_SIZEOF(sensor_stack),
                    sensor_entry, NULL, NULL, NULL,
                    K_PRIO_PREEMPT(4), 0, K_NO_WAIT);
    k_thread_name_set(&sensor_thread, "env_sensor");

    /* Render loop. */
    while (1) {
        dashboard_state_t snap = g_state;
        snap.mqtt_connected = (s_mqtt != NULL);
        dashboard_ui_apply(&snap);

        const uint32_t sleep_ms = lv_task_handler();
        k_msleep(MIN(sleep_ms, 10u));
    }

    return 0;
}
```

## src/dashboard_ui.c
```c
/*
 * Copyright 2026 ALP Lab AB
 * SPDX-License-Identifier: Apache-2.0
 *
 * Dashboard layout for iot-dashboard.
 *
 * Three tiles:
 *   - Temperature (large numeric, colour-coded by range).
 *   - Humidity    (gauge with hint text).
 *   - Pressure    (sparkline showing the last 60 samples).
 *
 * Plus a status strip showing the MQTT connection state and the
 * timestamp of the last sensor update.  Refresh runs at the
 * LVGL render frequency (30 fps via prj.conf); the sensor thread
 * pushes new values once per second.
 */

#include <stdio.h>

#include <lvgl.h>

#include "dashboard_ui.h"

static lv_obj_t *s_lbl_temp;
static lv_obj_t *s_lbl_humid;
static lv_obj_t *s_lbl_pressure;
static lv_obj_t *s_lbl_status;
static lv_obj_t *s_chart;
static lv_chart_series_t *s_pressure_series;

void dashboard_ui_build(void)
{
    lv_obj_t *scr = lv_screen_active();
    lv_obj_set_style_bg_color(scr, lv_color_hex(0x101820), 0);

    /* Temperature tile. */
    s_lbl_temp = lv_label_create(scr);
    lv_obj_set_pos(s_lbl_temp, 8, 8);
    lv_obj_set_style_text_color(s_lbl_temp, lv_color_hex(0xFF6040), 0);
    lv_obj_set_style_text_font(s_lbl_temp, &lv_font_montserrat_28, 0);
    lv_label_set_text(s_lbl_temp, "--.- °C");

    /* Humidity tile. */
    s_lbl_humid = lv_label_create(scr);
    lv_obj_set_pos(s_lbl_humid, 8, 60);
    lv_obj_set_style_text_color(s_lbl_humid, lv_color_hex(0x40A0FF), 0);
    lv_obj_set_style_text_font(s_lbl_humid, &lv_font_montserrat_28, 0);
    lv_label_set_text(s_lbl_humid, "--.- %RH");

    /* Pressure numeric + sparkline. */
    s_lbl_pressure = lv_label_create(scr);
    lv_obj_set_pos(s_lbl_pressure, 8, 112);
    lv_obj_set_style_text_color(s_lbl_pressure, lv_color_hex(0xFFFFFF), 0);
    lv_label_set_text(s_lbl_pressure, "---- hPa");

    s_chart = lv_chart_create(scr);
    lv_obj_set_size(s_chart, 224, 100);
    lv_obj_set_pos(s_chart, 8, 140);
    lv_chart_set_point_count(s_chart, 60);
    lv_chart_set_range(s_chart, LV_CHART_AXIS_PRIMARY_Y, 950, 1050);
    s_pressure_series = lv_chart_add_series(s_chart,
                                            lv_color_hex(0x40FF80),
                                            LV_CHART_AXIS_PRIMARY_Y);

    /* Status strip at the bottom. */
    s_lbl_status = lv_label_create(scr);
    lv_obj_set_pos(s_lbl_status, 8, 260);
    lv_obj_set_style_text_color(s_lbl_status, lv_color_hex(0x808890), 0);
    lv_label_set_text(s_lbl_status, "MQTT: --   updated --");
}

void dashboard_ui_apply(const dashboard_state_t *s)
{
    char buf[64];

    snprintf(buf, sizeof(buf), "%5.1f °C", (double)s->temp_c);
    lv_label_set_text(s_lbl_temp, buf);

    snprintf(buf, sizeof(buf), "%5.1f %%RH", (double)s->humid_pct);
    lv_label_set_text(s_lbl_humid, buf);

    snprintf(buf, sizeof(buf), "%6.1f hPa", (double)s->pressure_hpa);
    lv_label_set_text(s_lbl_pressure, buf);

    /* Push the latest pressure into the sparkline. */
    lv_chart_set_next_value(s_chart, s_pressure_series,
                            (int32_t)s->pressure_hpa);
    lv_chart_refresh(s_chart);

    snprintf(buf, sizeof(buf), "MQTT: %s   t=%u ms",
             s->mqtt_connected ? "CONNECTED" : "offline",
             (unsigned)s->last_update_ms);
    lv_label_set_text(s_lbl_status, buf);
}
```
