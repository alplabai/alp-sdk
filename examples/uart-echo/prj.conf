## CMakeLists.txt
```
# SPDX-License-Identifier: Apache-2.0

cmake_minimum_required(VERSION 3.20)

# Resolve the alp-sdk root.  In-tree the SDK is the example's
# grandparent directory; out-of-tree customers point ALP_SDK_ROOT
# at their checkout.
if(DEFINED ENV{ALP_SDK_ROOT})
    set(ALP_SDK_ROOT $ENV{ALP_SDK_ROOT})
else()
    get_filename_component(ALP_SDK_ROOT ${CMAKE_CURRENT_SOURCE_DIR}/../.. ABSOLUTE)
endif()

find_package(Python3 REQUIRED COMPONENTS Interpreter)

set(_alp_generated ${CMAKE_BINARY_DIR}/generated/alp.conf)
execute_process(
    COMMAND ${Python3_EXECUTABLE} ${ALP_SDK_ROOT}/scripts/alp_project.py
            --input ${CMAKE_CURRENT_SOURCE_DIR}/board.yaml
            --emit zephyr-conf
            --output ${_alp_generated}
    RESULT_VARIABLE _alp_rv
    OUTPUT_VARIABLE _alp_stdout
    ERROR_VARIABLE  _alp_stderr
)
if(NOT _alp_rv EQUAL 0)
    message(FATAL_ERROR
        "alp_project.py failed (rv=${_alp_rv}); "
        "check ${CMAKE_CURRENT_SOURCE_DIR}/board.yaml.\n"
        "stderr: ${_alp_stderr}")
endif()

# Layer generated CONFIG_* over prj.conf via OVERLAY_CONFIG.
list(APPEND OVERLAY_CONFIG ${_alp_generated})

find_package(Zephyr REQUIRED HINTS $ENV{ZEPHYR_BASE})
project(uart_echo LANGUAGES C)

target_sources(app PRIVATE src/main.c)
```

## prj.conf
```kconfig
# SPDX-License-Identifier: Apache-2.0

CONFIG_ALP_SDK=y
CONFIG_SERIAL=y
CONFIG_LOG=y
CONFIG_PRINTK=y
CONFIG_THREAD_LOCAL_STORAGE=y
```

## boards/native_sim_native_64.overlay
```dts
/*
 * Copyright 2026 ALP Lab AB
 * SPDX-License-Identifier: Apache-2.0
 *
 * Wire native_sim's host-stdin/stdout UART to alp-uart0 so the
 * example exercises a real (host-mediated) byte path.  On real
 * silicon the alias points at a SoC USART node.
 */

/ {
    aliases {
        alp-uart0 = &uart0;
    };
};
```

## src/main.c
```c
/*
 * Copyright 2026 ALP Lab AB
 * SPDX-License-Identifier: Apache-2.0
 *
 * uart-echo — read bytes from the console UART and write them back.
 *
 * In CI we don't actually feed input, so the example does a single
 * non-blocking read with a short timeout to exercise the read path
 * then exits cleanly so the twister console harness can assert
 * `[uart] done`.  On a real terminal you'd see the static greeting
 * written to stdout and any keys you typed echoed back if you
 * extended the loop.
 */

#include <stdio.h>

#include "alp/peripheral.h"

/* EVK_UART_PORT_DEBUG is a board-macro from the generated routes
 * header (= E1M_UART0); rebind it in board.yaml `pins:` to port this
 * app to another board without touching the code below. */
#include "alp/boards/alp_e1m_evk_routes.h"

int main(void) {
    printf("[uart] open EVK_UART_PORT_DEBUG @ 115200 8N1\n");

    /* The 8-N-1 framing is the lowest common denominator for serial
     * consoles -- 8 data bits, no parity, 1 stop bit.  Override
     * data_bits / parity / stop_bits when interfacing with chips
     * that demand a non-standard framing (some industrial PLCs use
     * 7-E-1, RS-485 buses with multidrop addressing use 9-bit
     * frames, etc.). */
    alp_uart_t *u = alp_uart_open(&(alp_uart_config_t){
        .port_id   = EVK_UART_PORT_DEBUG, /* = E1M_UART0 */
        .baudrate  = 115200,
        .data_bits = 8,
        .stop_bits = 1,
        .parity    = ALP_UART_PARITY_NONE,
    });
    if (u == NULL) {
        /* No alp-uart0 alias on this build -> NULL handle.
         * On native_sim with the overlay we ship, the alias maps
         * to the host-stdin/stdout virtual UART so this branch
         * isn't taken. */
        printf("[uart] open failed: alp_last_error=%d\n",
               (int)alp_last_error());
        printf("[uart] done\n");
        return 0;
    }

    /* Read with a 50 ms timeout -- plenty for an interactive
     * terminal but short enough that CI doesn't stall.  The byte
     * value is meaningful only when status==ALP_OK; otherwise the
     * caller must treat it as unspecified. */
    uint8_t b = 0;
    alp_status_t s = alp_uart_read(u, &b, 1, 50);
    printf("[uart] read -> status=%d byte=0x%02x\n", (int)s, b);

    /* Write a known greeting so a human running the example on
     * real hardware sees output.  alp_uart_write blocks until the
     * full buffer is sent or the driver returns an error. */
    static const uint8_t hello[] = "[uart] hello\r\n";
    s = alp_uart_write(u, hello, sizeof hello - 1);
    printf("[uart] write -> %d\n", (int)s);

    /* Close releases the handle but does NOT power down the
     * peripheral or drop the line -- on real hardware the UART
     * keeps running idle high.  If you need to truly shut down,
     * disable the corresponding Zephyr device via PM API after
     * close. */
    alp_uart_close(u);
    printf("[uart] done\n");
    return 0;
}
```
