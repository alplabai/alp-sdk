## examples/aen/aen-hp-core-smoke/testcase.yaml
```yaml
# SPDX-License-Identifier: Apache-2.0
#
# Build-only regression for the M55-HP first-light smoke on the REAL HP board
# target, BENCH-VERIFIED PASS on E8 2026-06-17: SES-booted as an M55_HP ATOC, the
# HP core reached main() and ran an advancing SRAM0 liveness beacon (the second
# M55's first light).
#
# This scenario compile-checks the HP image on the AEN801 M55-HP board (the only
# alp-sdk app targeting the SECOND M55).  It is intentionally filtered OUT of the
# native_sim PR gate: the only platform allowed is the HP board, which the
# native_sim twister run never selects, so it adds a board-target build check
# without slowing the gate.
#
# NOTE: the platform id below MUST match the board .yaml `identifier` exactly
# (zephyr/boards/alp/e1m_aen801_m55_hp/..._rtss_hp.yaml) or twister silently
# skips the scenario.

sample:
  name: aen-hp-core-smoke
  description: |
    M55-HP (RTSS-HP) first-light smoke for the E1M-AEN801 (Alif Ensemble E8): the
    first alp-sdk image on the SECOND M55, SES-booted as an M55_HP ATOC
    (loadAddress 0x50000000).  Proves the HP core runs by writing an advancing
    liveness beacon to global SRAM0, read over the system AXI/HE debug AP.
    BENCH-VERIFIED PASS on E8 (2026-06-17).

tests:
  alp_sdk.examples.aen.hp_core_smoke.aen:
    platform_allow:
      - alp_e1m_aen801_m55_hp/ae822fa0e5597ls0/rtss_hp
    tags:
      - alp-sdk
      - example
      - aen
      - multicore
      - rtss-hp
    build_only: true   # the HP first-light run is a Flow-D ATOC flash, not a CI run.
```

## examples/aen/aen-hwsem-regcheck/testcase.yaml
```yaml
# SPDX-License-Identifier: Apache-2.0
#
# Build-only regression for the in-tree alif,hwsem HWSEM driver
# (zephyr/drivers/misc/alif_hwsem/hwsem_alif.c), vendor-ext, BENCH-UNVERIFIED:
# the take/give API acquires HWSEM instance 0 and the REL count tracks
# take(->nonzero)/give(->0).  Single-core acquire/release smoke; dual-core
# arbitration is the fuller test (see README).
#
# Compile-checks the driver + DT node on the real E8 board target; filtered OUT
# of the native_sim PR gate (platform_allow = the AEN801 HE board only -- the
# M55-only HWSEM block has no native_sim model).

sample:
  name: aen-hwsem-regcheck
  description: |
    Bench RAM-run HWSEM (alif,hwsem) take/give proof for the E1M-AEN801 (Alif
    Ensemble E8, Cortex-M55-HE): binds hwsem@4902e000 via the alp-sdk in-tree
    alif,hwsem driver and confirms the AMP request/release latch acquires and
    releases through the take/give API.  vendor-ext, BENCH-UNVERIFIED.

tests:
  alp_sdk.examples.aen.hwsem_regcheck.aen:
    platform_allow:
      - alp_e1m_aen801_m55_he/ae822fa0e5597ls0/rtss_he
    tags:
      - alp-sdk
      - example
      - aen
      - hwsem
      - mproc
    build_only: true   # the HWSEM take/give check is a bench flash, not a CI run.
```

## examples/aen/aen-jpeg-regcheck/testcase.yaml
```yaml
# SPDX-License-Identifier: Apache-2.0
#
# aen-jpeg-regcheck -- <alp/jpeg.h> backend-selection proof: the software
# baseline (src/backends/jpeg/sw_baseline.c) runs for real on native_sim; the
# Alif Hantro VC9000E hardware backend (src/backends/jpeg/alif_hantro.c) is
# build_only in CI for the E1M-AEN801 (Ensemble E8, M55-HE) -- the HW encode
# path is SILICON-PROVEN on real AEN801 hardware (valid 935-byte JPEG), but
# needs a bench flash to run, so CI builds it rather than executing it.

sample:
  name: aen-jpeg-regcheck
  description: |
    Opens <alp/jpeg.h>, prints the selected backend's capabilities
    (hw_accelerated), encodes a synthetic 64x64 gradient 4:2:0 frame, and
    checks the output for the JPEG SOI marker (FF D8).  Two scenarios
    exercise the two backends this class currently ships:
      - native_sim: the portable TooJpeg-derived software fallback
        (sw_baseline.c, priority 50) -- runs for real in CI.
      - aen: the Alif Ensemble E8 Hantro VC9000E hardware backend
        (alif_hantro.c, priority 100) -- build_only in CI; HW encode is
        silicon-proven on real AEN801 (valid 935-byte JPEG).

tests:
  alp_sdk.examples.aen.jpeg_regcheck.native_sim:
    platform_allow:
      - native_sim/native/64
    integration_platforms:
      - native_sim/native/64
    extra_configs:
      # native_sim has no jpeg0 DT node (Alif-E8-only silicon) -- explicitly
      # disable the HW backend + its driver Kconfigs rather than rely on the
      # unmet-dependency auto-disable, so the merged .config carries no
      # dangling `=y` for a symbol this platform can't satisfy.  sw_baseline
      # (default y, priority 50) is the only backend left standing.
      - CONFIG_VIDEO_JPEG_HANTRO_VC9000E=n
      - CONFIG_USE_ALIF_JPEG_SW_LIB=n
      - CONFIG_ALP_SDK_JPEG_ALIF_HANTRO=n
    tags:
      - alp-sdk
      - example
      - aen
      - jpeg
      - video
    harness: console
    harness_config:
      type: one_line
      regex:
        - "RESULT PASS"

  alp_sdk.examples.aen.jpeg_regcheck.aen:
    platform_allow:
      - alp_e1m_aen801_m55_he/ae822fa0e5597ls0/rtss_he
    build_only: true   # HW encode is a bench flash, not a CI run (silicon-proven on AEN801).
    tags:
      - alp-sdk
      - example
      - aen
      - jpeg
      - video
```

## examples/aen/aen-lptimer-regcheck/testcase.yaml
```yaml
# SPDX-License-Identifier: Apache-2.0
#
# Build-only regression for the Tier-1.5 alif,lptimer LPTIMER counter driver
# (counter_alif_lptimer.c).  BENCH-UNVERIFIED: the lptimer@42001000 channel-0
# free-running DOWN-counter advance check is a bench flash, not a CI run.
#
# Compile-checks the driver + DT node on the real E8 board target; filtered OUT
# of the native_sim PR gate (platform_allow = the AEN801 HE board only).

sample:
  name: aen-lptimer-regcheck
  description: |
    Bench RAM-run LPTIMER (alif,lptimer) counter proof for the E1M-AEN801 (Alif
    Ensemble E8, Cortex-M55-HE): binds lptimer@42001000 channel 0 via the
    alp-sdk Tier-1.5 counter_alif_lptimer driver and confirms the free-running
    DOWN-counter advances through the portable Zephyr counter_* API.
    BENCH-UNVERIFIED.

tests:
  alp_sdk.examples.aen.lptimer_regcheck.aen:
    platform_allow:
      - alp_e1m_aen801_m55_he/ae822fa0e5597ls0/rtss_he
    tags:
      - alp-sdk
      - example
      - aen
      - counter
      - lptimer
    build_only: true   # the LPTIMER advance check is a bench flash, not a CI run.
```

## examples/aen/aen-mram-flash-validate/testcase.yaml
```yaml
# SPDX-License-Identifier: Apache-2.0
#
# Bench slot0 SES-boot MRAM flash erase/program/readback proof for the
# E1M-AEN801 (Alif Ensemble E8, Cortex-M55-HE): drives the alp-sdk Tier-2
# flash_mram_alif driver ("alif,mram-flash-controller") through the portable
# Zephyr flash_* API against the safe `storage` partition (person_detect slot0
# restored after).  Closes issue #512.
#
# Compile-checks the driver + DT node on the real E8 board target; filtered OUT
# of the native_sim PR gate (platform_allow = the AEN801 HE board only).

sample:
  name: aen-mram-flash-validate
  description: |
    Bench slot0 SES-boot MRAM flash (alif,mram-flash-controller)
    erase/program/readback proof for the E1M-AEN801 (Alif Ensemble E8,
    Cortex-M55-HE): exercises the alp-sdk Tier-2 flash_mram_alif driver through
    the portable Zephyr flash_* class API against the safe `storage`
    fixed-partition and verifies the written pattern byte-exact.  Flow-D slot0
    flash; the canonical person_detect slot0 is restored after the run.

tests:
  alp_sdk.examples.aen.mram_flash_validate.aen:
    platform_allow:
      - alp_e1m_aen801_m55_he/ae822fa0e5597ls0/rtss_he
    tags:
      - alp-sdk
      - example
      - aen
      - flash
      - mram
    build_only: true   # the erase/program/readback check is a bench flash, not a CI run.
```

## examples/aen/aen-power-iwic/testcase.yaml
```yaml
# SPDX-License-Identifier: Apache-2.0
#
# Build-only regression for the Stage-B PM deep-sleep (suspend-to-idle / IWIC)
# example on the E1M-AEN801 (Alif Ensemble E8, M55-HE).  BENCH-PENDING: the
# deep-IWIC-enter / SysTick-wake proof is a bench flash + SWD read, not a CI run.
#
# This scenario compile-checks the Stage-B PM bring-up on the REAL E8 board
# target (it cannot run in CI -- the M55 has no native_sim host):
#   - CONFIG_PM=y is REACHABLE (the app Kconfig `select HAS_PM` over the pinned
#     tree, which neither selects HAS_PM nor ships a pm_state_set) and LINKS
#     (src/alif_pm_iwic.c supplies pm_state_set/pm_state_exit_post_ops);
#   - the suspend_idle zephyr,power-state + cpu0 cpu-power-states (board overlay)
#     enter the devicetree, so the PM policy can select PM_STATE_SUSPEND_TO_IDLE;
#   - the RAM-console retarget + ITCM RAM-run overlay link.
# It is intentionally filtered to the AEN801 M55-HE board only, which the
# native_sim PR gate never selects, so it adds a board-target build check
# without slowing the gate.
#
# NOTE: the platform id below MUST match the board .yaml `identifier` exactly
# (zephyr/boards/alp/e1m_aen801_m55_he/..._rtss_he.yaml) or twister silently
# skips the scenario.

sample:
  name: aen-power-iwic
  description: |
    Stage-B PM deep-sleep for the E1M-AEN801 (Alif Ensemble E8, Cortex-M55-HE):
    brings a minimal Alif PM up over the pinned Zephyr 4.4.0 tree (which ships no
    Alif pm_state_set and does not select HAS_PM) and enters the CONFIG_PM
    suspend-to-idle (deep IWIC sleep) state repeatedly via the kernel idle path,
    proving the core parks via the AON WICCONTROL register (0x1A604010, bit8 WIC
    / bit9 IWIC) and SysTick wakes it (a beacon in global SRAM0 at 0x02000000 and
    k_uptime_get advance across each sleep).  Stage-B of aen-power-smoke.
    BENCH-PENDING.

tests:
  alp_sdk.examples.aen.power_iwic.aen:
    platform_allow:
      - alp_e1m_aen801_m55_he/ae822fa0e5597ls0/rtss_he
    extra_args:
      - EXTRA_DTC_OVERLAY_FILE=boards/alp_e1m_aen801_m55_he.overlay
    tags:
      - alp-sdk
      - example
      - aen
      - power
      - pm
    build_only: true   # deep IWIC enter + SysTick wake is a bench flash, not a CI run.
```

## examples/aen/aen-power-smoke/testcase.yaml
```yaml
# SPDX-License-Identifier: Apache-2.0
#
# Build-only regression for the Stage-A low-power smoke (periodic k_timer wake +
# k_cpu_idle / WFI with a SysTick wake) on the E1M-AEN801 (Alif Ensemble E8,
# M55-HE).  BENCH-PENDING: the WFI-enter/SysTick-wake proof is a bench flash +
# SWD read, not a CI run.
#
# This scenario compile-checks the Stage-A app on the REAL E8 board target (it
# cannot run in CI -- the M55 has no native_sim host):
#   - k_timer/k_sem/k_cpu_idle()/k_uptime_get() link against the arch idle path;
#   - the RAM-console retarget + ITCM RAM-run overlay link with NO PM subsystem
#     (Stage-A is intentionally CONFIG_PM-free; HAS_PM is unselected upstream).
# It is intentionally filtered to the AEN801 M55-HE board only, which the
# native_sim PR gate never selects, so it adds a board-target build check
# without slowing the gate.
#
# NOTE: the platform id below MUST match the board .yaml `identifier` exactly
# (zephyr/boards/alp/e1m_aen801_m55_he/..._rtss_he.yaml) or twister silently
# skips the scenario.

sample:
  name: aen-power-smoke
  description: |
    Stage-A low-power smoke for the E1M-AEN801 (Alif Ensemble E8, Cortex-M55-HE):
    enters the architectural WFI sleep via a periodic k_timer wake + k_cpu_idle()
    repeatedly and proves the SysTick system clock wakes the core each time (a
    beacon/heartbeat in global SRAM0 at 0x02000000 and k_uptime_get advance
    across each sleep).  WFI-equivalent baseline for the Stage-B board
    pm_state_set IWIC hook.  CONFIG_PM-free: pinned upstream Zephyr's Alif E8 SoC
    does not select HAS_PM (only the zephyr_alif fork does).  BENCH-PENDING.

tests:
  alp_sdk.examples.aen.power_smoke.aen:
    platform_allow:
      - alp_e1m_aen801_m55_he/ae822fa0e5597ls0/rtss_he
    tags:
      - alp-sdk
      - example
      - aen
      - power
      - pm
    build_only: true   # WFI enter + SysTick wake is a bench flash, not a CI run.
```

## examples/aen/aen-rtc-calendar/testcase.yaml
```yaml
# SPDX-License-Identifier: Apache-2.0
#
# Build-only regression for the E8 LPRTC counter->calendar shim
# (src/backends/rtc/lprtc_calendar_shim.c): compile-checks the alp_rtc_*
# calendar surface layered over the always-on snps,dw-apb-rtc COUNTER on the real
# E8 board target.  Filtered OUT of the native_sim PR gate (platform_allow = the
# AEN801 HE board only); the on-silicon advance proof is a bench flash, not a CI
# run.  Pairs with aen-rtc-regcheck (the raw counter proof underneath).

sample:
  name: aen-rtc-calendar
  description: |
    Bench RAM-run LPRTC calendar-shim proof for the E1M-AEN801 (Alif Ensemble
    E8, Cortex-M55-HE): exercises the portable alp_rtc_set_time()/get_time()
    surface over the lprtc@42000000 free-running COUNTER via the alp-sdk
    "lprtc_calendar_shim" rtc backend, and confirms the calendar advances with
    the counter.

tests:
  alp_sdk.examples.aen.rtc_calendar.aen:
    platform_allow:
      - alp_e1m_aen801_m55_he/ae822fa0e5597ls0/rtss_he
    tags:
      - alp-sdk
      - example
      - aen
      - rtc
      - counter
    build_only: true   # the calendar advance check is a bench flash, not a CI run.
```

## examples/aen/aen-rtc-regcheck/testcase.yaml
```yaml
# SPDX-License-Identifier: Apache-2.0
#
# Build-only regression for the Tier-2 snps,dw-apb-rtc LPRTC counter driver
# (counter_dw_rtc.c), BENCH-VERIFIED PASS on E8 2026-06-17: the lprtc@42000000
# free-running counter advances (delta=3467 ticks/100ms, 32768 Hz), the VBAT
# clock-gate is already on (counter_start -> -EALREADY).
#
# Compile-checks the driver + DT node on the real E8 board target; filtered OUT
# of the native_sim PR gate (platform_allow = the AEN801 HE board only).

sample:
  name: aen-rtc-regcheck
  description: |
    Bench RAM-run LPRTC (snps,dw-apb-rtc) counter proof for the E1M-AEN801 (Alif
    Ensemble E8, Cortex-M55-HE): binds lprtc@42000000 via the alp-sdk Tier-2
    counter_dw_rtc driver and confirms the free-running counter advances through
    the portable Zephyr counter_* API.  BENCH-VERIFIED PASS on E8 (2026-06-17).

tests:
  alp_sdk.examples.aen.rtc_regcheck.aen:
    platform_allow:
      - alp_e1m_aen801_m55_he/ae822fa0e5597ls0/rtss_he
    tags:
      - alp-sdk
      - example
      - aen
      - counter
      - rtc
    build_only: true   # the LPRTC advance check is a bench flash, not a CI run.
```

## examples/aen/edgeai-vision-aen/testcase.yaml
```yaml
# SPDX-License-Identifier: Apache-2.0

sample:
  name: edgeai-vision-aen
  description: |
    EdgeAI vision reference application for the E1M-AEN family.
    v0.1: skeleton — compiles under native_sim and prints the
    pipeline stages with v0.2 stubs.

tests:
  alp_sdk.example.edgeai_vision_aen.skeleton:
    platform_allow:
      - native_sim
      - native_sim/native/64
    integration_platforms:
      - native_sim/native/64
    tags:
      - alp-sdk
      - example
      - edgeai
    build_only: false
    harness: console
    harness_config:
      type: one_line
      regex:
        - "\\[edgeai\\] done"

  # alp_sdk.example.edgeai_vision_aen.evk_aen — HW-in-loop variant
  # for the E1M EVK populated with an E1M-AEN801 SoM. The real board
  # target, alp_e1m_aen801_m55_he/ae822fa0e5597ls0/rtss_he, ships
  # in-tree under zephyr/boards/alp/ -- this scenario stays parked
  # pending HW-in-loop CI wiring, not a missing board file. The
  # overlay at boards/alp_e1m_aen801_m55_he.overlay is already in
  # place.
```
