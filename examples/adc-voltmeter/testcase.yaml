## examples/adc-voltmeter/testcase.yaml
```yaml
# SPDX-License-Identifier: Apache-2.0

sample:
  name: adc-voltmeter
  description: |
    Per-peripheral example for <alp/adc.h>.  Demonstrates open /
    capability-validation / read_uv / close on E1M_ADC0.

tests:
  alp_sdk.example.adc_voltmeter:
    platform_allow:
      - native_sim
      - native_sim/native/64
    integration_platforms:
      - native_sim/native/64
    tags:
      - alp-sdk
      - example
      - adc
      harness: console
  harness_config:
      type: one_line
      regex:
        - "\\[adc\\] done"
```

## examples/aen/aen-analog-validate/testcase.yaml
```yaml
# SPDX-License-Identifier: Apache-2.0

sample:
  name: aen-analog-validate
  description: |
    DAC0 -> ADC loopback on-silicon analog validation for the E1M-AEN801
    (Alif Ensemble E8, M55-HE), driven through the SoM-portable <alp/dac.h> +
    <alp/adc.h> surface.  Drives a millivolt setpoint on dac0 (alif,dac,
    0.750 V VREF) and reads it back through adc12_0 (alif,adc, 1.8 V VREF),
    asserting the readback tracks the setpoint within tolerance.

tests:
  # Compile-only on native_sim: the alp-dac0 / alp-adc0 aliases + the
  # adc12_0/dac0 nodes only exist in the E8 board overlay (auto-applied by board
  # name), so on native_sim the portable opens just return NOT_READY -- the value
  # of the gate is that the portable <alp/*> source builds clean off-target.
  # The real DAC->ADC loopback is a bench RAM-run on alp_e1m_aen801_m55_he.
  alp_sdk.examples.aen.analog_validate.native_sim:
    platform_allow:
      - native_sim/native/64
    tags:
      - alp-sdk
      - example
      - aen
      - adc
      - dac
      - analog
    build_only: true
```

## examples/aen/aen-cc3501e-ble-gatt/testcase.yaml
```yaml
# SPDX-License-Identifier: Apache-2.0

sample:
  name: aen-cc3501e-ble-gatt
  description: |
    Bench proof of the #480 CC3501E BLE GATT-SERVER path through the
    portable <alp/ble.h> surface on the E1M-AEN801 (Alif Ensemble E8,
    M55-HE): open the radio, register a service, advertise, then exercise
    gatt read/write/notify with NO live central peer on this bench. Prints
    a single RESULT PASS:/RESULT FAIL: line (RAM console -- see board.yaml
    diagnostics.console: ram).

tests:
  alp_sdk.examples.aen.cc3501e_ble_gatt.native_sim:
    platform_allow:
      - native_sim/native/64
    tags:
      - alp-sdk
      - example
      - aen
      - cc3501e
      - ble
      - gatt
    build_only: true
```

## examples/aen/aen-cc3501e-bringup/testcase.yaml
```yaml
# SPDX-License-Identifier: Apache-2.0

sample:
  name: aen-cc3501e-bringup
  description: |
    Host (Alif M55-HE) side of the on-module TI CC3501E Wi-Fi 6 + BLE 5.4
    coprocessor bring-up: drive WIFI_EN + E_WIFI.NRST to power+reset the
    CC3501E, then PING / GET_VERSION / GET_DIAG_INFO over the inter-chip
    SPI1 link via the chips/cc3501e host driver. AEN analog of
    v2n-gd32-bridge-ping.

tests:
  alp_sdk.examples.aen.cc3501e_bringup.native_sim:
    platform_allow:
      - native_sim/native/64
    tags:
      - alp-sdk
      - example
      - aen
      - cc3501e
      - wifi
      - ble
    build_only: true
```

## examples/aen/aen-cc3501e-companion-tour/testcase.yaml
```yaml
# SPDX-License-Identifier: Apache-2.0

sample:
  name: aen-cc3501e-companion-tour
  description: |
    Capstone full-surface tour of the on-module TI CC3501E Wi-Fi 6 + BLE 5.4
    companion API from the Alif Ensemble E8 host (M55-HE): init -> ping ->
    diag -> Wi-Fi scan/connect/IP -> a TCP socket round-trip -> Wi-Fi
    teardown -> BLE enable/scan/disable -> a proxied-GPIO read.  Each step
    is guarded and failures print + continue -- it is a teaching demo of the
    hand-written-firmware path, not a pass/fail gate.

tests:
  alp_sdk.examples.aen.cc3501e_companion_tour.native_sim:
    platform_allow:
      - native_sim/native/64
    tags:
      - alp-sdk
      - example
      - aen
      - cc3501e
      - wifi
      - ble
      - sockets
    build_only: true
```

## examples/aen/aen-cc3501e-gpio/testcase.yaml
```yaml
# SPDX-License-Identifier: Apache-2.0

sample:
  name: aen-cc3501e-gpio
  description: |
    Host (Alif M55-HE) side of the on-module TI CC3501E Wi-Fi 6 + BLE 5.4
    coprocessor GPIO proxy + camera-enable demo: bring up the inter-chip
    SPI1 bridge, then configure / drive / read a proxied CC3501E GPIO and
    enable + disable the camera-enable LDOs over the bridge via the
    portable cc3501e_gpio_* / cc3501e_cam_enable host API.

tests:
  alp_sdk.examples.aen.cc3501e_gpio.native_sim:
    platform_allow:
      - native_sim/native/64
    tags:
      - alp-sdk
      - example
      - aen
      - cc3501e
      - gpio
    build_only: true
```

## examples/aen/aen-cmp-regcheck/testcase.yaml
```yaml
# SPDX-License-Identifier: Apache-2.0
#
# Build-only regression for the Tier-2 alif,cmp HSCMP comparator driver
# (comparator_alif.c) -- a clean-room driver implementing the upstream Zephyr
# v4.4 comparator class API over cmp0@49023000, with the DAC6 on-chip reference
# on the negative terminal (internal-reference smoke -- no external wiring).
#
# Compile-checks the driver + DT node on the real E8 board target; filtered OUT
# of the native_sim PR gate (platform_allow = the AEN801 HE board only).
# BENCH-UNVERIFIED.

sample:
  name: aen-cmp-regcheck
  description: |
    Bench RAM-run HSCMP (alif,cmp) analog-comparator proof for the E1M-AEN801
    (Alif Ensemble E8, Cortex-M55-HE): binds cmp0@49023000 via the alp-sdk
    Tier-2 comparator_alif driver and drives it through the portable Zephyr
    comparator_* API against the on-chip DAC6 internal reference (no external
    wiring).  BENCH-UNVERIFIED.

tests:
  alp_sdk.examples.aen.cmp_regcheck.aen:
    platform_allow:
      - alp_e1m_aen801_m55_he/ae822fa0e5597ls0/rtss_he
    tags:
      - alp-sdk
      - example
      - aen
      - comparator
      - cmp
      - analog
    build_only: true   # the HSCMP smoke is a bench flash, not a CI run.
```

## examples/aen/aen-counter-alarm-regcheck/testcase.yaml
```yaml
# SPDX-License-Identifier: Apache-2.0
#
# Build-only regression for the Tier-1.5 UTIMER counter alarm path
# (counter_alif_utimer.c set_alarm + irq_cfg), BENCH-VERIFIED PASS on E8
# 2026-06-17: the COMPARE-A one-shot alarm fires + re-arms (fired=2).
#
# This scenario compile-checks the alarm wire-up on the REAL E8 board target (it
# cannot run in CI -- the M55 has no native_sim host and no UTIMER on the gate):
#   - the alif,utimer parent + alif,utimer-counter child bind and instantiate the
#     counter device (DT_HAS_ALIF_UTIMER_COUNTER -> CONFIG_COUNTER_ALIF_UTIMER),
#   - set_alarm's COMPARE_A_BUF1 shadow write + the comp_a_buf1 IRQ_CONNECT (the
#     two bring-up fixes) compile against the hal_alif register library,
#   - the board overlay's ITCM RAM-run retarget (zephyr,flash = &itcm) links.
# It is intentionally filtered OUT of the native_sim PR gate: the only platform
# allowed is the AEN801 M55-HE board, which the native_sim twister run never
# selects, so this adds a board-target build check without slowing the gate.
#
# NOTE: the platform id below MUST match the board .yaml `identifier` exactly
# (zephyr/boards/alp/e1m_aen801_m55_he/..._rtss_he.yaml) or twister silently
# skips the scenario.

sample:
  name: aen-counter-alarm-regcheck
  description: |
    Bench RAM-run UTIMER COMPARE-A alarm proof for the E1M-AEN801 (Alif Ensemble
    E8, Cortex-M55-HE): arms a relative one-shot alarm through the portable
    Zephyr counter_set_channel_alarm path over the alp-sdk Tier-1.5
    counter_alif_utimer driver and confirms the callback fires + re-arms.  Guards
    the two bring-up fixes (COMPARE_A_BUF1 shadow write + comp_a_buf1 IRQ line).
    BENCH-VERIFIED PASS on E8 (2026-06-17).

tests:
  alp_sdk.examples.aen.counter_alarm_regcheck.aen:
    platform_allow:
      - alp_e1m_aen801_m55_he/ae822fa0e5597ls0/rtss_he
    tags:
      - alp-sdk
      - example
      - aen
      - counter
      - utimer
    build_only: true   # no UTIMER in CI; the alarm fire is a bench flash, not a run.
```

## examples/aen/aen-crc-regcheck/testcase.yaml
```yaml
# SPDX-License-Identifier: Apache-2.0
#
# Build-only regression for the clean-room alif,crc CRC-engine driver
# (crc_alif.c).  BENCH-UNVERIFIED: the on-silicon reflect/invert post-processing
# order is the open bench-confirm item (see the README / main.c note); the CI
# gate only compile-checks the driver + DT node on the real E8 board target.
#
# Filtered OUT of the native_sim PR gate (platform_allow = the AEN801 HE board
# only).

sample:
  name: aen-crc-regcheck
  description: |
    Bench RAM-run CRC-engine (alif,crc) proof for the E1M-AEN801 (Alif Ensemble
    E8, Cortex-M55-HE): binds crc0@48107000 via the alp-sdk clean-room crc_alif
    driver, computes CRC32_IEEE over a fixed 16-byte buffer through the portable
    Zephyr CRC class API (crc_begin/update/finish), and compares against a
    host-precomputed reference (0x684FC31C).  BENCH-UNVERIFIED.

tests:
  alp_sdk.examples.aen.crc_regcheck.aen:
    platform_allow:
      - alp_e1m_aen801_m55_he/ae822fa0e5597ls0/rtss_he
    tags:
      - alp-sdk
      - example
      - aen
      - crc
    build_only: true   # the CRC-value check is a bench flash, not a CI run.
```

## examples/aen/aen-eeprom-manifest/testcase.yaml
```yaml
# SPDX-License-Identifier: Apache-2.0

sample:
  name: aen-eeprom-manifest
  description: |
    Read + decode the 128-byte Alp hardware-info manifest from the on-module
    24C128 EEPROM on the E1M-AEN (Alif Ensemble) SoM, via the portable <alp/*>
    API. AEN sibling of v2n-eeprom-manifest-dump; EEPROM on SoC I2C2 (i2c_dw).

tests:
  alp_sdk.examples.aen.eeprom_manifest.native_sim:
    platform_allow:
      - native_sim/native/64
    tags:
      - alp-sdk
      - example
      - aen
      - eeprom
      - hw-info
    build_only: true
```

## examples/aen/aen-ethernet-link/testcase.yaml
```yaml
# SPDX-License-Identifier: Apache-2.0
#
# Build-only regression for the Tier-1.5 Alif Ensemble GMAC glue (eth_dwmac_alif,
# BENCH-VERIFIED PASS on E8 2026-06-17: real DHCP lease, server-side REACHABLE).
#
# This scenario compile-checks the full Ethernet wire-up on the REAL E8 board
# target (it cannot run in CI -- the M55 has no native_sim host and there is no
# Ethernet HW in the PR gate):
#   - the `alif,ethernet` DT node binds + enables CONFIG_ETH_DWMAC_ALIF (which in
#     turn selects the upstream eth_dwmac core),
#   - the glue's clock/pinctrl/IRQ wire-up and the descriptor-ring BUILD_ASSERT
#     (cache-coherency guard) compile,
#   - the board overlay's DMA-buffer placement (chosen zephyr,sram = &sram0,
#     CONFIG_DCACHE=n) is consistent.
# It is intentionally filtered OUT of the native_sim PR gate: the only platform
# allowed is the AEN801 M55-HE board, which the native_sim twister run never
# selects, so this adds a board-target build check without slowing the gate.
#
# NOTE: the platform id below MUST match the board .yaml `identifier` exactly
# (zephyr/boards/alp/e1m_aen801_m55_he/..._rtss_he.yaml) or twister silently
# skips the scenario.

sample:
  name: aen-ethernet-link
  description: |
    Bench RAM-run Ethernet (GMAC) link proof for the E1M-AEN801 (Alif Ensemble
    E8, Cortex-M55-HE): brings up the upstream eth_dwmac core via the alp-sdk
    Tier-1.5 alif,ethernet glue and pulls a DHCP lease off the bench switch.
    DMA descriptor rings + net_buf pool placed in global SRAM0 (zephyr,sram =
    &sram0) with CONFIG_DCACHE=n.  BENCH-VERIFIED PASS on E8 (2026-06-17).

tests:
  alp_sdk.examples.aen.ethernet_link.aen:
    platform_allow:
      - alp_e1m_aen801_m55_he/ae822fa0e5597ls0/rtss_he
    tags:
      - alp-sdk
      - example
      - aen
      - ethernet
      - dwmac
    build_only: true   # no Ethernet HW in CI; end-to-end is a bench flash, not a run.

  # Compile-only proof for the new snps,designware-mdio controller
  # (mdio_dwmac_alif.c, ADR 0017 Tier-1.5, BUILD-ONLY -- no MDIO-managed PHY
  # exercised on real E8 silicon this batch). mdio-managed.overlay repoints
  # &ethernet's phy-handle from the fixed-link eth_phy to the mdio-managed
  # eth_phy_managed (ti,dp83825): closes that the MDIO driver binds,
  # phy_ti_dp83825 binds on the bus, and the upstream eth_dwmac core's
  # phy_link path compiles with a managed PHY. Same reasons as the sibling
  # scenario above for build_only + the single AEN801 platform_allow.
  alp_sdk.examples.aen.ethernet_link.aen.mdio_managed:
    platform_allow:
      - alp_e1m_aen801_m55_he/ae822fa0e5597ls0/rtss_he
    # NOTE: twister's extra_dtc_overlay_files maps to CMake DTC_OVERLAY_FILE
    # (NOT EXTRA_DTC_OVERLAY_FILE), which REPLACES rather than supplements
    # CMake's own board-default-overlay auto-discovery -- so the board's
    # default overlay must be listed explicitly here too, or the mdio-managed
    # build silently loses it (gpio11/lpgpio, pinctrl_eth, chosen zephyr,sram
    # all live there) and fails downstream on an unrelated undeclared-device
    # error.
    extra_dtc_overlay_files:
      - boards/alp_e1m_aen801_m55_he_ae822fa0e5597ls0_rtss_he.overlay
      - mdio-managed.overlay
    tags:
      - alp-sdk
      - example
      - aen
      - ethernet
      - dwmac
      - mdio
    build_only: true   # compile-proof only; MDIO-managed PHY not bench-verified.
```

## examples/aen/aen-gpu2d-bench/testcase.yaml
```yaml
# SPDX-License-Identifier: Apache-2.0
#
# Build-only regression for the GPU2D bench example on the REAL E8 board target,
# BENCH-VERIFIED PASS on E8 2026-06-17: the portable <alp/gpu2d.h> sw_fallback
# (fill_rect / blit / blend REPLACE/SRC_OVER/ADDITIVE/MULTIPLY) runs on M55-HE
# silicon with exact-value-correct output.
#
# This scenario compile-checks the example on the AEN801 M55-HE board (the
# sw_fallback PIXEL logic itself is already unit-tested on native_sim in
# tests/unit/gpu2d_registry; this adds the board-target build of the example +
# its ITCM RAM-run overlay).  It is intentionally filtered OUT of the native_sim
# PR gate: the only platform allowed is the AEN801 M55-HE board, which the
# native_sim twister run never selects, so it adds a board-target build check
# without slowing the gate.
#
# NOTE: the platform id below MUST match the board .yaml `identifier` exactly
# (zephyr/boards/alp/e1m_aen801_m55_he/..._rtss_he.yaml) or twister silently
# skips the scenario.

sample:
  name: aen-gpu2d-bench
  description: |
    Bench RAM-run GPU2D software-fallback proof for the E1M-AEN801 (Alif Ensemble
    E8, Cortex-M55-HE): exercises the portable <alp/gpu2d.h> fill_rect / blit /
    blend surface through the priority-0 pure-C sw_fallback backend and checks
    every op against exact expected pixel values.  BENCH-VERIFIED PASS on E8
    (2026-06-17).

tests:
  alp_sdk.examples.aen.gpu2d_bench.aen:
    platform_allow:
      - alp_e1m_aen801_m55_he/ae822fa0e5597ls0/rtss_he
    tags:
      - alp-sdk
      - example
      - aen
      - gpu2d
    build_only: true   # the bench fill/blit/blend run is a flash, not a CI run.
```
