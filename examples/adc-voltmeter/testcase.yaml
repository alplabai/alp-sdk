## examples/ai-anomaly-detection-vibration/testcase.yaml
```yaml
# SPDX-License-Identifier: Apache-2.0

sample:
  name: ai-anomaly-detection-vibration
  description: |
    Predictive-maintenance edge-AI demo: LSM6DSO accelerometer ->
    256-sample sliding window -> 1D-CNN anomaly model via TFLM ->
    per-window score.  Same source targets E1M-AEN (Ethos-U) and
    V2N (DEEPX DX-M1); native_sim exercises the framing path
    against the CPU reference kernels.
common:
  tags: ai inference industrial predictive-maintenance marketing showcase
tests:
  alp_sdk.examples.anomaly_detection.native_sim:
    platform_allow:
      - native_sim/native/64
    tags:
      - alp-sdk
      - example
      - ai
      - industrial
    build_only: true
    harness: console
    harness_config:
      type: one_line
      regex:
        - "\\[anomaly\\] done"
  alp_sdk.examples.anomaly_detection.aen:
    platform_allow:
      - ensemble_e8_dk/ae402fa0e5597le0/rtss_hp
    tags:
      - alp-sdk
      - example
      - ai
      - industrial
    build_only: true
```

## examples/ai-camera-viewer/testcase.yaml
```yaml
# SPDX-License-Identifier: Apache-2.0

sample:
  name: ai-camera-viewer
  description: |
    Headline edge-AI demo: OV5640 camera + TFLM person-detect
    on the on-die Ethos-U (U55/U65/U85 picked from the SKU's
    capabilities: block by the §D.lib loader) + LVGL preview +
    bounding-box overlay.  Customers swap som.sku to compare
    NPU variants without app-source changes.
common:
  tags: lvgl ai inference demo example marketing showcase
  harness: console
tests:
  alp_sdk.examples.ai_camera_viewer.native_sim:
    platform_allow: native_sim/native/64
    build_only: true
  alp_sdk.examples.ai_camera_viewer.aen:
    platform_allow:
      - alif_e7_dk_rtss_hp
    build_only: true
```

## examples/ai/ai-anomaly-detection-vibration/testcase.yaml
```yaml
# SPDX-License-Identifier: Apache-2.0

sample:
  name: ai-anomaly-detection-vibration
  description: |
    Predictive-maintenance edge-AI demo: ICM-42670 accelerometer ->
    256-sample sliding window -> 1D-CNN anomaly model via TFLM ->
    per-window score.  Uses BOARD_I2C_SENSORS for portability across
    E1M EVK (AEN, Ethos-U) and E1M-X EVK (V2N, DEEPX DX-M1);
    native_sim exercises the framing path against the CPU reference
    kernels.  The ICM-42670 is populated on BOTH EVK variants.
common:
  tags: ai inference industrial predictive-maintenance marketing showcase
tests:
  alp_sdk.examples.anomaly_detection.e1m_evk:
    extra_configs:
      - 'CONFIG_COMPILER_OPT="-DALP_BOARD_E1M_EVK"'
    platform_allow:
      - native_sim/native/64
    tags:
      - alp-sdk
      - example
      - ai
      - industrial
      - aen
    build_only: true
    harness: console
    harness_config:
      type: one_line
      regex:
        - "\\[anomaly\\] done"

  alp_sdk.examples.anomaly_detection.e1m_x_evk:
    extra_configs:
      - 'CONFIG_COMPILER_OPT="-DALP_BOARD_E1M_X_EVK"'
    platform_allow:
      - native_sim/native/64
    tags:
      - alp-sdk
      - example
      - ai
      - industrial
      - v2n
    build_only: true
    harness: console
    harness_config:
      type: one_line
      regex:
        - "\\[anomaly\\] done"
```
