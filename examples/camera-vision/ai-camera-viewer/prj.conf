## CMakeLists.txt
```
# SPDX-License-Identifier: Apache-2.0
cmake_minimum_required(VERSION 3.20.0)

# Auto-apply the RK055HDMIPI4MA0 DSI shield on the AEN M55-HP board targets
# (`alp_e1m_aen801_m55_hp/...`, `alp_e1m_aen803_m55_hp/...`): the E1M-EVK
# has no panel on its own, and the shield provides the `zephyr,display`
# chosen node and `alp-display0` alias alp_display_open() binds to (#2885,
# the same panel examples/connectivity/iot-dashboard uses, #2173).  Skipped
# when the caller already set SHIELD, so a different panel can be swapped
# in; inert on every other target, including native_sim.  BOARD is read
# from the environment or the sysbuild cache when it is not a -D entry --
# see examples/connectivity/iot-dashboard/CMakeLists.txt for why.
if(NOT DEFINED BOARD AND DEFINED ENV{BOARD})
    set(BOARD $ENV{BOARD})
endif()
if(NOT DEFINED BOARD AND DEFINED SYSBUILD_CACHE AND EXISTS "${SYSBUILD_CACHE}")
    file(STRINGS "${SYSBUILD_CACHE}" _alp_sysbuild_board_line REGEX "^BOARD:STRING=")
    if(_alp_sysbuild_board_line)
        string(REGEX REPLACE "^BOARD:STRING=" "" BOARD "${_alp_sysbuild_board_line}")
    endif()
endif()
if(DEFINED BOARD AND BOARD MATCHES "^alp_e1m_aen80[13]_m55_hp(/|$)" AND NOT DEFINED SHIELD)
    list(APPEND SHIELD e1m_evk_rk055hdmipi4ma0)
endif()

find_package(Zephyr REQUIRED HINTS $ENV{ZEPHYR_BASE})
project(ai_camera_viewer LANGUAGES C)

target_sources(app PRIVATE
    src/main.c
    src/viewer_ui.c
    src/inference_loop.c
)
```

## prj.conf
```kconfig
# SPDX-License-Identifier: Apache-2.0
CONFIG_MAIN_STACK_SIZE=16384
# Heap sized for camera frame + tensor arena.
CONFIG_HEAP_MEM_POOL_SIZE=524288

CONFIG_LV_Z_VDB_SIZE=50
CONFIG_LV_COLOR_DEPTH_16=y
CONFIG_LV_DEF_REFR_PERIOD=33
# LVGL's own internal allocator pool -- see
# examples/display/lvgl-widgets-demo/prj.conf for why the 2048-byte
# Kconfig default is unsafe.
CONFIG_LV_Z_MEM_POOL_SIZE=131072

CONFIG_LOG=y
CONFIG_LOG_PRINTK=y

# Inference subsystem.
CONFIG_ALP_SDK_INFERENCE_BACKEND_TFLM=y

# Display subsystem.  The actual panel driver is board-specific:
# real silicon binds the panel from the generated alp.conf, while
# native_sim has no panel and pulls CONFIG_DUMMY_DISPLAY=y from the
# per-board boards/native_sim_native_64.conf overlay.
CONFIG_DISPLAY=y

# This app binds LVGL to the panel itself via <alp/gui.h>'s
# alp_gui_lvgl_attach() (src/main.c) -- see
# examples/display/lvgl-widgets-demo/prj.conf for the full rationale
# on turning Zephyr's own lvgl auto-init off.
CONFIG_LV_Z_AUTO_INIT=n
```

## boards/native_sim_native_64.conf
```kconfig
# SPDX-License-Identifier: Apache-2.0
#
# native_sim has no real panel, so bind Zephyr's dummy display driver:
# it lets the viewer link without an SDL/X11 dependency.  Auto-loaded
# by Zephyr when building for native_sim/native/64; on real silicon
# this file is NOT applied (the generated alp.conf binds the actual
# panel driver instead), so the dummy-panel knob never reaches the
# real-silicon build.
CONFIG_DUMMY_DISPLAY=y

# native_sim's DTS also carries a zephyr,sdl-dc node, so CONFIG_DISPLAY=y
# (prj.conf) drags in the SDL display driver by default alongside the
# dummy one above -- see examples/display/lvgl-widgets-demo/native_sim.conf
# for why that segfaults headless. This app never opens that device,
# so keep SDL out of the build entirely.
CONFIG_SDL_DISPLAY=n
```

## boards/native_sim_native_64.overlay
```dts
/*
 * Copyright 2026 Alp Lab AB
 * SPDX-License-Identifier: Apache-2.0
 *
 * native_sim board overlay -- chooses zephyr's dummy display
 * driver so the LVGL demo links without a real display chip.
 * Real-silicon builds (alif / v2n) bring up the actual panel
 * (ST7789 / ILI9488 / DSI etc.) via the SoM board overlay.
 *
 * Two references to the same dummy_dc node -- see
 * examples/display/lvgl-widgets-demo/boards/native_sim_native_64.overlay
 * for why `chosen { zephyr,display }` and `aliases { alp-display0 }`
 * both point at it (one satisfies the lvgl module's compile-time
 * requirement, the other is what src/main.c actually opens).
 */

/ {
	chosen {
		zephyr,display = &dummy_dc;
	};

	aliases {
		alp-display0 = &dummy_dc;
	};

	dummy_dc: dummy_dc {
		compatible = "zephyr,dummy-dc";
		height = <320>;
		width = <240>;
	};
};
```

## src/main.c
```c
/*
 * Copyright 2026 Alp Lab AB
 * SPDX-License-Identifier: Apache-2.0
 *
 * ai-camera-viewer
 * ================
 *
 * Headline edge-AI demo on the E1M-AEN family.
 *
 *   ┌──────────────────┐                ┌──────────────────────┐
 *   │  E1M-AEN801 SoM  │  MIPI / DVP    │ OmniVision OV5640    │
 *   │ + Cortex-M55 HP  │ ◀──── frames ──│ camera (RGB565 / VGA)│
 *   └────────┬─────────┘                └──────────────────────┘
 *            │   <alp/camera.h> hands the frame to the inference
 *            │   pipeline:
 *            ▼
 *      ┌──────────────────────┐
 *      │ TFLM + Ethos-U85      │  ── person_detect.tflite
 *      │ (CONFIG_ALP_TFLM_     │     compiled with Vela for
 *      │  ETHOS_U85=y on E8)   │     ethos-u85-256.
 *      └─────────┬─────────────┘
 *                │  ── bounding-box list + per-class score
 *                ▼
 *           ┌──────────┐
 *           │  LVGL    │  draws the latest preview frame on the
 *           │  UI      │  ST7789 + overlays the boxes + a stats
 *           └──────────┘  strip (latency + class confidence).
 *
 *
 * ── Why this demo matters for customers ───────────────────────
 *
 * Three customer questions get answered side-by-side:
 *   1. "Can I run real inference on the AEN's on-die NPU?"  --
 *      yes, the dispatch path is alp_inference_open(..., backend
 *      = ALP_INFERENCE_BACKEND_ETHOS_U).  The §D.lib.loader picks
 *      the U85 vs U55 driver shim from the SKU's
 *      `capabilities:` block, no app-source changes.
 *   2. "How fast?"  --  the per-frame latency strip prints the
 *      microseconds from `alp_inference_invoke()` entry to exit.
 *      Customers compare E8 / E6 / E4 by flipping `som.sku`
 *      in `board.yaml`.
 *   3. "Does it run portably?"  --  the app source uses zero
 *      vendor-specific symbols; the SoC-family routing is in the
 *      loader, not the source.  Re-targeting between AEN SKUs
 *      is a one-line board.yaml change.
 *
 *
 * ── What's still a placeholder ──────────────────────────────────
 *
 * - The actual `person_detect.tflite` model isn't checked in --
 *   customers drop their own Vela-compiled .tflite into
 *   `models/` and the loader picks it up via the include mount.
 * - The camera capture path falls back to NOSUPPORT on
 *   native_sim (no real OV5640 connected), and the UI shows a
 *   solid-colour placeholder + the inference latency for the
 *   built-in dummy bytes.
 * - Real bounding-box decode is paper-correct only -- the
 *   post-process kernel that turns the model output tensor into
 *   a `viewer_box_t[]` array is still TODO, pending the real
 *   compiled model + AEN HiL bench validation.
 */

#include <zephyr/kernel.h>
#include <zephyr/logging/log.h>

#include "alp/peripheral.h"
#include "alp/camera.h"
#include "alp/inference.h"
#include <alp/display.h>
#include <alp/gui.h>

#include <lvgl.h>

#include "viewer_ui.h"
#include "inference_loop.h"

LOG_MODULE_REGISTER(ai_camera_viewer, LOG_LEVEL_INF);

static viewer_state_t g_state;

K_THREAD_STACK_DEFINE(infer_stack, 8192);
static struct k_thread infer_thread;

static void infer_entry(void *p1, void *p2, void *p3)
{
	ARG_UNUSED(p1);
	ARG_UNUSED(p2);
	ARG_UNUSED(p3);
	inference_loop_run(&g_state);
}

int main(void)
{
	LOG_INF("ai-camera-viewer demo starting");

	/* The camera SCCB + capture path are bring-up duties for the
     * inference loop -- this thread owns the chip handle so it
     * can re-init on failure.  Pass our shared state pointer in
     * via the thread arg slot (NULL above; the loop fetches it
     * from main's stack via g_state directly). */

	/* Display + LVGL bring-up.  Open the panel through the portable
     * <alp/display.h> surface, then bind LVGL to it via <alp/gui.h>
     * -- see examples/display/lvgl-widgets-demo/src/main.c for the
     * full rationale on this open -> lv_init -> tick -> attach
     * sequence, and why CONFIG_LV_Z_AUTO_INIT=n (prj.conf) is
     * required alongside it. */
	alp_display_config_t display_cfg = ALP_DISPLAY_CONFIG_DEFAULT(0);
	/* This app owns the panel, so it opts in to driving the mode.
	 * Ignored on Zephyr; on Yocto/Linux it is required, because
	 * opening a display there reprograms a live output (#1143). */
	display_cfg.allow_modeset        = true;
	alp_display_t       *display     = alp_display_open(&display_cfg);
	if (display == NULL) {
		LOG_ERR("display open failed (err=%d)", (int)alp_last_error());
		return 1;
	}
	lv_init();
	lv_tick_set_cb(k_uptime_get_32);

	alp_status_t attach_status = alp_gui_lvgl_attach(display);
	if (attach_status != ALP_OK) {
		LOG_ERR("alp_gui_lvgl_attach failed (err=%d)", (int)attach_status);
		return 1;
	}

	viewer_ui_build();

	/* Spawn the inference thread.  Higher priority than main so
     * the model gets timely CPU even when LVGL is mid-blit. */
	k_thread_create(&infer_thread,
	                infer_stack,
	                K_THREAD_STACK_SIZEOF(infer_stack),
	                infer_entry,
	                NULL,
	                NULL,
	                NULL,
	                K_PRIO_PREEMPT(3),
	                0,
	                K_NO_WAIT);
	k_thread_name_set(&infer_thread, "infer_loop");

	/* Render loop: 30 fps, sample the shared state once per
     * frame to avoid tearing the bounding-box overlay mid-update. */
	while (1) {
		viewer_state_t snap = g_state;
		viewer_ui_apply(&snap);

		const uint32_t sleep_ms = lv_timer_handler();
		k_msleep(MIN(sleep_ms, 10u));
	}

	return 0;
}
```

## src/inference_loop.c
```c
/*
 * Copyright 2026 Alp Lab AB
 * SPDX-License-Identifier: Apache-2.0
 *
 * Capture -> infer -> decode loop.
 *
 *   1. Open the camera at startup; on failure tolerate it and
 *      run with a synthetic frame so the UI still renders.
 *   2. Open the inference backend (ALP_INFERENCE_BACKEND_AUTO --
 *      let the dispatcher pick the on-chip NPU on AEN / V2N,
 *      or fall back to CPU on native_sim).
 *   3. Per loop iteration:
 *        - alp_camera_capture(...) returns a frame.
 *        - alp_inference_invoke(...) runs the model.
 *        - decode_boxes(...) turns the output tensor into a
 *          viewer_box_t array.
 *        - publish via the shared viewer_state_t snapshot.
 *
 * The model itself isn't checked in -- this example expects a
 * Vela-compiled `person_detect.tflite` at models/.  Customers
 * drop their own model + edit the input pre-processing as
 * needed.
 */

#include <zephyr/kernel.h>
#include <zephyr/logging/log.h>
#include <string.h>

#include "alp/peripheral.h"
#include "alp/camera.h"
#include "alp/inference.h"

#include "inference_loop.h"

LOG_MODULE_REGISTER(infer_loop, LOG_LEVEL_INF);

/* Placeholder Vela-compiled model bytes.  Real customers replace
 * this with #include "models/person_detect_vela.h" generated by
 * the upstream Vela compiler. */
static const uint8_t s_model[] = { 0x00 };

/* Tensor arena -- the buffer TFLM uses for intermediate
 * activations.  Sized to match `default_arena_kib` in
 * board.yaml's `inference:` block. */
static uint8_t s_arena[256 * 1024] __aligned(16);

/* Captured camera frame -- 240×240 RGB565 == 115200 bytes.  Real
 * pipelines reuse a pool of frames; this single-buffer demo is
 * the simplest customer-facing baseline. */
static uint8_t s_frame[240 * 240 * 2] __aligned(16);

void inference_loop_run(viewer_state_t *state)
{
	memset(state, 0, sizeof(*state));

	/* Camera setup.  Open <alp/camera.h>, ask for VGA-ish frames.
     * On native_sim the open returns NOSUPPORT; the loop carries
     * on with the placeholder frame data and the UI shows that
     * the camera is offline. */
	alp_camera_t *cam = alp_camera_open(&(alp_camera_config_t){
	    .camera_id = 0,
	    .width     = 240,
	    .height    = 240,
	    .fps       = 30,
	    .format    = ALP_PIXFMT_RGB565,
	});
	state->camera_ok  = (cam != NULL);
	if (!state->camera_ok) {
		LOG_WRN("camera open failed; running with synthetic frame");
	} else {
		/* TODO: inspect alp_camera_start()'s returned
         * alp_status_t -- today this tolerates NOSUPPORT
         * silently so native_sim still runs. */
		(void)alp_camera_start(cam);
	}

	/* Inference setup.  AUTO routes to the best backend available to
     * this Zephyr slice (ETHOS_U85 on AEN401 / AEN601 / AEN801,
     * TFLM CPU on V2N M33 and native_sim).  V2N's
     * DRP-AI3 engine is available only to its A55/Yocto slice. */
	alp_inference_t *inf = alp_inference_open(&(alp_inference_config_t){
	    .backend     = ALP_INFERENCE_BACKEND_AUTO,
	    .format      = ALP_INFERENCE_MODEL_VELA,
	    .model_data  = s_model,
	    .model_size  = sizeof(s_model),
	    .arena       = s_arena,
	    .arena_bytes = sizeof(s_arena),
	});
	state->inference_ok  = (inf != NULL);
	if (!state->inference_ok) {
		LOG_WRN("inference open failed; UI will render zero boxes");
	}

	uint32_t frames_in_window = 0;
	uint32_t window_start_ms  = k_uptime_get_32();

	while (1) {
		/* Capture.  Backend owns the frame buffer; we copy out and
         * release immediately so the next capture can reuse it. */
		if (state->camera_ok) {
			alp_camera_frame_t frame = { 0 };
			if (alp_camera_capture(cam, &frame, /*timeout_ms=*/100) == ALP_OK) {
				size_t n = frame.size < sizeof(s_frame) ? frame.size : sizeof(s_frame);
				if (frame.data) {
					memcpy(s_frame, frame.data, n);
				}
				(void)alp_camera_release(cam, &frame);
			}
		}

		/* Invoke. */
		uint32_t t0_us = k_cycle_get_32();
		if (state->inference_ok) {
			/* TODO: copy s_frame into the model's input tensor via
             * alp_inference_get_input() -- available today, see
             * include/alp/inference.h -- then invoke.  This
             * skeleton just times the empty invoke so the UI
             * shows the latency floor. */
			(void)alp_inference_invoke(inf);
		}
		uint32_t t1_us        = k_cycle_get_32();
		state->last_invoke_us = k_cyc_to_us_floor32(t1_us - t0_us);

		/* Decode bounding boxes.  This skeleton emits a
         * synthetic box so the UI renders one rectangle; wiring
         * the real post-process is still TODO, pending a real
         * compiled model. */
		state->n_boxes  = 1;
		state->boxes[0] = (viewer_box_t){
			.x        = 60,
			.y        = 60,
			.w        = 120,
			.h        = 120,
			.class_id = 0,
			.score    = 0.92f,
		};

		/* FPS estimate over a rolling 1 s window. */
		frames_in_window++;
		uint32_t now_ms = k_uptime_get_32();
		if (now_ms - window_start_ms >= 1000) {
			state->fps_x10   = (frames_in_window * 10);
			frames_in_window = 0;
			window_start_ms  = now_ms;
		}

		/* No explicit sleep -- the inference invoke + render loop
         * is the pacing.  If the model runs faster than the
         * display can render, LVGL's render thread naturally
         * limits the frame rate. */
		k_yield();
	}
}
```

## src/inference_loop.h
```c
/*
 * Copyright 2026 Alp Lab AB
 * SPDX-License-Identifier: Apache-2.0
 */

#ifndef AI_CAMERA_VIEWER_INFERENCE_LOOP_H
#define AI_CAMERA_VIEWER_INFERENCE_LOOP_H

#include "viewer_ui.h"

#ifdef __cplusplus
extern "C" {
#endif

/** Inference thread entrypoint.  Owns the camera + inference
 *  handles, captures one frame per cycle, runs the model,
 *  decodes the output tensor, and updates the shared state. */
void inference_loop_run(viewer_state_t *state);

#ifdef __cplusplus
} /* extern "C" */
#endif

#endif /* AI_CAMERA_VIEWER_INFERENCE_LOOP_H */
```

## src/viewer_ui.c
```c
/*
 * Copyright 2026 Alp Lab AB
 * SPDX-License-Identifier: Apache-2.0
 *
 * LVGL viewer for ai-camera-viewer.  Renders:
 *   - The captured preview frame as a 240×240 LVGL image (top).
 *   - Up to 8 bounding boxes overlaid as borderless rectangles.
 *   - A status strip with per-invoke latency + FPS + camera/
 *     inference health flags.
 */

#include <stdio.h>

#include <lvgl.h>

#include "viewer_ui.h"

static lv_obj_t *s_preview;
static lv_obj_t *s_box_widgets[VIEWER_MAX_BOXES];
static lv_obj_t *s_lbl_stats;
static lv_obj_t *s_lbl_health;

void viewer_ui_build(void)
{
	lv_obj_t *scr = lv_screen_active();
	lv_obj_set_style_bg_color(scr, lv_color_black(), 0);

	/* Preview pane.  Real capture path fills this with the
     * camera frame; the fallback paints it a colour as a
     * visible "no frame" placeholder. */
	s_preview = lv_obj_create(scr);
	lv_obj_set_size(s_preview, 240, 240);
	lv_obj_set_pos(s_preview, 0, 0);
	lv_obj_set_style_bg_color(s_preview, lv_color_hex(0x202830), 0);
	lv_obj_set_style_border_width(s_preview, 0, 0);

	/* Pre-allocate the bounding-box widgets so updates don't
     * thrash the LVGL allocator each frame. */
	for (int i = 0; i < VIEWER_MAX_BOXES; i++) {
		s_box_widgets[i] = lv_obj_create(s_preview);
		lv_obj_set_size(s_box_widgets[i], 1, 1);
		lv_obj_set_pos(s_box_widgets[i], 0, 0);
		lv_obj_set_style_bg_opa(s_box_widgets[i], LV_OPA_TRANSP, 0);
		lv_obj_set_style_border_color(s_box_widgets[i], lv_color_hex(0x00FF80), 0);
		lv_obj_set_style_border_width(s_box_widgets[i], 2, 0);
		lv_obj_add_flag(s_box_widgets[i], LV_OBJ_FLAG_HIDDEN);
	}

	/* Stats strip. */
	s_lbl_stats = lv_label_create(scr);
	lv_obj_set_pos(s_lbl_stats, 4, 245);
	lv_obj_set_style_text_color(s_lbl_stats, lv_color_white(), 0);
	lv_label_set_text(s_lbl_stats, "-- fps  --.- ms");

	s_lbl_health = lv_label_create(scr);
	lv_obj_set_pos(s_lbl_health, 4, 285);
	lv_obj_set_style_text_color(s_lbl_health, lv_color_hex(0xA0A0A0), 0);
	lv_label_set_text(s_lbl_health, "cam: ?  inf: ?");
}

void viewer_ui_apply(const viewer_state_t *s)
{
	char buf[64];

	/* Bounding-box overlay.  Hide unused box widgets. */
	for (int i = 0; i < VIEWER_MAX_BOXES; i++) {
		if (i < s->n_boxes) {
			const viewer_box_t *b = &s->boxes[i];
			lv_obj_set_pos(s_box_widgets[i], b->x, b->y);
			lv_obj_set_size(s_box_widgets[i], b->w, b->h);
			lv_obj_clear_flag(s_box_widgets[i], LV_OBJ_FLAG_HIDDEN);
		} else {
			lv_obj_add_flag(s_box_widgets[i], LV_OBJ_FLAG_HIDDEN);
		}
	}

	/* Stats strip. */
	snprintf(buf,
	         sizeof(buf),
	         "%2u.%u fps  %5u µs/inv",
	         (unsigned)(s->fps_x10 / 10),
	         (unsigned)(s->fps_x10 % 10),
	         (unsigned)s->last_invoke_us);
	lv_label_set_text(s_lbl_stats, buf);

	snprintf(buf,
	         sizeof(buf),
	         "cam: %s  inf: %s  boxes: %u",
	         s->camera_ok ? "OK" : "!!",
	         s->inference_ok ? "OK" : "!!",
	         (unsigned)s->n_boxes);
	lv_label_set_text(s_lbl_health, buf);
}
```

## src/viewer_ui.h
```c
/*
 * Copyright 2026 Alp Lab AB
 * SPDX-License-Identifier: Apache-2.0
 */

#ifndef AI_CAMERA_VIEWER_UI_H
#define AI_CAMERA_VIEWER_UI_H

#include <stdint.h>
#include <stdbool.h>

#ifdef __cplusplus
extern "C" {
#endif

#define VIEWER_MAX_BOXES 8

typedef struct {
	int16_t x, y, w, h;
	uint8_t class_id;
	float   score;
} viewer_box_t;

typedef struct {
	viewer_box_t boxes[VIEWER_MAX_BOXES];
	uint8_t      n_boxes;
	uint32_t     last_invoke_us;
	uint32_t     fps_x10; /**< Frames-per-second × 10 (one decimal). */
	bool         camera_ok;
	bool         inference_ok;
} viewer_state_t;

void viewer_ui_build(void);
void viewer_ui_apply(const viewer_state_t *s);

#ifdef __cplusplus
} /* extern "C" */
#endif

#endif /* AI_CAMERA_VIEWER_UI_H */
```
