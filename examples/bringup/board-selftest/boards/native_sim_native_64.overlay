/*
 * Copyright 2026 Alp Lab AB
 * SPDX-License-Identifier: Apache-2.0
 *
 * One emulated I2C bus exposed via the alp-i2c0 alias.  No emul
 * targets are attached, so every address in the scan NACKs -- but
 * the open / probe-loop / close path runs end-to-end and the
 * harness latches on the `[selftest] done` marker.  The identity
 * and power checks have no native_sim backend and report SKIP.
 */

#include <zephyr/dt-bindings/i2c/i2c.h>

/ {
    aliases {
        alp-i2c0 = &i2c0_emul;
    };

    soc {
        i2c0_emul: i2c@100 {
            compatible = "zephyr,i2c-emul-controller";
            status = "okay";
            reg = <0 0x100 4>;
            #address-cells = <1>;
            #size-cells = <0>;
            clock-frequency = <I2C_BITRATE_STANDARD>;
        };
    };
};
