## tests/console/testcase.yaml
```yaml
tests:
  alp_sdk.console:
    platform_allow:
      - native_sim
      - native_sim/native/64
    tags:
      - alp_sdk
      - console
```

## tests/unit/bpf_modulation/testcase.yaml
```yaml
# SPDX-License-Identifier: Apache-2.0
tests:
  alp.unit.bpf_modulation:
    platform_allow:
      - native_sim
      - native_sim/native/64
    integration_platforms:
      - native_sim/native/64
    tags:
      - alp
      - audio
      - dsp
      - predictive-maintenance
      - unit
```

## tests/unit/cold_chain/testcase.yaml
```yaml
# SPDX-License-Identifier: Apache-2.0
tests:
  alp.unit.cold_chain:
    platform_allow:
      - native_sim
      - native_sim/native/64
    integration_platforms:
      - native_sim/native/64
    tags:
      - alp
      - ai
      - environmental
      - predictive-maintenance
      - unit
```

## tests/unit/defect_map/testcase.yaml
```yaml
# SPDX-License-Identifier: Apache-2.0
tests:
  alp.unit.defect_map:
    platform_allow:
      - native_sim
      - native_sim/native/64
    integration_platforms:
      - native_sim/native/64
    tags:
      - alp
      - ai
      - vision
      - defect
      - unit
```

## tests/unit/gd32_bridge_ota/testcase.yaml
```yaml
tests:
  alp.unit.gd32_bridge_ota:
    platform_allow:
      - native_sim
      - native_sim/native/64
    integration_platforms:
      - native_sim
      - native_sim/native/64
    tags:
      - alp
      - gd32-bridge
      - ota
      - unit
```

## tests/unit/gd32_bridge_ota_overflow/testcase.yaml
```yaml
tests:
  alp.unit.gd32_bridge_ota_overflow:
    # 32-bit only: ota.c's meta/flash-address casts assume uintptr_t ==
    # uint32_t (true on the real Cortex-M33 target), which trips
    # -Werror=int-to-pointer-cast on a 64-bit host.  Pre-existing property
    # of the production source, not something this guard-only change
    # should widen scope to touch.
    platform_allow:
      - native_sim
    integration_platforms:
      - native_sim
    tags:
      - alp
      - gd32-bridge
      - ota
      - unit
```

## tests/unit/gd32_swd_flash_bounds/testcase.yaml
```yaml
tests:
  alp.unit.gd32_swd_flash_bounds:
    platform_allow:
      - native_sim
      - native_sim/native/64
    integration_platforms:
      - native_sim
      - native_sim/native/64
    tags:
      - alp
      - gd32-swd
      - unit
```

## tests/unit/i2c_registry/testcase.yaml
```yaml
tests:
  alp.unit.i2c_registry:
    platform_allow:
      - native_sim
      - native_sim/native/64
    integration_platforms:
      - native_sim
      - native_sim/native/64
    tags:
      - alp
      - i2c
      - backend
      - unit
```

## tests/unit/jpeg_registry/testcase.yaml
```yaml
tests:
  alp.unit.jpeg_registry:
    platform_allow:
      - native_sim
      - native_sim/native/64
    integration_platforms:
      - native_sim
      - native_sim/native/64
    tags:
      - alp
      - jpeg
      - backend
      - unit
```

## tests/unit/motion_features/testcase.yaml
```yaml
# SPDX-License-Identifier: Apache-2.0
tests:
  alp.unit.motion_features:
    platform_allow:
      - native_sim
      - native_sim/native/64
    integration_platforms:
      - native_sim/native/64
    tags:
      - alp
      - ai
      - imu
      - wearable
      - unit
```

## tests/unit/rail_features/testcase.yaml
```yaml
# SPDX-License-Identifier: Apache-2.0
tests:
  alp.unit.rail_features:
    platform_allow:
      - native_sim
      - native_sim/native/64
    integration_platforms:
      - native_sim/native/64
    tags:
      - alp
      - ai
      - dsp
      - predictive-maintenance
      - unit
```

## tests/unit/rail_position/testcase.yaml
```yaml
# SPDX-License-Identifier: Apache-2.0
tests:
  alp.unit.rail_position:
    platform_allow:
      - native_sim
      - native_sim/native/64
    integration_platforms:
      - native_sim/native/64
    tags:
      - alp
      - ai
      - gnss
      - predictive-maintenance
      - unit
```

## tests/unit/rpc_zephyr_backend/testcase.yaml
```yaml
tests:
  alp.unit.rpc_zephyr_backend:
    platform_allow:
      - native_sim
      - native_sim/native/64
    integration_platforms:
      - native_sim
      - native_sim/native/64
    tags:
      - alp
      - rpc
      - backend
      - unit
      - security
```

## tests/unit/update_log/testcase.yaml
```yaml
# SPDX-License-Identifier: Apache-2.0
common:
  platform_allow:
    - native_sim
    - native_sim/native/64
  integration_platforms:
    - native_sim
    - native_sim/native/64
  tags:
    - alp
    - update_log
    - security
    - unit
tests:
  # RAM-fallback mode: NVS off, so ALP_SDK_UPDATE_LOG_PERSIST resolves n
  # and the sw tier keeps the pre-persistence RAM store (entries do NOT
  # survive re-init).  Also carries all the engine-level chain tests.
  alp.unit.update_log: {}
  # NVS-persistent mode: the boards/*.overlay carves alp_ulog_partition
  # and these configs mount NVS on it -- entries survive a full backend
  # re-init and a full log reports NOMEM without wrapping.
  alp.unit.update_log.persist:
    extra_configs:
      - CONFIG_FLASH=y
      - CONFIG_FLASH_MAP=y
      - CONFIG_NVS=y
```

## tests/zephyr/cc3501e_ble_gatt_register/testcase.yaml
```yaml
# SPDX-License-Identifier: Apache-2.0
#
# Native-sim end-to-end test for issue #480 (CC3501E dynamic BLE GATT
# service registration): drives the real CC3501E BLE backend encoder +
# chip driver against a software model of the firmware SPI slave.  Lives
# under tests/zephyr/ (not tests/unit/) so the pr-twister gate runs it
# (tests/unit/ is not yet in any twister root -- issue #90).

tests:
  alp_sdk.cc3501e.ble_gatt_register:
    platform_allow:
      - native_sim
      - native_sim/native/64
    integration_platforms:
      - native_sim
      - native_sim/native/64
    tags:
      - alp-sdk
      - cc3501e
      - ble
```
