## examples/v2n/v2n-pwm-fan-control/testcase.yaml
```yaml
# SPDX-License-Identifier: Apache-2.0

sample:
  name: v2n-pwm-fan-control
  description: |
    Drive a fan via a PWM channel routed through the on-module
    GD32 bridge.  Uses the portable `<alp/pwm.h>` surface;
    backend dispatch to the GD32G553 is transparent to app code.

tests:
  alp_sdk.examples.v2n.pwm_fan_control.native_sim:
    platform_allow:
      - native_sim/native/64
    tags:
      - alp-sdk
      - example
      - v2n
      - pwm
    build_only: true
```

## examples/v2n/v2n-rtc-multi-alarm/testcase.yaml
```yaml
# SPDX-License-Identifier: Apache-2.0

sample:
  name: v2n-rtc-multi-alarm
  description: |
    Multi-alarm scheduling against the V2N's RV-3028-C7 external
    RTC via `<alp/rtc.h>`.  Exercises the multi-source event-line
    pattern documented in the RV-3028-C7 app note.

tests:
  alp_sdk.examples.v2n.rtc_multi_alarm.native_sim:
    platform_allow:
      - native_sim/native/64
    tags:
      - alp-sdk
      - example
      - v2n
      - rtc
    build_only: true
```

## examples/v2n/v2n-secure-element-sign/testcase.yaml
```yaml
# SPDX-License-Identifier: Apache-2.0

sample:
  name: v2n-secure-element-sign
  description: |
    Probe the OPTIGA Trust M secure element on the V2N SoM and
    confirm product-info/raw-APDU calls are cleanly blocked with
    ALP_ERR_NOSUPPORT until the host-library transport is integrated.

tests:
  alp_sdk.examples.v2n.secure_element_sign.native_sim:
    platform_allow:
      - native_sim/native/64
    tags:
      - alp-sdk
      - example
      - v2n
      - security
      - optiga
    build_only: true
```

## examples/v2n/v2n-temp-sensor/testcase.yaml
```yaml
# SPDX-License-Identifier: Apache-2.0

sample:
  name: v2n-temp-sensor
  description: |
    Read the V2N's on-module TMP112 temperature sensor over
    BRD_I2C via the chip-driver header.  Useful as a basic
    on-module-chip sanity check.

tests:
  alp_sdk.examples.v2n.temp_sensor.native_sim:
    platform_allow:
      - native_sim/native/64
    tags:
      - alp-sdk
      - example
      - v2n
      - i2c
      - sensors
    build_only: true
```

## examples/v2n/v2n-xspi-flash-readwrite/testcase.yaml
```yaml
# SPDX-License-Identifier: Apache-2.0

sample:
  name: v2n-xspi-flash-readwrite
  description: |
    Read + write + erase against the V2N's on-module xSPI NOR
    flash via Zephyr's flash API.  Validates low-level V2N flash
    bring-up, not coverage for the portable SDK storage facade.

tests:
  alp_sdk.examples.v2n.xspi_flash_readwrite.native_sim:
    platform_allow:
      - native_sim/native/64
    # native_sim has no xSPI controller -- this overlay backs the
    # flash API with the in-RAM flash simulator so the build links
    # (real V2N keeps the xSPI flash driver from prj.conf).
    extra_args: EXTRA_CONF_FILE=generated/native_sim.conf
    tags:
      - alp-sdk
      - example
      - v2n
      - storage
      - flash
    build_only: true
```

## meta-alp-sdk/conf/distro/include/ros2-humble-build.inc
```bitbake
# SPDX-License-Identifier: Apache-2.0
#
# Build config for the ROS 2 Humble subset the Alp images ship (the alp-ros
# feature group: rclcpp + the message/transport stack + alp-perception).
# Required by conf/distro/alp.conf so every DISTRO=alp build gets it -- this is
# recipe-intent, NOT a CI scratch local.conf.
#
# Two things meta-ros's full recipe set needs that we deliberately do without:
#
#  1. cmake_qt5 (meta-qt5) -- pulled by the GUI/sim/visualization recipes
#     (gazebo, rviz, rqt, moveit, mapviz, ...). meta-qt5 is not vendored and
#     none of those recipes are in any alp image, so mask them; otherwise a
#     plain .bbappend that inherits the missing class is a hard parse error.
#  2. rmw-connextdds -> rti-connext-dds (proprietary, not in the OSS pkg).
#     rmw-implementation hard-lists every RMW backend; drop Connext so it
#     builds against the open backends (Fast-DDS stays the default RMW).
#
# Copyright (C) 2026 Alp Lab AB

# --- 1. mask the cmake_qt5-inheriting recipes (relative-path regexes) -------
BBMASK += "meta-ros/meta-ros2-humble/recipes-bbappends/cartographer-ros/cartographer-rviz_2.0.9002-1.bbappend"
BBMASK += "meta-ros/meta-ros2-humble/recipes-bbappends/clearpath-common/clearpath-generator-common_1.3.9-1.bbappend"
BBMASK += "meta-ros/meta-ros2-humble/recipes-bbappends/find-object-2d/find-object-2d_0.7.0-1.bbappend"
BBMASK += "meta-ros/meta-ros2-humble/recipes-bbappends/grid-map/grid-map-rviz-plugin_2.0.1-1.bbappend"
BBMASK += "meta-ros/meta-ros2-humble/recipes-bbappends/imu-tools/rviz-imu-plugin_2.1.5-1.bbappend"
BBMASK += "meta-ros/meta-ros2-humble/recipes-bbappends/mapviz/mapviz_2.6.2-1.bbappend"
BBMASK += "meta-ros/meta-ros2-humble/recipes-bbappends/mapviz/mapviz-plugins_2.6.2-1.bbappend"
BBMASK += "meta-ros/meta-ros2-humble/recipes-bbappends/mapviz/multires-image_2.6.2-1.bbappend"
BBMASK += "meta-ros/meta-ros2-humble/recipes-bbappends/mapviz/tile-map_2.6.2-1.bbappend"
BBMASK += "meta-ros/meta-ros2-humble/recipes-bbappends/moveit/moveit-ros-visualization_2.5.9-1.bbappend"
BBMASK += "meta-ros/meta-ros2-humble/recipes-bbappends/moveit/moveit-setup-framework_2.5.9-1.bbappend"
BBMASK += "meta-ros/meta-ros2-humble/recipes-bbappends/moveit/moveit-setup-srdf-plugins_2.5.9-1.bbappend"
BBMASK += "meta-ros/meta-ros2-humble/recipes-bbappends/moveit-visual-tools/moveit-visual-tools_4.1.2-1.bbappend"
BBMASK += "meta-ros/meta-ros2-humble/recipes-bbappends/navigation2/nav2-rviz-plugins_1.1.20-1.bbappend"
BBMASK += "meta-ros/meta-ros2-humble/recipes-bbappends/octomap-rviz-plugins/octomap-rviz-plugins_2.1.1-1.bbappend"
BBMASK += "meta-ros/meta-ros2-humble/recipes-bbappends/plotjuggler/plotjuggler_3.15.0-1.bbappend"
BBMASK += "meta-ros/meta-ros2-humble/recipes-bbappends/plotjuggler-ros/plotjuggler-ros_2.3.1-2.bbappend"
BBMASK += "meta-ros/meta-ros2-humble/recipes-bbappends/polygon-ros/polygon-rviz-plugins_1.2.0-1.bbappend"
BBMASK += "meta-ros/meta-ros2-humble/recipes-bbappends/qt-gui-core/qt-gui-cpp_2.2.4-1.bbappend"
BBMASK += "meta-ros/meta-ros2-humble/recipes-bbappends/rmf-task/rmf-task_2.1.8-1.bbappend"
BBMASK += "meta-ros/meta-ros2-humble/recipes-bbappends/rmf-traffic-editor/rmf-traffic-editor_1.6.3-1.bbappend"
BBMASK += "meta-ros/meta-ros2-humble/recipes-bbappends/rmf-visualization/rmf-visualization-rviz2-plugins_2.0.2-1.bbappend"
BBMASK += "meta-ros/meta-ros2-humble/recipes-bbappends/ros-gz/ros-gz-sim_0.244.23-1.bbappend"
BBMASK += "meta-ros/meta-ros2-humble/recipes-bbappends/ros-gz/ros-ign-gazebo_0.244.23-1.bbappend"
BBMASK += "meta-ros/meta-ros2-humble/recipes-bbappends/ros-image-to-qimage/ros-image-to-qimage_0.2.1-1.bbappend"
BBMASK += "meta-ros/meta-ros2-humble/recipes-bbappends/rqt-image-overlay/rqt-image-overlay_0.1.3-1.bbappend"
BBMASK += "meta-ros/meta-ros2-humble/recipes-bbappends/rqt-image-view/rqt-image-view_1.2.0-2.bbappend"
BBMASK += "meta-ros/meta-ros2-humble/recipes-bbappends/rqt/rqt-gui-cpp_1.1.9-1.bbappend"
BBMASK += "meta-ros/meta-ros2-humble/recipes-bbappends/rviz-2d-overlay-plugins/rviz-2d-overlay-plugins_1.4.0-1.bbappend"
BBMASK += "meta-ros/meta-ros2-humble/recipes-bbappends/rviz/rviz2_11.2.26-1.bbappend"
BBMASK += "meta-ros/meta-ros2-humble/recipes-bbappends/rviz/rviz-common_11.2.26-1.bbappend"
BBMASK += "meta-ros/meta-ros2-humble/recipes-bbappends/rviz/rviz-default-plugins_11.2.26-1.bbappend"
BBMASK += "meta-ros/meta-ros2-humble/recipes-bbappends/rviz/rviz-rendering_11.2.26-1.bbappend"
BBMASK += "meta-ros/meta-ros2-humble/recipes-bbappends/rviz-satellite/rviz-satellite_4.0.0-1.bbappend"
BBMASK += "meta-ros/meta-ros2-humble/recipes-bbappends/rviz-visual-tools/rviz-visual-tools_4.1.4-1.bbappend"
BBMASK += "meta-ros/meta-ros2-humble/recipes-bbappends/slam-toolbox/slam-toolbox_2.6.10-1.bbappend"
BBMASK += "meta-ros/meta-ros2-humble/recipes-bbappends/snowbot-operating-system/snowbot-operating-system_0.1.2-3.bbappend"
BBMASK += "meta-ros/meta-ros2-humble/recipes-bbappends/swri-console/swri-console_2.1.2-1.bbappend"
BBMASK += "meta-ros/meta-ros2-humble/recipes-bbappends/turtlesim/turtlesim_%.bbappend"
BBMASK += "meta-ros/meta-ros2-humble/recipes-bbappends/vision-msgs-layers/vision-msgs-layers_0.1.0-1.bbappend"
BBMASK += "meta-ros/meta-ros2-humble/recipes-bbappends/vision-msgs/vision-msgs-rviz-plugins_4.1.1-1.bbappend"
BBMASK += "meta-ros/meta-ros-common/recipes-devtools/gazebo-classic/gazebo11_11.15.1.bb"
BBMASK += "meta-ros/meta-ros-common/recipes-devtools/gazebo-classic/sdformat9_9.10.1.bb"
BBMASK += "meta-ros/meta-ros-common/recipes-devtools/gazebo/gz-gui8_8.3.0.bb"
BBMASK += "meta-ros/meta-ros-common/recipes-devtools/gazebo/gz-gui8_8.4.0.bb"
BBMASK += "meta-ros/meta-ros-common/recipes-devtools/gazebo/gz-gui9_9.0.0.bb"
BBMASK += "meta-ros/meta-ros-common/recipes-devtools/gazebo/gz-gui9_9.0.1.bb"
BBMASK += "meta-ros/meta-ros-common/recipes-devtools/gazebo/gz-gui9_9.0.2.bb"
BBMASK += "meta-ros/meta-ros-common/recipes-devtools/gazebo/gz-launch7_7.1.1.bb"
BBMASK += "meta-ros/meta-ros-common/recipes-devtools/gazebo/gz-launch8_8.0.0.bb"
BBMASK += "meta-ros/meta-ros-common/recipes-devtools/gazebo/gz-launch8_8.0.1.bb"
BBMASK += "meta-ros/meta-ros-common/recipes-devtools/gazebo/gz-sim8_8.10.0.bb"
BBMASK += "meta-ros/meta-ros-common/recipes-devtools/gazebo/gz-sim8_8.11.0.bb"
BBMASK += "meta-ros/meta-ros-common/recipes-devtools/gazebo/gz-sim8_8.7.0.bb"
BBMASK += "meta-ros/meta-ros-common/recipes-devtools/gazebo/gz-sim8_8.9.0.bb"
BBMASK += "meta-ros/meta-ros-common/recipes-devtools/gazebo/gz-sim9_9.0.0.bb"
BBMASK += "meta-ros/meta-ros-common/recipes-devtools/gazebo/gz-sim9_9.1.0.bb"
BBMASK += "meta-ros/meta-ros-common/recipes-devtools/gazebo/gz-sim9_9.4.0.bb"
BBMASK += "meta-ros/meta-ros-common/recipes-devtools/gazebo/gz-sim9_9.5.0.bb"
BBMASK += "meta-ros/meta-ros-common/recipes-devtools/gazebo/ignition-gazebo6_6.17.0.bb"
BBMASK += "meta-ros/meta-ros-common/recipes-devtools/gazebo/ignition-gui6_6.8.0.bb"
BBMASK += "meta-ros/meta-ros-common/recipes-devtools/gazebo/ignition-launch5_5.3.0.bb"

# --- 2. drop the proprietary Connext RMW backend ---------------------------
DEPENDS:remove:pn-rmw-implementation = "rmw-connextdds"
```

## meta-alp-sdk/conf/machine/e1m-nx9101-a55.conf
```bitbake
#@TYPE: Machine
#@NAME: E1M-NX9101 A55 cluster (NXP i.MX 93)
#@DESCRIPTION: Alp Lab E1M-NX9101 SoM (NXP i.MX 93: Cortex-A55 dual
#              + Cortex-M33 RT-domain + Ethos-U65 micro-NPU) on the
#              E1M EVK.  This MACHINE targets the A55 Linux cluster;
#              the M33 system core builds via Zephyr.
#
#              Layers on top of `meta-imx`'s i.MX 93 base; see
#              https://github.com/nxp-imx/meta-imx for the upstream.

# TODO(meta-imx): this MACHINE must `require` the real meta-imx i.MX 93
# machine include, but meta-imx is NOT vendored in this layer so the
# exact include name cannot be asserted here without fabricating it.
# The earlier `conf/machine/include/imx93-base.inc` does not exist in
# meta-imx. Point this at the correct upstream include (commonly the
# i.MX 93 EVK machine conf, e.g. `require conf/machine/imx93-11x11-lpddr4x-evk.conf`,
# or the shared `conf/machine/include/imx9-class.inc` / `imx-base.inc`
# family) once the meta-imx release pinned in bblayers.conf is known.
# With the require commented out this MACHINE is missing its SoC base
# (no SOC_FAMILY, tune, kernel/bootloader providers) and therefore will
# NOT parse to a buildable config -- that is intentional until the real
# include is wired in. Do NOT uncomment with a guessed path.
#require conf/machine/include/imx93-base.inc

MACHINEOVERRIDES =. "e1m-nx9101-a55:e1m-nx9101:e1m-n93:e1m:"
MACHINE_FEATURES += "alp-sdk e1m nx9101 ethos-u65"

# i.MX 93 has a Cortex-M33 real-time domain alongside the A55s.
# alp-sdk builds the same <alp/...> surface for both -- Linux
# user-space on the A55s + RTOS-side (Zephyr) on the M33.  The
# M33 firmware is loaded by the A55s at boot via remoteproc
# (alp-remoteproc.service handles the lifecycle).
ALP_BOOT_RTCORE_DEFAULT ?= "1"

# Ethos-U65 micro-NPU.  Same Vela toolchain as AEN's U55, just a
# different command-stream variant.  The alp-inference Ethos-U
# backend targets both -- see task #14.
PREFERRED_PROVIDER_virtual/ethosu-firmware ?= "ethosu-fw-imx93"
PREFERRED_PROVIDER_ethosu-driver-library ?= "ethosu-driver-library"

# Inference runtime is silicon-determined -- alp-sdk's
# DEPENDS:append:e1m-nx9101 installs ethosu-driver-library, which
# the build's compiled-in Ethos-U dispatcher uses.  No build-time
# backend pin; apps pick at runtime via alp_inference_open().

# E1M-NX9101 carrier wiring (vs NXP's generic imx93evk).
KERNEL_DEVICETREE = "freescale/imx93-e1m-evk.dtb"

# Runtime payload is image-owned: alp-sdk ships in every alp-image-*; ROS is
# the opt-in alp-ros feature group. This machine has no DRP-AI/DEEPX runtime
# to add -- alp-sdk's Ethos-U backend is compiled into the library.

# Boot media: SD card by default, eMMC populated on production
# images.  The carrier's microSD slot is multiplexed via 74LVC157
# with the M.2 E-key SDIO -- see <alp/boards/alp_e1m_evk.h>.
ALP_BOOT_DEVICE ?= "sdcard"

# OTA via Mender (opt-in).  Uncomment to inherit Mender image
# generation + A/B rootfs partitioning.  Requires meta-mender-core
# in bblayers.conf; reference flow in docs/ota.md.
#
#     require conf/distro/include/mender.inc
```

## meta-alp-sdk/conf/machine/e1m-v2m101.conf
```bitbake
#@TYPE: Machine
#@NAME: E1M-V2M101 (V2N + DEEPX DX-M1)
#@DESCRIPTION: ALP Lab E1M-V2M101 SoM -- V2N base + on-module
#              DEEPX DX-M1 NPU over PCIe.

require conf/machine/include/rzv2n.inc

MACHINEOVERRIDES =. "e1m-v2m101:e1m-v2n101:"

PREFERRED_PROVIDER_virtual/kernel = "linux-renesas"

# Install the alp-sdk runtime + DEEPX driver + DEEPX runtime
# alongside the ROS 2 base packages.  dx-rt brings dx_rt + the
# Linux kernel driver as a built-in module.
IMAGE_INSTALL:append = " \
    alp-sdk                       \
    dx-rt                         \
    kernel-module-dx-rt-npu       \
    ros-humble-rclcpp             \
    ros-humble-sensor-msgs        \
    ros-humble-vision-msgs        \
"

KERNEL_DEVICETREE:append = " renesas/e1m-x-evk-v2m.dts"
```

## meta-alp-sdk/conf/machine/e1m-v2n101.conf
```bitbake
#@TYPE: Machine
#@NAME: E1M-V2N101 (V2N base)
#@DESCRIPTION: ALP Lab E1M-V2N101 SoM (Renesas RZ/V2N quad-A55 +
#              M33 + DRP-AI3) on the E1M-X-EVK carrier.

require conf/machine/include/rzv2n.inc

MACHINEOVERRIDES =. "e1m-v2n101:"

# Bootloader + kernel + dtb come straight from meta-renesas; we
# just add the alp-sdk overlays + the ROS 2 base packages.
PREFERRED_PROVIDER_virtual/kernel = "linux-renesas"

IMAGE_INSTALL:append = " alp-sdk ros-humble-rclcpp ros-humble-sensor-msgs"

# DEEPX runtime is NOT installed on V2N101 -- the SoM has no DEEPX
# silicon.  V2M101 (separate machine conf) adds dx-rt.

# Carrier overlay: E1M-X-EVK exposes USB-CDC console + dual
# Ethernet + 2x mPCIe slots.
KERNEL_DEVICETREE:append = " renesas/e1m-x-evk.dts"
```

## src/lib/gfx_compat/Kconfig
```kconfig
# SPDX-License-Identifier: Apache-2.0
#
# gfx_compat -- maintainer-written in-tree shim (src/lib/gfx_compat/).
# Moved out of zephyr/Kconfig.alp-libraries into this per-library
# Kconfig (rsourced from there) so the shim's Kconfig + CMakeLists.txt
# + sources live together, matching the "CMakeLists.txt + Kconfig"
# shape every other in-tree library integration point in this repo
# documents in its comments (see Kconfig.alp-libraries's own header
# comment). Every other §D.lib knob stays centralized in
# Kconfig.alp-libraries -- gfx_compat is the one exception because,
# unlike the other 24 libraries, it has no upstream and no west
# pin: this directory *is* the upstream.

config ALP_GFX_COMPAT_GPU2D
	bool "gfx_compat -> Alif GPU2D backend"
config ALP_GFX_COMPAT_DMA2D
	bool "gfx_compat -> generic DMA2D backend"
config ALP_GFX_COMPAT_SPI_DMA
	bool "gfx_compat SPI push via DMA"
config ALP_GFX_COMPAT_SW
	bool "gfx_compat pure-C SW blit (fallback)"
	default y
```
