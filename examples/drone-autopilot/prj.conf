## CMakeLists.txt
```
# SPDX-License-Identifier: Apache-2.0
cmake_minimum_required(VERSION 3.20.0)

# PYTHON_EXECUTABLE is only set after find_package(Zephyr);
# we need a Python interpreter at configure time *before*
# that, so resolve one ourselves here.
find_package(Python3 REQUIRED COMPONENTS Interpreter)

execute_process(
    COMMAND ${Python3_EXECUTABLE}
            ${CMAKE_CURRENT_SOURCE_DIR}/../../scripts/alp_project.py
            --input  ${CMAKE_CURRENT_SOURCE_DIR}/board.yaml
            --output ${CMAKE_CURRENT_BINARY_DIR}/alp.conf
            --emit zephyr-conf
    RESULT_VARIABLE rc
)
if(NOT rc EQUAL 0)
    message(FATAL_ERROR "alp_project.py failed (rc=${rc})")
endif()
set(OVERLAY_CONFIG ${CMAKE_CURRENT_BINARY_DIR}/alp.conf)

find_package(Zephyr REQUIRED HINTS $ENV{ZEPHYR_BASE})
project(drone_autopilot LANGUAGES C)

target_sources(app PRIVATE
    src/main.c
    src/autopilot.c
    src/sbus.c
    src/mixer.c
    src/mavlink.c
)
```

## prj.conf
```kconfig
# SPDX-License-Identifier: Apache-2.0
CONFIG_MAIN_STACK_SIZE=8192

CONFIG_LOG=y
CONFIG_LOG_PRINTK=y

# Tight scheduling: rate loop runs at 1 kHz, attitude at 250 Hz,
# nav at 25 Hz.  Cooperative threads + tick-rate set high.
CONFIG_NUM_PREEMPT_PRIORITIES=8
# 100 us tick resolution.
CONFIG_SYS_CLOCK_TICKS_PER_SEC=10000
# k_cycle_get_*() needed for jitter audit.
CONFIG_TIMING_FUNCTIONS=y

# Compile-time gate for the flight-loop tracing (helpful during
# bring-up; off by default to keep the loop ISR-clean).
# CONFIG_AUTOPILOT_TRACE_RATE_LOOP=y
```

## src/main.c
```c
/*
 * Copyright 2026 ALP Lab AB
 * SPDX-License-Identifier: Apache-2.0
 *
 * Drone autopilot main entry point.
 *
 * Spawns three deterministic control loops + the RC receiver
 * thread.  The PWM bank is owned by autopilot.c; this file just
 * orchestrates the threads.
 *
 * ── Thread priorities ──────────────────────────────────────────
 *
 *   prio 1   rate_loop      1 kHz   -- highest; never blocked.
 *   prio 2   attitude_loop  250 Hz
 *   prio 3   rc_loop        50 Hz   -- SBUS UART read.
 *   prio 4   nav_loop       25 Hz   -- GPS + baro + battery.
 *   prio 5   mav_tx         10 Hz   -- MAVLink telemetry pack/send.
 *   prio 5   mav_rx         --      -- MAVLink frame parse (UART read).
 *   prio 6   main           --      -- telemetry status print.
 *
 * The rate loop owns the motors.  If it stops getting CPU time
 * the failsafe in nav_loop will cut throttle on the next 40 ms
 * tick -- the design intent is rate loop never starves but
 * defence-in-depth catches the rare case it does.
 */

#include <zephyr/kernel.h>
#include <zephyr/logging/log.h>

#include "alp/peripheral.h"

#include "autopilot.h"
#include "sbus.h"
#include "mavlink.h"

LOG_MODULE_REGISTER(drone_autopilot, LOG_LEVEL_WRN);

/* Single shared autopilot state.  Every loop reads/writes only its
 * own slice of this struct -- see autopilot.h for the single-writer
 * convention.  File-scope so the thread entry trampolines below can
 * find it without dragging context pointers through k_thread_create. */
static autopilot_state_t g_state;

/* 4 KiB per loop is generous for the cascaded PID + small ring buffers;
 * Madgwick + the mixer keep their state in g_state, not on the stack. */
#define STACK_SIZE 4096
K_THREAD_STACK_DEFINE(stk_rate,    STACK_SIZE);
K_THREAD_STACK_DEFINE(stk_atti,    STACK_SIZE);
K_THREAD_STACK_DEFINE(stk_nav,     STACK_SIZE);
K_THREAD_STACK_DEFINE(stk_rc,      STACK_SIZE);
K_THREAD_STACK_DEFINE(stk_mav_tx,  STACK_SIZE);
K_THREAD_STACK_DEFINE(stk_mav_rx,  STACK_SIZE);

/* Thread control blocks live alongside their stacks so the scheduler
 * can find them; each one binds to exactly one of the loops below. */
static struct k_thread t_rate, t_atti, t_nav, t_rc, t_mav_tx, t_mav_rx;

/* ── Thread entry trampolines ───────────────────────────────────────
 * Zephyr's k_thread_create signature is (void*,void*,void*) so each
 * loop gets a thin shim that forwards into the strongly-typed loop
 * function with the shared g_state pointer.  Keeping them tiny keeps
 * the call site obvious to the reviewer. */
static void rate_entry(void *p1, void *p2, void *p3) {
    ARG_UNUSED(p1); ARG_UNUSED(p2); ARG_UNUSED(p3);
    autopilot_rate_loop(&g_state);
}
static void atti_entry(void *p1, void *p2, void *p3) {
    ARG_UNUSED(p1); ARG_UNUSED(p2); ARG_UNUSED(p3);
    autopilot_attitude_loop(&g_state);
}
static void nav_entry(void *p1, void *p2, void *p3) {
    ARG_UNUSED(p1); ARG_UNUSED(p2); ARG_UNUSED(p3);
    autopilot_nav_loop(&g_state);
}
static void rc_entry(void *p1, void *p2, void *p3) {
    ARG_UNUSED(p1); ARG_UNUSED(p2); ARG_UNUSED(p3);
    autopilot_rc_loop(&g_state);
}
static void mav_tx_entry(void *p1, void *p2, void *p3) {
    ARG_UNUSED(p1); ARG_UNUSED(p2); ARG_UNUSED(p3);
    alp_mavlink_telem_loop(&g_state);
}
static void mav_rx_entry(void *p1, void *p2, void *p3) {
    ARG_UNUSED(p1); ARG_UNUSED(p2); ARG_UNUSED(p3);
    alp_mavlink_rx_loop(&g_state);
}

int main(void)
{
    LOG_INF("drone-autopilot booting (state machine in DISARMED)");

    /* ── Sensor + actuator bring-up ────────────────────────────────
     * autopilot_init() opens the IMU (LSM6DSO over I2C), the
     * barometer (BMP390), the GPS UART (u-blox NEO-M9N), the battery
     * sense (INA236), the SBUS RX UART, and the four ESC PWMs.  All
     * of these come through the portable `<alp/*>` surfaces so the
     * same code runs across any SoM whose preset declares the bus
     * mapping; chip-specific work lives behind alp_chips/<part>.
     *
     * If init fails (a sensor missing, wrong i2c addr, …) we DO NOT
     * exit -- the autopilot stays in DISARMED forever, but we still
     * need the RC loop alive so the pilot can see the arming-rejected
     * feedback via the radio's RX-loss / failsafe indicator on their
     * transmitter.  Silent dead firmware is worse than a flashing
     * red light. */
    if (autopilot_init(&g_state) != 0) {
        LOG_ERR("autopilot_init failed -- staying in DISARMED");
        /* Don't return -- still spawn the RC loop so the pilot can
         * see the arming-rejected feedback via the radio's RX-loss
         * indicator. */
    }

    /* ── Spawn control loops in priority order ─────────────────────
     * Higher-rate loops get higher priority (lower numeric value in
     * Zephyr's PREEMPT scheme).  The rate loop at 1 kHz must never
     * be starved -- everything else is allowed to slip a tick if the
     * CPU is busy; the rate loop is the one that keeps the airframe
     * upright. */

    /* prio 1: 1 kHz inner rate loop -- gyro -> rate PID -> motor mix
     * -> ESC PWMs.  Highest priority of any application thread.  If
     * this ever stops getting CPU time, the failsafe in nav_loop
     * will cut throttle on the next 40 ms tick (defence in depth). */
    k_thread_create(&t_rate, stk_rate, K_THREAD_STACK_SIZEOF(stk_rate),
                    rate_entry, NULL, NULL, NULL,
                    K_PRIO_PREEMPT(1), 0, K_NO_WAIT);
    k_thread_name_set(&t_rate, "rate_loop");

    /* prio 2: 250 Hz attitude loop -- accel+gyro -> Madgwick fuse
     * -> attitude PID -> rate setpoints.  Feeds the rate loop above. */
    k_thread_create(&t_atti, stk_atti, K_THREAD_STACK_SIZEOF(stk_atti),
                    atti_entry, NULL, NULL, NULL,
                    K_PRIO_PREEMPT(2), 0, K_NO_WAIT);
    k_thread_name_set(&t_atti, "atti_loop");

    /* prio 3: 50 Hz SBUS RC receiver -- UART read of the 25-byte
     * SBUS frame from the radio.  Writes stick + mode + rc_link_ok
     * into g_state for the inner loops to consume. */
    k_thread_create(&t_rc, stk_rc, K_THREAD_STACK_SIZEOF(stk_rc),
                    rc_entry, NULL, NULL, NULL,
                    K_PRIO_PREEMPT(3), 0, K_NO_WAIT);
    k_thread_name_set(&t_rc, "rc_recv");

    /* prio 4: 25 Hz navigation loop -- GPS + baro + battery monitoring.
     * Lower frequency because GNSS solutions only refresh ~10 Hz and
     * altitude smoothing benefits from longer windows.  Also owns the
     * failsafe arbitration (RC-loss, battery-critical, etc.). */
    k_thread_create(&t_nav, stk_nav, K_THREAD_STACK_SIZEOF(stk_nav),
                    nav_entry, NULL, NULL, NULL,
                    K_PRIO_PREEMPT(4), 0, K_NO_WAIT);
    k_thread_name_set(&t_nav, "nav_loop");

    /* ── MAVLink ground-station link (optional) ────────────────────
     * QGroundControl / Mission Planner speak MAVLink over a serial
     * radio (typically a 433/915 MHz SiK telemetry modem).  sysid=1
     * + compid=1 is the convention for "the autopilot itself"; in a
     * multi-drone swarm each airframe gets a unique sysid so the GCS
     * can tell them apart.  Customers usually wire this to a SoM
     * Kconfig knob rather than hard-coding. */
    if (alp_mavlink_init(/*sysid=*/1, /*compid=*/1) != 0) {
        /* Telemetry is non-critical: a failed link just means no
         * GCS visibility.  Flight loops above keep running. */
        LOG_WRN("alp_mavlink_init failed -- telemetry link disabled");
    } else {
        /* prio 5: 10 Hz outbound telemetry -- packs HEARTBEAT,
         * ATTITUDE, GLOBAL_POSITION_INT, BATTERY_STATUS frames from
         * g_state and writes them to the GCS UART. */
        k_thread_create(&t_mav_tx, stk_mav_tx,
                        K_THREAD_STACK_SIZEOF(stk_mav_tx),
                        mav_tx_entry, NULL, NULL, NULL,
                        K_PRIO_PREEMPT(5), 0, K_NO_WAIT);
        k_thread_name_set(&t_mav_tx, "mav_tx");

        /* prio 5: inbound MAVLink parser -- blocks in UART read,
         * dispatches MAV_CMD_* into the autopilot (e.g. arm/disarm
         * from QGC, waypoint upload, parameter set).  Same priority
         * as TX because neither is timing-critical. */
        k_thread_create(&t_mav_rx, stk_mav_rx,
                        K_THREAD_STACK_SIZEOF(stk_mav_rx),
                        mav_rx_entry, NULL, NULL, NULL,
                        K_PRIO_PREEMPT(5), 0, K_NO_WAIT);
        k_thread_name_set(&t_mav_rx, "mav_rx");
    }

    /* ── Main thread becomes the diagnostic printer ────────────────
     * Slow telemetry print at 1 Hz to the diagnostic UART (Zephyr
     * console).  Useful during bring-up on the bench when no GCS is
     * attached -- you can watch attitude + altitude + battery climb
     * via `west espresso monitor` or any TTY viewer.
     *
     * Lowest effective priority (prio 6 by virtue of being the main
     * thread Zephyr spawned).  This loop never returns; the four
     * spawned loops run forever. */
    while (1) {
        LOG_INF("mode=%d arm=%d roll=%.1f pitch=%.1f alt=%.1fm bat=%.2fV",
                (int)g_state.mode, (int)g_state.armed,
                (double)g_state.roll, (double)g_state.pitch,
                (double)g_state.altitude_m, (double)g_state.battery_v);
        k_msleep(1000);
    }
    /* Unreachable -- here so the compiler doesn't whine about main's
     * declared return type.  If you ever turn the while-loop into a
     * conditional, this is your normal exit. */
    return 0;
}

/* ── RC receiver loop ─────────────────────────────────────────────
 *
 * SBUS is the Futaba serial RC protocol used by most modern radio
 * receivers: 100 kbaud, 8E2, inverted UART, 25-byte frames at 14 ms
 * cadence (or 7 ms in "high-speed" mode).  Each frame carries 16
 * 11-bit channels plus a flags byte (frame_lost, failsafe).
 *
 * Lives in main.c rather than autopilot.c so the orchestration is
 * all in one place; autopilot.c owns the sensors+motors and exposes
 * the SBUS UART handle through a tiny re-export.
 */

/* Re-exported from autopilot.c -- the UART was opened during
 * autopilot_init() and the handle is owned over there. */
extern alp_uart_t *autopilot_rc_uart(void);   /* defined in autopilot.c */

void autopilot_rc_loop(autopilot_state_t *s)
{
    /* The autopilot owns the UART handle; we pull frame bytes via
     * a small re-export to keep this file pure-orchestration.
     *
     * last_frame_ms is our RC-link liveness watchdog -- if we go
     * 200 ms without a fresh frame, rc_link_ok flips false and the
     * nav loop's failsafe arbitrator promotes the airframe to
     * AP_MODE_FAILSAFE (controlled descent + land). */
    uint32_t last_frame_ms = 0;
    while (1) {
        sbus_frame_t f;
        /* TODO(sbus): real UART byte-stream framing -- find the
         * 0x0F start byte, then read 24 bytes.  Stubbed here so
         * the demo compiles standalone; v0.6 wires the real
         * frame slicer.  Pretend we got a frame every 20 ms so
         * the failsafe doesn't trip in the simulator.
         *
         * Real implementation will: alp_uart_read() into a small
         * byte ring, hunt for the 0x0F start byte, then accumulate
         * exactly 25 bytes and validate the 0x00 end byte. */
        if (true) {
            /* 1024 is the SBUS mid-stick value (range 0..2047,
             * mid = 1024 = "stick centred").  Filling every
             * channel with the neutral value keeps the airframe
             * level under sim. */
            for (int i = 0; i < SBUS_CHANNELS; i++) f.channel[i] = 1024;
            f.frame_lost = false;
            f.failsafe   = false;
            last_frame_ms = k_uptime_get_32();
        }

        /* Channel mapping (Futaba convention):
         *   ch1=roll  ch2=pitch  ch3=throttle  ch4=yaw  ch5=mode
         *
         * Roll/pitch/yaw are bidirectional sticks centred at 1024;
         * we normalise to [-1, +1] with ±800-count stick travel.
         * Throttle is unidirectional (bottom-of-detent = 0) so we
         * just divide by the 2048 full-scale. */
        s->stick_roll     = ((int)f.channel[0] - 1024) / 800.f;
        s->stick_pitch    = ((int)f.channel[1] - 1024) / 800.f;
        s->stick_throttle = (f.channel[2]) / 2048.f;
        s->stick_yaw      = ((int)f.channel[3] - 1024) / 800.f;

        /* Mode switch: ch5 below 600 -> MANUAL, 600..1400 -> STABILISE,
         * above 1400 -> GPS-HOLD.  Edge cases roll up to RTH via the
         * dedicated ch6 trip.
         *
         * The three-position switch on most RC transmitters maps to
         * roughly {300, 1024, 1700} in SBUS counts, so the 600/1400
         * thresholds give comfortable hysteresis around each detent. */
        if      (f.channel[4] < 600)  s->mode = AP_MODE_MANUAL;
        else if (f.channel[4] < 1400) s->mode = AP_MODE_STABILISE;
        else                          s->mode = AP_MODE_GPS_HOLD;
        /* ch6 is the dedicated RTH (return-to-home) trip -- a 2-pos
         * switch the pilot can hit to override whatever ch5 says. */
        if (f.channel[5] > 1400)      s->mode = AP_MODE_RTH;

        /* Arming -- ch7 high + throttle low.
         *
         * The throttle-low guard is non-negotiable: arming with
         * throttle up would spin motors immediately, which is how
         * fingers get cut on the bench.  ArduPilot and PX4 enforce
         * the same pre-arm check. */
        s->armed = (f.channel[6] > 1400) && (s->stick_throttle < 0.05f);
        /* If disarmed for any reason, force the mode back to
         * DISARMED so downstream loops can't accidentally spin
         * motors based on stale mode state. */
        if (!s->armed) s->mode = AP_MODE_DISARMED;

        /* RC link-OK if we've seen a frame in the last 200 ms.
         * 200 ms = 10 missed frames at 20 ms cadence, generous
         * enough to ride out transient radio dropouts without
         * triggering failsafe on every glitch. */
        s->rc_link_ok = (k_uptime_get_32() - last_frame_ms) < 200;

        /* 50 Hz nominal poll rate (20 ms).  SBUS frames arrive at
         * ~70 Hz natively, so we'll never miss two in a row at this
         * cadence even with worst-case jitter. */
        k_msleep(20);
    }
}
```

## src/autopilot.c
```c
/*
 * Copyright 2026 ALP Lab AB
 * SPDX-License-Identifier: Apache-2.0
 *
 * Drone autopilot implementation.
 *
 * Three control loops + the navigator + the failsafe:
 *
 *   ┌─────────────────────────────────────────────────────────┐
 *   │  25 Hz   nav loop      (alt + pos PID -> atti setpoint) │
 *   │  250 Hz  atti loop     (att PID  -> rate setpoint)      │
 *   │  1 kHz   rate loop     (rate PID -> motor mix -> ESCs)  │
 *   └─────────────────────────────────────────────────────────┘
 *
 * Each loop reads the autopilot_state_t snapshot, applies its
 * stage of the PID cascade, writes its outputs back, and sleeps.
 * Single-writer per field; the snapshot copy in main() shows the
 * pilot a consistent telemetry view.
 *
 * Sensor bring-up + the PWM bank live in autopilot_init().
 */

#include <zephyr/kernel.h>
#include <zephyr/logging/log.h>
#include <math.h>
#include <string.h>

#include "alp/peripheral.h"
#include "alp/pwm.h"
#include "alp/e1m_pinout.h"
#include "alp/chips/lsm6dso.h"
#include "alp/chips/bmp390.h"
#include "alp/chips/ublox_neo_m9n.h"
#include "alp/chips/ina236.h"

#include "autopilot.h"
#include "mixer.h"

LOG_MODULE_REGISTER(autopilot, LOG_LEVEL_WRN);

/* ───────── Driver handles + bus handles ───────── */
static alp_i2c_t   *s_i2c;
static alp_uart_t  *s_rc_uart;
static alp_uart_t  *s_gps_uart;
static alp_pwm_t   *s_esc[AUTOPILOT_N_MOTORS];

static lsm6dso_t        s_imu;
static bmp390_t         s_baro;
static ublox_neo_m9n_t  s_gps;
static ina236_t         s_batt;

/* ───────── Tiny PID kernel ─────────
 *
 * Minimal PID with anti-windup + derivative-on-measurement.  Real
 * implementation is the `pid` library knob -- which on AEN binds
 * to the FPU SIMD path and on V2N to the TMU CORDIC.  We inline
 * here because the autopilot loop wants the absolute-minimum
 * cycle cost.
 */
typedef struct {
    float kp, ki, kd;
    float integ;
    float prev_meas;
    float out_min, out_max;
} pid_t;

static inline float pid_step(pid_t *p, float setp, float meas, float dt_s) {
    const float err = setp - meas;
    p->integ += err * dt_s;
    /* Clamp the integrator to half the output range. */
    const float i_max = (p->out_max - p->out_min) * 0.5f;
    if (p->integ >  i_max) p->integ =  i_max;
    if (p->integ < -i_max) p->integ = -i_max;
    const float d = (meas - p->prev_meas) / dt_s;
    p->prev_meas = meas;
    float out = p->kp * err + p->ki * p->integ - p->kd * d;
    if (out < p->out_min) out = p->out_min;
    if (out > p->out_max) out = p->out_max;
    return out;
}

/* Per-axis PID instances.  Gains here are conservative starting
 * points; real flight tuning lives in a sysbuild-time KConfig
 * overlay so customers don't have to recompile to twiddle. */
static pid_t s_rate_p = {.kp = 0.10f, .ki = 0.05f, .kd = 0.001f,
                          .out_min = -1.0f, .out_max = 1.0f};
static pid_t s_rate_q = {.kp = 0.10f, .ki = 0.05f, .kd = 0.001f,
                          .out_min = -1.0f, .out_max = 1.0f};
static pid_t s_rate_r = {.kp = 0.08f, .ki = 0.02f, .kd = 0.0f,
                          .out_min = -1.0f, .out_max = 1.0f};

static pid_t s_atti_roll  = {.kp = 4.0f, .ki = 0.0f, .kd = 0.0f,
                              .out_min = -250.f, .out_max = 250.f};   /* dps */
static pid_t s_atti_pitch = {.kp = 4.0f, .ki = 0.0f, .kd = 0.0f,
                              .out_min = -250.f, .out_max = 250.f};

static pid_t s_alt_pid = {.kp = 1.5f, .ki = 0.15f, .kd = 0.5f,
                           .out_min = -3.0f, .out_max = 3.0f};       /* m/s */

/* ───────── Bring-up ───────── */
int autopilot_init(autopilot_state_t *s)
{
    memset(s, 0, sizeof(*s));
    s->mode = AP_MODE_DISARMED;

    s_i2c = alp_i2c_open(&(alp_i2c_config_t){
        .bus_id = E1M_I2C0, .bitrate_hz = 400000,
    });
    if (!s_i2c) { LOG_ERR("I2C0 open failed"); return -1; }

    if (lsm6dso_init(&s_imu,  s_i2c, LSM6DSO_I2C_ADDR_LOW) != ALP_OK) return -2;
    if (bmp390_init(&s_baro, s_i2c, BMP390_I2C_ADDR_PRIMARY) != ALP_OK) return -3;
    if (ina236_init(&s_batt, s_i2c, /*addr_7bit=*/0x40, /*shunt_ohms=*/0.01f,
                    /*max_current_a=*/50.f,
                    /*adcrange=*/INA236_ADCRANGE_81MV) != ALP_OK) return -4;

    /* GNSS + SBUS RC.  Both are UART; SBUS expects 100000/8E2 inverted
     * but most carriers + Zephyr UART drivers don't expose the inverted
     * polarity directly -- customers wire an external inverter or use
     * a microcontroller-side inverter chip. */
    s_gps_uart = alp_uart_open(&(alp_uart_config_t){
        .port_id = E1M_UART0, .baudrate = 9600,
    });
    s_rc_uart  = alp_uart_open(&(alp_uart_config_t){
        .port_id = E1M_UART1, .baudrate = 100000,
    });
    if (s_gps_uart) ublox_neo_m9n_init(&s_gps, s_gps_uart);

    /* ESC PWM bank -- 400 Hz BLHeli-flavoured ESC compatibility.
     * Real ESC types vary; customers tune the period_ns to match
     * (DShot uses its own protocol and bypasses the PWM path
     * entirely). */
    for (int i = 0; i < AUTOPILOT_N_MOTORS; i++) {
        s_esc[i] = alp_pwm_open(&(alp_pwm_config_t){
            .channel_id = E1M_PWM0 + i,
            .period_ns  = 2500000,   /* 400 Hz. */
            .polarity   = ALP_PWM_POLARITY_NORMAL,
        });
        if (!s_esc[i]) {
            LOG_ERR("ESC%d open failed", i);
            return -10 - i;
        }
        alp_pwm_set_duty(s_esc[i], 0);
    }

    return 0;
}

/* ───────── Per-loop entrypoints ───────── */

void autopilot_rate_loop(autopilot_state_t *s)
{
    const float dt_s = 0.001f;   /* 1 kHz. */
    while (1) {
        /* Inputs: gyro rates (set by the attitude loop on a fresh
         * IMU read; we re-read here too so the rate loop's PID
         * sees the freshest sample at 1 kHz). */
        lsm6dso_axes_t g = {0};
        if (lsm6dso_read_gyro(&s_imu, &g) == ALP_OK) {
            /* Raw int16 counts -> rad/s.  Default FS is +/-250 dps
             * where 1 dps = 114.286 LSB; deg -> rad scales by
             * pi/180.  v0.6 reads the SoM's configured FS. */
            const float dps_per_lsb = 1.f / 114.286f;
            const float deg_to_rad  = 3.14159265f / 180.f;
            s->p = g.x * dps_per_lsb * deg_to_rad;
            s->q = g.y * dps_per_lsb * deg_to_rad;
            s->r = g.z * dps_per_lsb * deg_to_rad;
        }

        /* Rate setpoints feed in from the atti loop in stabilised
         * modes; in MANUAL the sticks drive the rate setpoint
         * directly. */
        const float setp_p = (s->mode == AP_MODE_MANUAL)
                              ? s->stick_roll  * 250.f * (3.14159265f / 180.f)
                              : s->setp_roll   * (3.14159265f / 180.f);
        const float setp_q = (s->mode == AP_MODE_MANUAL)
                              ? s->stick_pitch * 250.f * (3.14159265f / 180.f)
                              : s->setp_pitch  * (3.14159265f / 180.f);
        const float setp_r = s->stick_yaw * 250.f * (3.14159265f / 180.f);

        const float tau_p = pid_step(&s_rate_p, setp_p, s->p, dt_s);
        const float tau_q = pid_step(&s_rate_q, setp_q, s->q, dt_s);
        const float tau_r = pid_step(&s_rate_r, setp_r, s->r, dt_s);

        const float thr = (s->mode == AP_MODE_DISARMED ||
                           s->mode == AP_MODE_FAILSAFE)
                          ? 0.0f
                          : s->stick_throttle;

        mixer_x_quad(thr, tau_p, tau_q, tau_r, s->motor_cmd);
        autopilot_emit_motors(s);

        k_msleep(1);
    }
}

void autopilot_attitude_loop(autopilot_state_t *s)
{
    const float dt_s = 1.f / 250.f;
    while (1) {
        /* TODO(madgwick): real fusion via the library knob.  For
         * v0.5 paper-correctness we approximate roll/pitch from the
         * accelerometer at static conditions; the rate loop's gyro
         * integration handles dynamics until the AHRS lands. */
        lsm6dso_axes_t a = {0};
        if (lsm6dso_read_accel(&s_imu, &a) == ALP_OK) {
            /* Raw int16 counts -> g.  Default FS is +/-2 g where
             * 1 g = 16384 LSB.  v0.6 reads the SoM's configured FS
             * and uses it here. */
            const float ax = a.x / 16384.f;
            const float ay = a.y / 16384.f;
            const float az = a.z / 16384.f;
            const float pitch = atan2f(-ax, sqrtf(ay * ay + az * az));
            const float roll  = atan2f(ay, az);
            s->roll  = roll  * 180.f / 3.14159265f;
            s->pitch = pitch * 180.f / 3.14159265f;
        }

        /* Attitude setpoints from sticks (STABILISE) or nav loop
         * (GPS-HOLD/RTH). */
        if (s->mode == AP_MODE_STABILISE || s->mode == AP_MODE_GPS_HOLD ||
            s->mode == AP_MODE_RTH) {
            const float roll_sp  = (s->mode == AP_MODE_STABILISE)
                                    ? s->stick_roll  * 25.f
                                    : s->setp_roll;
            const float pitch_sp = (s->mode == AP_MODE_STABILISE)
                                    ? s->stick_pitch * 25.f
                                    : s->setp_pitch;
            s->setp_roll  = pid_step(&s_atti_roll,  roll_sp,  s->roll,  dt_s);
            s->setp_pitch = pid_step(&s_atti_pitch, pitch_sp, s->pitch, dt_s);
        }

        k_msleep(4);
    }
}

void autopilot_nav_loop(autopilot_state_t *s)
{
    const float dt_s = 1.f / 25.f;
    while (1) {
        /* Barometer altitude.  Compensation lives in the real
         * driver; for paper-correctness we just emit the raw
         * pressure cast into "metres" via a coarse 1 hPa = 8.5 m
         * rule.  v0.6 wires the proper altitude formula. */
        s->altitude_m += 0.0f;  /* placeholder until v0.6. */

        /* GNSS poll. */
        if (s_gps_uart) {
            uint8_t line[128];
            size_t  got;
            (void)ublox_neo_m9n_read_nmea_line(&s_gps, line, sizeof(line),
                                                &got, /*timeout_ms=*/20);
        }

        /* Battery telemetry + failsafe check. */
        int32_t mv = 0, ua = 0;
        if (ina236_read_bus_mv(&s_batt, &mv) == ALP_OK &&
            ina236_read_current_ua(&s_batt, &ua) == ALP_OK) {
            s->battery_v = mv / 1000.f;
            s->battery_a = ua / 1.0e6f;
        }
        /* 3.3 V/cell critical -- 4S pack -> 13.2 V trip. */
        if (s->battery_v > 0.f && s->battery_v < 13.2f) {
            s->mode = AP_MODE_FAILSAFE;
        }
        /* RC link loss failsafe. */
        if (!s->rc_link_ok && s->mode != AP_MODE_DISARMED) {
            s->mode = AP_MODE_FAILSAFE;
        }

        /* GPS-HOLD / RTH setpoint generation.  v0.5 stub: hold
         * level pitch + zero roll; v0.6 fills in the proper
         * position controller. */
        if (s->mode == AP_MODE_GPS_HOLD || s->mode == AP_MODE_RTH) {
            s->setp_roll  = 0.f;
            s->setp_pitch = 0.f;
        }

        /* Altitude PID feeds throttle in altitude-hold modes. */
        if (s->mode == AP_MODE_GPS_HOLD || s->mode == AP_MODE_RTH ||
            s->mode == AP_MODE_FAILSAFE) {
            const float climb_sp = (s->mode == AP_MODE_FAILSAFE) ? -1.0f : 0.f;
            const float alt_correction = pid_step(&s_alt_pid, climb_sp,
                                                   s->climb_rate_mps, dt_s);
            s->stick_throttle = 0.55f + alt_correction * 0.10f;
        }

        k_msleep(40);
    }
}

void autopilot_emit_motors(const autopilot_state_t *s)
{
    for (int i = 0; i < AUTOPILOT_N_MOTORS; i++) {
        /* Convert 0..1 throttle to pulse width 1000..2000 µs
         * (BLHeli-compatible band). */
        const uint32_t pulse_ns =
            (uint32_t)(1000000.f + s->motor_cmd[i] * 1000000.f);
        alp_pwm_set_duty(s_esc[i], pulse_ns);
    }
}
```

## src/autopilot.h
```c
/*
 * Copyright 2026 ALP Lab AB
 * SPDX-License-Identifier: Apache-2.0
 *
 * Drone autopilot -- cascaded PID rate + attitude + altitude loops,
 * flight-mode state machine, motor mixer.  Single-thread per loop;
 * data flows via the shared autopilot_state_t snapshot.
 */

#ifndef DRONE_AUTOPILOT_H
#define DRONE_AUTOPILOT_H

#include <stdint.h>
#include <stdbool.h>

#ifdef __cplusplus
extern "C" {
#endif

#define AUTOPILOT_N_MOTORS 4       /* X-quad layout. */

/** Flight-mode state machine.  Pilot switches via RC channel 5;
 *  failsafe is the only state the autopilot enters on its own. */
typedef enum {
    AP_MODE_DISARMED  = 0,     /**< Motors off; throttle locked to 0. */
    AP_MODE_MANUAL    = 1,     /**< Direct rate-stick → motor output. */
    AP_MODE_STABILISE = 2,     /**< Attitude-stabilised; pilot has stick authority. */
    AP_MODE_GPS_HOLD  = 3,     /**< Position + altitude hold. */
    AP_MODE_RTH       = 4,     /**< Return to home -- waypoint nav back to launch GPS fix. */
    AP_MODE_FAILSAFE  = 5,     /**< RC link lost / battery critical -- descend + land. */
} ap_mode_t;

/** Shared autopilot state.  Single-writer per field:
 *    - rate / atti / nav loops write their own outputs.
 *    - SBUS thread writes stick + mode.
 *    - main thread reads everything for telemetry / motor output.
 *  Memcpy-snapshot read pattern keeps frames consistent without
 *  locks. */
typedef struct {
    /* Attitude (Madgwick output, ENU frame, degrees). */
    float roll, pitch, yaw;

    /* Angular rates (gyro, rad/s). */
    float p, q, r;

    /* Altitude estimate (m AGL, from barometer + GNSS fusion). */
    float altitude_m;
    float climb_rate_mps;

    /* GNSS. */
    float lat_deg, lon_deg;
    bool  gps_fix;

    /* Battery. */
    float battery_v;
    float battery_a;

    /* RC stick inputs (normalised −1..+1; throttle 0..1). */
    float stick_throttle;
    float stick_roll;
    float stick_pitch;
    float stick_yaw;
    bool  rc_link_ok;

    /* Setpoints (mode-dependent: stick-driven in MANUAL/STABILISE,
     * planner-driven in GPS-HOLD/RTH). */
    float setp_roll, setp_pitch, setp_yaw;
    float setp_altitude_m;

    /* Motor commands (0..1 throttle scale). */
    float motor_cmd[AUTOPILOT_N_MOTORS];

    /* Flight mode. */
    ap_mode_t mode;
    bool      armed;
} autopilot_state_t;

/** Bring up sensors + PWMs + UARTs.  @return 0 on success. */
int  autopilot_init(autopilot_state_t *s);

/** 1 kHz rate loop -- PID on body rates → motor mixer → ESCs.
 *  Runs forever; spawn as its own thread. */
void autopilot_rate_loop(autopilot_state_t *s);

/** 250 Hz attitude loop -- IMU sample → Madgwick fuse → attitude
 *  PID → rate setpoints feed forward into the rate loop. */
void autopilot_attitude_loop(autopilot_state_t *s);

/** 25 Hz navigation loop -- GNSS + barometer → altitude/position
 *  PID → attitude setpoints feed forward into the attitude loop. */
void autopilot_nav_loop(autopilot_state_t *s);

/** SBUS RC receiver parse thread -- 50 Hz UART poll, decode 16
 *  channels into the stick + mode fields. */
void autopilot_rc_loop(autopilot_state_t *s);

/** Push motor_cmd[] to the ESC PWM channels.  Called by the rate
 *  loop after each PID iteration. */
void autopilot_emit_motors(const autopilot_state_t *s);

#ifdef __cplusplus
} /* extern "C" */
#endif

#endif /* DRONE_AUTOPILOT_H */
```

## src/mavlink.c
```c
/*
 * Copyright 2026 ALP Lab AB
 * SPDX-License-Identifier: Apache-2.0
 *
 * MAVLink v2 implementation.  Packs the 7 outbound message types
 * the drone-autopilot needs to round-trip with QGroundControl /
 * Mission Planner; parses HEARTBEAT + COMMAND_LONG inbound.
 */

#include <zephyr/kernel.h>
#include <zephyr/logging/log.h>
#include <string.h>

#include "alp/peripheral.h"
#include "alp/e1m_pinout.h"

#include "mavlink.h"

LOG_MODULE_REGISTER(mavlink, LOG_LEVEL_INF);

/* ───────── State ───────── */

static alp_uart_t       *s_uart;
static uint8_t           s_sysid     = 1;
static uint8_t           s_compid    = 1;
static uint8_t           s_tx_seq    = 0;
static uint32_t          s_last_gcs_ms = 0;
static alp_mavlink_rx_t  s_rx;

/* ───────── CRC-X.25 (MAVLink CRC) ─────────
 *
 * MAVLink uses CRC-16/X.25 over the frame (excluding the start
 * byte) plus one extra "magic" byte per message type that the
 * dialect generator computes from the field types.  For our
 * minimal stack we hard-code the magic bytes for the 7 message
 * types we emit + COMMAND_LONG (the only one we parse). */

static const uint8_t s_crc_extra[] = {
    [ALP_MAVLINK_MSG_HEARTBEAT]       =  50,
    [ALP_MAVLINK_MSG_GPS_RAW_INT]     =  24,
    [ALP_MAVLINK_MSG_ATTITUDE]        =  39,
    [ALP_MAVLINK_MSG_GLOBAL_POSITION] = 104,
    [ALP_MAVLINK_MSG_RC_CHANNELS]     = 118,
    [ALP_MAVLINK_MSG_COMMAND_LONG]    = 152,
    [ALP_MAVLINK_MSG_BATTERY_STATUS]  = 154,
};

static uint16_t crc_update(uint16_t crc, uint8_t b) {
    uint8_t tmp = b ^ (uint8_t)(crc & 0xFF);
    tmp ^= tmp << 4;
    return (uint16_t)((crc >> 8) ^ (tmp << 8) ^ (tmp << 3) ^ (tmp >> 4));
}

static uint16_t crc_calc(const uint8_t *buf, size_t len, uint8_t magic) {
    uint16_t crc = 0xFFFFu;
    for (size_t i = 0; i < len; i++) crc = crc_update(crc, buf[i]);
    return crc_update(crc, magic);
}

/* ───────── TX framing ───────── */

static void send_frame(uint32_t msgid, const uint8_t *payload, uint8_t plen) {
    if (s_uart == NULL || msgid >= sizeof(s_crc_extra) ||
        s_crc_extra[msgid] == 0) {
        return;
    }
    uint8_t frame[256 + 12];
    frame[0] = ALP_MAVLINK_STX_V2;
    frame[1] = plen;
    frame[2] = 0;                       /* incompat_flags */
    frame[3] = 0;                       /* compat_flags */
    frame[4] = s_tx_seq++;
    frame[5] = s_sysid;
    frame[6] = s_compid;
    frame[7] = (uint8_t)(msgid & 0xFF);
    frame[8] = (uint8_t)((msgid >> 8) & 0xFF);
    frame[9] = (uint8_t)((msgid >> 16) & 0xFF);
    if (plen > 0 && payload != NULL) {
        memcpy(&frame[10], payload, plen);
    }
    const uint16_t crc = crc_calc(&frame[1], 9u + plen, s_crc_extra[msgid]);
    frame[10 + plen]     = (uint8_t)(crc & 0xFF);
    frame[10 + plen + 1] = (uint8_t)((crc >> 8) & 0xFF);
    alp_uart_write(s_uart, frame, 12u + plen);
}

/* ───────── Outbound messages ───────── */

static void send_heartbeat(const autopilot_state_t *s) {
    /* HEARTBEAT payload (mavlink v2 zero-truncated trailing bytes):
     *   uint32_t custom_mode
     *   uint8_t  type
     *   uint8_t  autopilot
     *   uint8_t  base_mode
     *   uint8_t  system_status
     *   uint8_t  mavlink_version */
    uint8_t p[9];
    uint32_t custom = (uint32_t)s->mode;
    memcpy(&p[0], &custom, 4);
    p[4] = ALP_MAV_TYPE_QUADROTOR;
    p[5] = ALP_MAV_AUTOPILOT_GENERIC;
    p[6] = s->armed ? 0x80u : 0x00u; /* base_mode: SAFETY_ARMED bit. */
    p[7] = (s->mode == AP_MODE_FAILSAFE) ? 6 : (s->armed ? 4 : 3);  /* MAV_STATE */
    p[8] = 3;                                                       /* mavlink version */
    send_frame(ALP_MAVLINK_MSG_HEARTBEAT, p, sizeof(p));
}

static void send_attitude(const autopilot_state_t *s) {
    /* ATTITUDE payload:
     *   uint32_t time_boot_ms
     *   float    roll, pitch, yaw      (rad)
     *   float    rollspeed, pitchspeed, yawspeed (rad/s) */
    uint8_t p[28];
    const uint32_t t = k_uptime_get_32();
    memcpy(&p[0],  &t,         4);
    const float r  = s->roll  * 3.14159265f / 180.f;
    const float pp = s->pitch * 3.14159265f / 180.f;
    const float y  = s->yaw   * 3.14159265f / 180.f;
    memcpy(&p[4],  &r,  4);
    memcpy(&p[8],  &pp, 4);
    memcpy(&p[12], &y,  4);
    memcpy(&p[16], &s->p, 4);
    memcpy(&p[20], &s->q, 4);
    memcpy(&p[24], &s->r, 4);
    send_frame(ALP_MAVLINK_MSG_ATTITUDE, p, sizeof(p));
}

static void send_battery(const autopilot_state_t *s) {
    /* BATTERY_STATUS payload (subset):
     *   int32_t  current_consumed (mAh -- -1 if unknown)
     *   int32_t  energy_consumed (hJ  -- -1 if unknown)
     *   int16_t  temperature (cdegC -- INT16_MAX if unknown)
     *   uint16_t voltages[10] (mV)   -- per-cell; 0xFFFF = N/A.
     *   int16_t  current_battery (cA -- -1 if unknown)
     *   uint8_t  id
     *   uint8_t  battery_function
     *   uint8_t  type
     *   int8_t   battery_remaining (% -- -1 if unknown) */
    uint8_t p[36];
    memset(p, 0, sizeof(p));
    /* current_consumed unknown */
    int32_t neg1 = -1;
    memcpy(&p[0], &neg1, 4);
    memcpy(&p[4], &neg1, 4);
    int16_t int_max16 = 0x7FFF;
    memcpy(&p[8], &int_max16, 2);
    /* Cells: assume 4S, fill mv per cell as battery_v/4 * 1000. */
    uint16_t mv_per_cell = (uint16_t)((s->battery_v / 4.f) * 1000.f);
    for (int c = 0; c < 4; c++) {
        memcpy(&p[10 + c * 2], &mv_per_cell, 2);
    }
    for (int c = 4; c < 10; c++) {
        uint16_t off = 0xFFFFu;
        memcpy(&p[10 + c * 2], &off, 2);
    }
    int16_t ca = (int16_t)(s->battery_a * 100.f);   /* 10 mA / cA. */
    memcpy(&p[30], &ca, 2);
    p[32] = 0;          /* id */
    p[33] = 0;          /* function: ALL */
    p[34] = 2;          /* type: LIPO */
    p[35] = (int8_t)(s->battery_v >= 16.8f ? 100 :
                       (s->battery_v <  13.2f ?   5 :
                       (int8_t)((s->battery_v - 13.2f) * (100.f / 3.6f))));
    send_frame(ALP_MAVLINK_MSG_BATTERY_STATUS, p, sizeof(p));
}

static void send_gps_raw(const autopilot_state_t *s) {
    /* GPS_RAW_INT payload (subset):
     *   uint64_t time_usec
     *   int32_t  lat (1e7 deg)
     *   int32_t  lon (1e7 deg)
     *   int32_t  alt (mm AMSL)
     *   ...      vel / cog / fix_type / sats_visible / ... */
    uint8_t p[30];
    memset(p, 0, sizeof(p));
    uint64_t t = (uint64_t)k_uptime_get_32() * 1000u;
    memcpy(&p[0],  &t, 8);
    int32_t lat = (int32_t)(s->lat_deg * 1.0e7f);
    int32_t lon = (int32_t)(s->lon_deg * 1.0e7f);
    int32_t alt = (int32_t)(s->altitude_m * 1000.f);
    memcpy(&p[8],  &lat, 4);
    memcpy(&p[12], &lon, 4);
    memcpy(&p[16], &alt, 4);
    p[27] = s->gps_fix ? 3 : 0;        /* fix_type: 3=3D, 0=NO_FIX */
    p[28] = 0;                          /* sats_visible -- v0.6 fills this in */
    send_frame(ALP_MAVLINK_MSG_GPS_RAW_INT, p, sizeof(p));
}

/* ───────── RX handling ─────────
 *
 * Payload accessors are by-offset memcpy() rather than the
 * struct-packed accessors the upstream c_library_v2 generates --
 * keeps the dialect-table-free stack small.  When customers swap
 * in the upstream library they get type-safe accessors for free. */

static void handle_rx_msg(uint32_t msgid, const uint8_t *p, uint8_t plen,
                          autopilot_state_t *s)
{
    if (msgid == ALP_MAVLINK_MSG_HEARTBEAT) {
        s_last_gcs_ms = k_uptime_get_32();
        return;
    }
    if (msgid == ALP_MAVLINK_MSG_COMMAND_LONG && plen >= 31) {
        /* COMMAND_LONG layout (subset):
         *   float    param1..param7      (28 B at offset 0)
         *   uint16_t command              (offset 28)
         *   uint8_t  target_system        (offset 30)
         *   ... */
        float    param1; memcpy(&param1, &p[0], 4);
        uint16_t cmd;    memcpy(&cmd,    &p[28], 2);
        switch (cmd) {
            case ALP_MAV_CMD_COMPONENT_ARM_DISARM:
                /* param1 = 1.0 -> arm; 0.0 -> disarm. */
                if (param1 > 0.5f) {
                    s->armed = true;
                    if (s->mode == AP_MODE_DISARMED) s->mode = AP_MODE_STABILISE;
                } else {
                    s->armed = false;
                    s->mode  = AP_MODE_DISARMED;
                }
                LOG_INF("ARM/DISARM via MAVLink: armed=%d", (int)s->armed);
                break;
            case ALP_MAV_CMD_DO_SET_MODE:
                /* param1 = base_mode bits; param2 = custom_mode
                 * (mapped to ap_mode_t). */
                if (s->armed) {
                    s->mode = (ap_mode_t)((int)param1 & 0x7u);
                    LOG_INF("SET_MODE via MAVLink: mode=%d", (int)s->mode);
                }
                break;
            default:
                LOG_INF("unknown MAVLink cmd %u (ignored)", cmd);
                break;
        }
    }
}

static void rx_feed_byte(uint8_t b, autopilot_state_t *s) {
    alp_mavlink_rx_t *r = &s_rx;
    switch (r->state) {
        case ALP_MAV_RX_IDLE:
            if (b == ALP_MAVLINK_STX_V2) {
                r->crc         = 0xFFFFu;
                r->payload_idx = 0;
                r->state       = ALP_MAV_RX_LEN;
            }
            break;
        case ALP_MAV_RX_LEN:
            r->payload_len = b;
            r->crc = crc_update(r->crc, b);
            r->state = ALP_MAV_RX_INCOMPAT;
            break;
        case ALP_MAV_RX_INCOMPAT:
            r->crc = crc_update(r->crc, b);
            r->state = ALP_MAV_RX_COMPAT;
            break;
        case ALP_MAV_RX_COMPAT:
            r->crc = crc_update(r->crc, b);
            r->state = ALP_MAV_RX_SEQ;
            break;
        case ALP_MAV_RX_SEQ:
            r->seq = b;
            r->crc = crc_update(r->crc, b);
            r->state = ALP_MAV_RX_SYSID;
            break;
        case ALP_MAV_RX_SYSID:
            r->sysid = b;
            r->crc = crc_update(r->crc, b);
            r->state = ALP_MAV_RX_COMPID;
            break;
        case ALP_MAV_RX_COMPID:
            r->compid = b;
            r->crc = crc_update(r->crc, b);
            r->state = ALP_MAV_RX_MSGID_LO;
            break;
        case ALP_MAV_RX_MSGID_LO:
            r->msgid = b;
            r->crc = crc_update(r->crc, b);
            r->state = ALP_MAV_RX_MSGID_MID;
            break;
        case ALP_MAV_RX_MSGID_MID:
            r->msgid |= ((uint32_t)b) << 8;
            r->crc = crc_update(r->crc, b);
            r->state = ALP_MAV_RX_MSGID_HI;
            break;
        case ALP_MAV_RX_MSGID_HI:
            r->msgid |= ((uint32_t)b) << 16;
            r->crc = crc_update(r->crc, b);
            r->state = (r->payload_len == 0) ? ALP_MAV_RX_CRC_LO
                                              : ALP_MAV_RX_PAYLOAD;
            break;
        case ALP_MAV_RX_PAYLOAD:
            r->payload[r->payload_idx++] = b;
            r->crc = crc_update(r->crc, b);
            if (r->payload_idx >= r->payload_len) r->state = ALP_MAV_RX_CRC_LO;
            break;
        case ALP_MAV_RX_CRC_LO: {
            uint16_t magic = (r->msgid < sizeof(s_crc_extra))
                              ? s_crc_extra[r->msgid] : 0;
            uint16_t crc   = crc_update(r->crc, (uint8_t)magic);
            if ((uint8_t)(crc & 0xFF) != b) {
                r->state = ALP_MAV_RX_IDLE;
                break;
            }
            r->crc = crc;
            r->state = ALP_MAV_RX_CRC_HI;
            break;
        }
        case ALP_MAV_RX_CRC_HI:
            if ((uint8_t)((r->crc >> 8) & 0xFF) == b) {
                handle_rx_msg(r->msgid, r->payload, r->payload_len, s);
            }
            r->state = ALP_MAV_RX_IDLE;
            break;
    }
}

/* ───────── Public API ───────── */

int alp_mavlink_init(uint8_t sysid, uint8_t compid)
{
    s_sysid  = sysid;
    s_compid = compid;
    /* The GCS link nominally needs its own UART; the E1M family only
     * exposes UART0/1 in v0.5 -- real flight builds wire the SiK radio
     * to an external port on the carrier (TBD pinout).  For paper
     * compile here we map onto UART0 (shared with GNSS); customers
     * route their actual GCS-radio onto the dedicated port. */
    s_uart = alp_uart_open(&(alp_uart_config_t){
        .port_id = E1M_UART0, .baudrate = 57600,
    });
    return s_uart ? 0 : -1;
}

void alp_mavlink_telem_loop(autopilot_state_t *s)
{
    uint32_t i = 0;
    while (1) {
        send_attitude(s);                      /* 10 Hz */
        if ((i % 2) == 0) send_gps_raw(s);     /*  5 Hz */
        if ((i % 10) == 0) {
            send_heartbeat(s);                 /*  1 Hz */
            send_battery(s);                   /*  1 Hz */
        }
        i++;
        k_msleep(100);
    }
}

void alp_mavlink_rx_loop(autopilot_state_t *s)
{
    while (1) {
        uint8_t b;
        if (s_uart && alp_uart_read(s_uart, &b, 1, /*timeout_ms=*/100) == ALP_OK) {
            rx_feed_byte(b, s);
        }
        /* GCS link-loss check: 3 s since last HEARTBEAT trips the
         * MAVLink-specific failsafe (separate from RC-link
         * failsafe in nav_loop). */
        if (k_uptime_get_32() - s_last_gcs_ms > 3000) {
            /* No GCS heartbeat -- the RC-link failsafe in nav_loop
             * still applies, but we log it.  Real production
             * autopilots may want a separate failsafe action when
             * the GCS link drops (e.g. continue mission instead
             * of land). */
        }
    }
}
```

## src/mavlink.h
```c
/*
 * Copyright 2026 ALP Lab AB
 * SPDX-License-Identifier: Apache-2.0
 *
 * MAVLink v2 ground-station link for the drone-autopilot.
 *
 * This is a deliberately minimal MAVLink stack -- enough to talk
 * to QGroundControl / Mission Planner over a serial telemetry
 * radio.  Customers wanting the full message set (200+ message
 * types) drop the upstream
 *
 *     https://github.com/mavlink/c_library_v2
 *
 * into the project's include path; this file's pack/parse helpers
 * are designed to coexist with that header (different symbol
 * prefix: `alp_mavlink_*` vs `mavlink_*`).
 *
 *
 * ── What this stack carries ────────────────────────────────────
 *
 * In v0.5 the GCS link shares UART0 with the GNSS port at the C
 * level (the only two-UART E1M family is short on dedicated radio
 * ports).  Real builds wire the SiK radio to a dedicated board
 * UART that the TBD board overlay exposes.
 *
 *   Tx (autopilot → ground station):
 *     - HEARTBEAT       (msg-id 0)    -- 1 Hz, always.
 *     - ATTITUDE        (msg-id 30)   -- 10 Hz.
 *     - GLOBAL_POSITION_INT (msg-id 33) -- 5 Hz.
 *     - GPS_RAW_INT     (msg-id 24)   -- 5 Hz.
 *     - BATTERY_STATUS  (msg-id 147)  -- 1 Hz.
 *     - RC_CHANNELS     (msg-id 65)   -- 5 Hz.
 *
 *   Rx (ground station → autopilot):
 *     - COMMAND_LONG    (msg-id 76)   -- arm/disarm, mode change.
 *     - HEARTBEAT       (msg-id 0)    -- keepalive; we use it
 *                                         to detect GCS link loss.
 *
 * ── Wire format ────────────────────────────────────────────────
 *
 * MAVLink v2 frame (11 + payload + 2 bytes CRC):
 *
 *   ┌──────┬──────┬──────┬──────┬──────┬──────┬───────────────┬──────┐
 *   │ 0xFD │ plen │ icmp │ csig │ seq  │ sysid│ msgid (3 B)   │ ...  │
 *   └──────┴──────┴──────┴──────┴──────┴──────┴───────────────┴──────┘
 *
 *   followed by `plen` bytes of payload + 2 bytes CRC-X.25.
 *
 * v0.5 stub: pack/parse the 7 message types above with hand-coded
 * marshalling.  Real customers swap in the auto-generated upstream
 * code when they need the full message catalogue.
 */

#ifndef DRONE_AUTOPILOT_MAVLINK_H
#define DRONE_AUTOPILOT_MAVLINK_H

#include <stdint.h>
#include <stdbool.h>
#include <stddef.h>

#include "autopilot.h"

#ifdef __cplusplus
extern "C" {
#endif

/* MAVLink v2 magic + message IDs we handle. */
#define ALP_MAVLINK_STX_V2                0xFDu
#define ALP_MAVLINK_MSG_HEARTBEAT           0u
#define ALP_MAVLINK_MSG_GPS_RAW_INT        24u
#define ALP_MAVLINK_MSG_ATTITUDE           30u
#define ALP_MAVLINK_MSG_GLOBAL_POSITION    33u
#define ALP_MAVLINK_MSG_RC_CHANNELS        65u
#define ALP_MAVLINK_MSG_COMMAND_LONG       76u
#define ALP_MAVLINK_MSG_BATTERY_STATUS    147u

/* HEARTBEAT mav_type / autopilot enums (subset). */
#define ALP_MAV_TYPE_QUADROTOR              2u
#define ALP_MAV_AUTOPILOT_GENERIC           0u

/* COMMAND_LONG command IDs we honour. */
#define ALP_MAV_CMD_COMPONENT_ARM_DISARM  400u
#define ALP_MAV_CMD_DO_SET_MODE           176u

/** Frame-parser state machine. */
typedef struct {
    enum {
        ALP_MAV_RX_IDLE = 0,
        ALP_MAV_RX_LEN,
        ALP_MAV_RX_INCOMPAT,
        ALP_MAV_RX_COMPAT,
        ALP_MAV_RX_SEQ,
        ALP_MAV_RX_SYSID,
        ALP_MAV_RX_COMPID,
        ALP_MAV_RX_MSGID_LO,
        ALP_MAV_RX_MSGID_MID,
        ALP_MAV_RX_MSGID_HI,
        ALP_MAV_RX_PAYLOAD,
        ALP_MAV_RX_CRC_LO,
        ALP_MAV_RX_CRC_HI,
    } state;
    uint8_t  payload_len;
    uint8_t  seq;
    uint8_t  sysid;
    uint8_t  compid;
    uint32_t msgid;
    uint8_t  payload[256];
    uint16_t payload_idx;
    uint16_t crc;
} alp_mavlink_rx_t;

/** Bring up the MAVLink link.  @return 0 on success. */
int  alp_mavlink_init(uint8_t sysid, uint8_t compid);

/** Telemetry loop -- emits HEARTBEAT + ATTITUDE + GPS + BATTERY
 *  at the configured rates from the autopilot state snapshot. */
void alp_mavlink_telem_loop(autopilot_state_t *s);

/** Receive loop -- read frames from the GCS UART, decode
 *  COMMAND_LONG, mutate the autopilot state accordingly
 *  (arm/disarm, mode change). */
void alp_mavlink_rx_loop(autopilot_state_t *s);

#ifdef __cplusplus
} /* extern "C" */
#endif

#endif /* DRONE_AUTOPILOT_MAVLINK_H */
```

## src/mixer.c
```c
/*
 * Copyright 2026 ALP Lab AB
 * SPDX-License-Identifier: Apache-2.0
 */

#include "mixer.h"

static inline float clip01(float v) {
    if (v < 0.f) return 0.f;
    if (v > 1.f) return 1.f;
    return v;
}

void mixer_x_quad(float thr, float tau_p, float tau_q, float tau_r,
                  float out[4])
{
    /* X-quad with M1 front-right (CW), M2 front-left (CCW),
     * M3 rear-left (CW), M4 rear-right (CCW). */
    out[0] = clip01(thr - tau_p + tau_q - tau_r);  /* M1 FR CW */
    out[1] = clip01(thr + tau_p + tau_q + tau_r);  /* M2 FL CCW */
    out[2] = clip01(thr + tau_p - tau_q - tau_r);  /* M3 RL CW */
    out[3] = clip01(thr - tau_p - tau_q + tau_r);  /* M4 RR CCW */
}
```

## src/mixer.h
```c
/*
 * Copyright 2026 ALP Lab AB
 * SPDX-License-Identifier: Apache-2.0
 *
 * X-quad motor mixer.
 *
 *   M1 (CW)  ┃   ┃  M2 (CCW)         (front, viewed from above)
 *           ◢ ┃ ◣
 *           ▒▒▒▒▒
 *           ◣ ┃ ◢
 *   M4 (CCW) ┃   ┃  M3 (CW)
 *
 *   throttle increases every motor.
 *   roll  (tau_p): right wing down  -> M2/M3 up, M1/M4 down.
 *   pitch (tau_q): nose up           -> M3/M4 up, M1/M2 down.
 *   yaw   (tau_r): nose right        -> CCW motors up, CW down.
 */

#ifndef DRONE_AUTOPILOT_MIXER_H
#define DRONE_AUTOPILOT_MIXER_H

#ifdef __cplusplus
extern "C" {
#endif

/** Map throttle + 3-axis torque commands into the 4 motor outputs.
 *  @param thr   Base throttle, 0..1.
 *  @param tau_p Roll torque, -1..+1.
 *  @param tau_q Pitch torque, -1..+1.
 *  @param tau_r Yaw torque, -1..+1.
 *  @param out   Output array of 4 motor commands, 0..1. */
void mixer_x_quad(float thr, float tau_p, float tau_q, float tau_r,
                  float out[4]);

#ifdef __cplusplus
} /* extern "C" */
#endif

#endif /* DRONE_AUTOPILOT_MIXER_H */
```
