## CMakeLists.txt
```
# SPDX-License-Identifier: Apache-2.0
#
# CMakeLists for the Cortex-M55-HP / Zephyr slice of rpmsg-aen.

cmake_minimum_required(VERSION 3.20)

if(DEFINED ENV{ALP_SDK_ROOT})
    set(ALP_SDK_ROOT $ENV{ALP_SDK_ROOT})
else()
    get_filename_component(ALP_SDK_ROOT ${CMAKE_CURRENT_SOURCE_DIR}/../../.. ABSOLUTE)
endif()

find_package(Python3 REQUIRED COMPONENTS Interpreter)

set(_alp_generated ${CMAKE_BINARY_DIR}/generated/alp.conf)
execute_process(
    COMMAND ${Python3_EXECUTABLE} ${ALP_SDK_ROOT}/scripts/alp_project.py
            --input ${CMAKE_CURRENT_SOURCE_DIR}/../board.yaml
            --emit zephyr-conf --core m55_hp
            --output ${_alp_generated}
    RESULT_VARIABLE _alp_rv
    OUTPUT_VARIABLE _alp_stdout
    ERROR_VARIABLE  _alp_stderr
)
if(NOT _alp_rv EQUAL 0)
    message(FATAL_ERROR
        "alp_project.py failed (rv=${_alp_rv}); "
        "check ${CMAKE_CURRENT_SOURCE_DIR}/../board.yaml.\n"
        "stderr: ${_alp_stderr}")
endif()

list(APPEND OVERLAY_CONFIG ${_alp_generated})

# Generate <alp/system_ipc.h> from the board.yaml `ipc:` block.  The
# producer (src/main.c) opens RPC channels via the auto-emitted macros
# (ALP_IPC_<NAME>_NAME, _ADDR, _SIZE, ...), so the header must be on
# the include path before any source compiles.
set(_alp_ipc_header ${CMAKE_BINARY_DIR}/generated/alp/system_ipc.h)
execute_process(
    COMMAND ${Python3_EXECUTABLE} ${ALP_SDK_ROOT}/scripts/alp_project.py
            --input ${CMAKE_CURRENT_SOURCE_DIR}/../board.yaml
            --emit ipc-contract-h
            --output ${_alp_ipc_header}
    RESULT_VARIABLE _alp_ipc_rv
    OUTPUT_VARIABLE _alp_ipc_stdout
    ERROR_VARIABLE  _alp_ipc_stderr
)
if(NOT _alp_ipc_rv EQUAL 0)
    message(FATAL_ERROR
        "alp_project.py --emit ipc-contract-h failed "
        "(rv=${_alp_ipc_rv}); stderr: ${_alp_ipc_stderr}")
endif()

find_package(Zephyr REQUIRED HINTS $ENV{ZEPHYR_BASE})
project(rpmsg_aen_m55_hp LANGUAGES C)

# Expose the orchestrator's generated/ directory so the
# `#include <alp/system_ipc.h>` in src/main.c resolves.
zephyr_include_directories(${CMAKE_BINARY_DIR}/generated)

target_sources(app PRIVATE src/main.c)
```

## prj.conf
```kconfig
# SPDX-License-Identifier: Apache-2.0
#
# Empty by design.  Effective Kconfig is build/generated/alp.conf,
# emitted from this app's board.yaml by scripts/alp_project.py
# and layered via OVERLAY_CONFIG (see CMakeLists.txt).
```

## src/main.c
```c
/*
 * Copyright 2026 ALP Lab AB
 * SPDX-License-Identifier: Apache-2.0
 *
 * rpmsg-aen -- Cortex-M55-HP / Zephyr producer.
 *
 * Reads the carrier's on-board LSM6DSO IMU + BMP581 barometer
 * through the portable <alp/chips/...> surfaces and publishes one
 * `imu_sample` event per second over the framed RPC channel.  The
 * A32 cluster's Linux consumer subscribes to `imu_sample` and
 * prints every payload to stdout.
 *
 * Both sides agree on the wire shape: a fixed-size struct (6 floats
 * + a uint32 sequence number) memcpy'd into the RPMsg payload.  No
 * field-by-field serialisation; the v0.6 framing is opaque payload
 * per spec §6.3.
 */

#include <stdio.h>
#include <string.h>

#include <zephyr/kernel.h>

#include <alp/peripheral.h>
#include <alp/rpc.h>
#include <alp/system_ipc.h> /* generated by alp_orchestrate.py */

/* Shared wire format -- mirror of linux/src/main.c's struct. */
typedef struct {
    uint32_t seq;
    float    accel_g[3];
    float    pressure_pa;
    float    temperature_c;
} __attribute__((packed)) imu_sample_t;

#define SAMPLE_BURST 4u

int main(void)
{
    printf("[m55-hp] rpmsg-aen producer coming up\n");

    const alp_rpc_config_t cfg = {
        .name      = ALP_IPC_ALP_DEFAULT_RPMSG_NAME,
        .src_ept   = ALP_IPC_ALP_DEFAULT_RPMSG_SRC_EPT,
        .dst_ept   = ALP_IPC_ALP_DEFAULT_RPMSG_DST_EPT,
        .mbox_ch   = ALP_IPC_ALP_DEFAULT_RPMSG_MBOX_CH,
        .cacheable = true, /* AEN MRAM is cacheable (spec §6.8). */
    };
    alp_rpc_channel_t *ch = alp_rpc_open(&cfg);
    if (ch == NULL) {
        printf("[m55-hp]   alp_rpc_open failed: last_err=%d\n", (int)alp_last_error());
        goto done;
    }

    /* Producer loop.  On real silicon this reads alp_i2c_xfer()
     * against the LSM6DSO + BMP581 chip drivers; under native_sim
     * the sensors aren't wired so we publish synthetic data so the
     * harness can latch. */
    for (uint32_t i = 0; i < SAMPLE_BURST; ++i) {
        imu_sample_t s = {
            .seq           = i,
            .accel_g       = { 0.0f, 0.0f, 1.0f },
            .pressure_pa   = 101325.0f - (float)i * 12.0f,
            .temperature_c = 22.5f + (float)i * 0.1f,
        };

        const alp_status_t rv = alp_rpc_send(ch, "imu_sample", &s, sizeof s);
        if (rv != ALP_OK) {
            printf("[m55-hp]   alp_rpc_send rv=%d at i=%u\n", (int)rv, (unsigned)i);
            break;
        }
        printf("[m55-hp] published imu_sample seq=%u T=%.1f\n", (unsigned)i,
               (double)s.temperature_c);

#ifndef CONFIG_BOARD_NATIVE_SIM
        k_msleep(1000);
#endif
    }

    alp_rpc_close(ch);

done:
    printf("[rpmsg-aen] done\n");
    return 0;
}
```
