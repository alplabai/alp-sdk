## examples/v2n/v2n-gd32-bridge-loopback/testcase.yaml
```yaml
# SPDX-License-Identifier: Apache-2.0

sample:
  name: v2n-gd32-bridge-loopback
  description: |
    V2N-specific JUMPERED Tier-B LOOPBACK validation of the GD32
    bridge: the analog/timer surfaces that a status-only or
    floating-pad functional test cannot prove are exercised through
    three physical loopback jumpers on the E1M-X V2 carrier --
    DAC0 -> ADC0 (direct 1:1 raw-net tap), PWM ch1 -> ENC1_X,
    and PWM ch2 -> PWM ch3 input-capture.  Each test drives a known
    stimulus and asserts the value that returns over the wire, then
    parks (single pass, then idle forever).  Exercises the gd32g553
    chip-driver surface directly (intentional for this bridge demo
    per spec section 4.5).  BENCH-ONLY: meaningful only on a board
    wired per README.md; builds clean everywhere as a CI artifact.

tests:
  alp_sdk.examples.v2n.gd32_bridge_loopback.native_sim:
    platform_allow:
      - native_sim/native/64
    tags:
      - alp-sdk
      - example
      - v2n
      - supervisor-mcu
      - gd32-bridge
      - hil
      - loopback
    build_only: true
```

## examples/v2n/v2n-gd32-bridge-ping/testcase.yaml
```yaml
# SPDX-License-Identifier: Apache-2.0

sample:
  name: v2n-gd32-bridge-ping
  description: |
    V2N-specific bring-up demo: ping + version round-trip against
    the on-module GD32G553 supervisor MCU via both SPI and I2C
    transports.  Exercises the gd32g553 chip-driver surface
    directly (intentional for this bridge demo per spec §4.5).

tests:
  alp_sdk.examples.v2n.gd32_bridge_ping.native_sim:
    platform_allow:
      - native_sim/native/64
    tags:
      - alp-sdk
      - example
      - v2n
      - supervisor-mcu
      - gd32-bridge
    build_only: true
```

## examples/v2n/v2n-gd32-swd-flash/testcase.yaml
```yaml
# SPDX-License-Identifier: Apache-2.0

sample:
  name: v2n-gd32-swd-flash
  description: |
    Reflash the on-module GD32G553 via SWD from the V2N host's
    three GPIOs (SWDIO + SWCLK + nRST).  Bring-up recovery flow
    for a bricked bridge MCU; uses the chip-driver gd32_swd
    surface directly.

tests:
  alp_sdk.examples.v2n.gd32_swd_flash.native_sim:
    platform_allow:
      - native_sim/native/64
    tags:
      - alp-sdk
      - example
      - v2n
      - swd
      - bridge-recovery
    build_only: true
```

## examples/v2n/v2n-m1-deepx-inference/testcase.yaml
```yaml
# SPDX-License-Identifier: Apache-2.0

sample:
  name: v2n-m1-deepx-inference
  description: |
    DEEPX DX-M1 NPU bring-up + single inference through
    <alp/inference.h> on a V2N-M1 SoM.  Native_sim exercises
    the framing (every step lands on the documented NOSUPPORT
    contract); HiL verification gates on a V2N-M1 EVK + the
    DEEPX runtime + a DXNN-compiled model.
common:
  tags: inference deepx v2n-m1
  harness: console
  harness_config:
    type: one_line
    regex:
      - "\\[deepx\\] done"
tests:
  alp_sdk.examples.v2n_m1_deepx_inference.native_sim:
    platform_allow: native_sim/native/64
  alp_sdk.examples.v2n_m1_deepx_inference.v2n_m1:
    # Build-only until the customer-side dx_rt integration ships.
    # The V2N-M1 board file (alp_e1m_v2m101_m33_sm) already ships
    # in-tree under zephyr/boards/alp/e1m_v2m101_m33_sm/.
    build_only: true
```
