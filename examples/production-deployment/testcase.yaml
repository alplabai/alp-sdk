## examples/production-deployment/testcase.yaml
```yaml
# SPDX-License-Identifier: Apache-2.0

sample:
  name: production-deployment
  description: |
    v1.0 reference application for a field-deployable IoT product.
    Demonstrates the full manufactured -> deployed -> updated ->
    attested lifecycle on a single app (EEPROM factory-identity
    read-back, MCUboot slot inspection, Mender OTA polling,
    OPTIGA-signed remote attestation).  Native_sim exercises the
    framing path (every stage reaches its open() call); HiL
    verification of the actual OTA cycle gates on a staged Mender
    server.
common:
  tags: production secure-boot ota attestation
  harness: console
  harness_config:
    type: one_line
    regex:
      - "\\[prod\\] done"
tests:
  alp_sdk.examples.production_deployment.native_sim:
    platform_allow: native_sim/native/64
  alp_sdk.examples.production_deployment.aen:
    platform_allow:
      - alif_e7_dk_rtss_hp
    build_only: true   # real run needs a staged Mender server.
```

## examples/pwm-led-fade/testcase.yaml
```yaml
# SPDX-License-Identifier: Apache-2.0

sample:
  name: pwm-led-fade
  description: |
    Per-peripheral example for <alp/pwm.h>.  Fades an LED on
    E1M_PWM0.  On native_sim there's no PWM emul controller
    so the example prints the alp_last_error() diagnostic and
    exits — proves the open / last_error / close path works.

tests:
  alp_sdk.example.pwm_led_fade:
    platform_allow:
      - native_sim
      - native_sim/native/64
    integration_platforms:
      - native_sim/native/64
    tags:
      - alp-sdk
      - example
      - pwm
      harness: console
  harness_config:
      type: one_line
      regex:
        - "\\[pwm\\] done"
```

## examples/qenc-readout/testcase.yaml
```yaml
# SPDX-License-Identifier: Apache-2.0

sample:
  name: qenc-readout
  description: |
    Per-peripheral example for the quadrature-decoder side of
    <alp/counter.h>.  Polls E1M_ENC0's accumulated position.

tests:
  alp_sdk.example.qenc_readout:
    platform_allow:
      - native_sim
      - native_sim/native/64
    integration_platforms:
      - native_sim/native/64
    tags:
      - alp-sdk
      - example
      - qenc
      harness: console
  harness_config:
      type: one_line
      regex:
        - "\\[qenc\\] done"
```

## examples/rpmsg-v2n/m33_sm/testcase.yaml
```yaml
# SPDX-License-Identifier: Apache-2.0
#
# Lives under m33_sm/ (not the project root) because rpmsg-v2n is a
# multi-slice project: the parent directory carries the orchestrator's
# board.yaml + linux/ Yocto consumer + this m33_sm/ Zephyr app.  Only
# the m33_sm/ tree is a self-contained Zephyr app twister can build,
# so the testcase has to sit next to its CMakeLists.txt — otherwise
# twister picks up the parent directory and tries to configure the
# multi-slice marker as a Zephyr app (no prj.conf, no Zephyr CMake).

sample:
  name: rpmsg-v2n-m33_sm
  description: |
    Heterogeneous-compute flagship: Yocto Linux on the V2N's
    Cortex-A55 cluster + Zephyr on the same SoC's Cortex-M33-SM,
    communicating via <alp/rpc.h> over RPMsg.  This testcase
    covers ONLY the Zephyr/M33-SM half (build_only under
    native_sim) -- twister stays the Zephyr-only fast lane per
    spec §4.4.  The A55/Yocto consumer is tested separately by
    the bitbake CI lane.

tests:
  alp_sdk.examples.rpmsg_v2n.native_sim:
    platform_allow:
      - native_sim/native/64
    tags:
      - alp-sdk
      - example
      - multiprocessor
      - yocto
      - heterogeneous
      - rpmsg
    build_only: true
    # CONFIG_ALP_SDK_RPC=y -- enables <alp/rpc.h> which the producer
    # uses to publish samples; matches the comment in m33_sm/prj.conf.
    extra_args: CONFIG_ALP_SDK_RPC=y
    harness: console
    harness_config:
      type: one_line
      regex:
        - "\\[rpmsg-v2n\\] done"
```

## examples/rpmsg-v2n/testcase.yaml
```yaml
# SPDX-License-Identifier: Apache-2.0

sample:
  name: rpmsg-v2n
  description: |
    Heterogeneous-compute flagship: Yocto Linux on the V2N's
    Cortex-A55 cluster + Zephyr on the same SoC's Cortex-M33-SM,
    communicating via <alp/rpc.h> over RPMsg.  This testcase
    covers ONLY the Zephyr/M33-SM half (build_only under
    native_sim) -- twister stays the Zephyr-only fast lane per
    spec §4.4.  The A55/Yocto consumer is tested separately by
    the bitbake CI lane.

tests:
  alp_sdk.examples.rpmsg_v2n.native_sim:
    platform_allow:
      - native_sim/native/64
    tags:
      - alp-sdk
      - example
      - multiprocessor
      - yocto
      - heterogeneous
      - rpmsg
    build_only: true
    harness: console
    harness_config:
      type: one_line
      regex:
        - "\\[rpmsg-v2n\\] done"
```

## examples/rtc-clock/testcase.yaml
```yaml
# SPDX-License-Identifier: Apache-2.0

sample:
  name: rtc-clock
  description: |
    Per-peripheral example for <alp/rtc.h>.  Demonstrates set/get
    round-trip with the human-readable alp_rtc_time_t struct.

tests:
  alp_sdk.example.rtc_clock:
    platform_allow:
      - native_sim
      - native_sim/native/64
    integration_platforms:
      - native_sim/native/64
    tags:
      - alp-sdk
      - example
      - rtc
    harness: console
    harness_config:
        type: one_line
        regex:
          - "\\[rtc\\] done"
```

## examples/spi-loopback/testcase.yaml
```yaml
# SPDX-License-Identifier: Apache-2.0

sample:
  name: spi-loopback
  description: |
    Per-peripheral example for SPI.  Open / transceive / close
    on E1M_SPI1 with no CS GPIO.

tests:
  alp_sdk.example.spi_loopback:
    platform_allow:
      - native_sim
      - native_sim/native/64
    integration_platforms:
      - native_sim/native/64
    tags:
      - alp-sdk
      - example
      - spi
    harness: console
    harness_config:
        type: one_line
        regex:
          - "\\[spi\\] done"
```

## examples/spi-master/testcase.yaml
```yaml
# SPDX-License-Identifier: Apache-2.0

sample:
  name: spi-master
  description: |
    Per-peripheral example for SPI master.  Send a known byte
    pattern via write / transceive / read against E1M_SPI0.
    Contrasts with examples/spi-loopback (which exercises both
    ends on the same chip).

tests:
  alp_sdk.example.spi_master:
    platform_allow:
      - native_sim
      - native_sim/native/64
    integration_platforms:
      - native_sim/native/64
    tags:
      - alp-sdk
      - example
      - spi
    harness: console
    harness_config:
        type: one_line
        regex:
          - "\\[spi-master\\] done"
```

## examples/spi-slave/boards/native_sim_native_64.conf
```kconfig
# SPDX-License-Identifier: Apache-2.0
#
# native_sim emul controller -- bus enumerates but the API gap
# fires before any actual transfer happens.  Kept for symmetry
# with examples/spi-master.

CONFIG_EMUL=y
CONFIG_SPI_EMUL=y
```

## examples/testing/catch2-selftest/testcase.yaml
```yaml
# SPDX-License-Identifier: Apache-2.0

sample:
  name: catch2-selftest
  description: |
    Minimal Catch2 v3 unit-test binary (amalgamated single-TU
    distribution) -- 3 TEST_CASEs over a trivial clamp() helper.
    HOST unit-test example: Catch2's own "All tests passed" summary
    IS the app output; the SDK's uniform `[catch2-selftest] done`
    marker is printed only after Catch2 reports zero failures.
    Builds against the vendored Catch2 amalgamated distribution
    (vendors/catch2/) -- see README.md.

tests:
  alp_sdk.example.catch2_selftest:
    platform_allow:
      - native_sim
      - native_sim/native/64
    integration_platforms:
      - native_sim/native/64
    harness: console
    harness_config:
        type: one_line
        regex:
          - "\\[catch2-selftest\\] done"
    tags:
      - alp-sdk
      - example
      - testing
      - catch2-selftest
```

## examples/testing/doctest-selftest/testcase.yaml
```yaml
# SPDX-License-Identifier: Apache-2.0

sample:
  name: doctest-selftest
  description: |
    Minimal doctest v2.4.11 unit-test binary -- 3 TEST_CASEs over a
    trivial clamp() helper. HOST unit-test example: the framework's
    own pass summary IS the app output; the SDK's uniform
    `[doctest-selftest] done` marker is printed only after doctest
    reports zero failures.

tests:
  alp_sdk.example.doctest_selftest:
    platform_allow:
      - native_sim
      - native_sim/native/64
    integration_platforms:
      - native_sim/native/64
    harness: console
    harness_config:
        type: one_line
        regex:
          - "\\[doctest-selftest\\] done"
    tags:
      - alp-sdk
      - example
      - testing
      - doctest-selftest
```

## examples/uart-echo/testcase.yaml
```yaml
# SPDX-License-Identifier: Apache-2.0

sample:
  name: uart-echo
  description: |
    Per-peripheral example for UART.  Demonstrates open / read /
    write / close on E1M_UART0.

tests:
  alp_sdk.example.uart_echo:
    platform_allow:
      - native_sim
      - native_sim/native/64
    integration_platforms:
      - native_sim/native/64
    tags:
      - alp-sdk
      - example
      - uart
    harness: console
    harness_config:
      type: one_line
      regex:
        - "\\[uart\\] done"
```

## examples/uart-hello-world/testcase.yaml
```yaml
# SPDX-License-Identifier: Apache-2.0

sample:
  name: uart-hello-world
  description: |
    Per-peripheral example for <alp/peripheral.h> UART.  Producer-
    only "printf via UART" walkthrough: open, send greeting + a
    counter every second, close.  Companion to examples/uart-echo
    (bidirectional) and examples/uart-rx-ringbuf (IRQ-driven RX).

tests:
  alp_sdk.example.uart_hello_world:
    platform_allow:
      - native_sim
      - native_sim/native/64
    integration_platforms:
      - native_sim/native/64
    tags:
      - alp-sdk
      - example
      - uart
    harness: console
    harness_config:
        type: one_line
        regex:
          - "\\[uart-hello\\] done"
```

## examples/uart-rx-ringbuf/testcase.yaml
```yaml
# SPDX-License-Identifier: Apache-2.0

sample:
  name: uart-rx-ringbuf
  description: |
    Per-feature example for <alp/peripheral.h>'s opt-in
    interrupt-driven RX ring buffer (CONFIG_ALP_SDK_UART_RX_RINGBUF).
    Attaches an LwRB-backed ring to E1M_UART0, polls the
    drain count + pops batched bytes, then detaches.

tests:
  alp_sdk.example.uart_rx_ringbuf:
    platform_allow:
      - native_sim
      - native_sim/native/64
    integration_platforms:
      - native_sim/native/64
    tags:
      - alp-sdk
      - example
      - uart
      - lwrb
      harness: console
  harness_config:
      type: one_line
      regex:
        - "\\[ringbuf\\] done"
```

## examples/v2n/v2n-board-id-readout/testcase.yaml
```yaml
# SPDX-License-Identifier: Apache-2.0

sample:
  name: v2n-board-id-readout
  description: |
    Read the V2N SoM's EEPROM manifest + BOARD_ID ADC and assert
    the resolved SKU matches the build's `som.sku`.  Uses
    `<alp/hw_info.h>` exclusively; no chip-specific calls in app
    code.

tests:
  alp_sdk.examples.v2n.board_id_readout.native_sim:
    platform_allow:
      - native_sim/native/64
    tags:
      - alp-sdk
      - example
      - v2n
      - hw-info
      - eeprom
    build_only: true
```

## examples/v2n/v2n-brd-i2c-bringup/testcase.yaml
```yaml
# SPDX-License-Identifier: Apache-2.0
sample:
  name: v2n-brd-i2c-bringup
  description: |
    Patch-day diagnostic for the V2N SoM's BRD_I2C management bus:
    bus-health check + full address scan + read-only probe of every
    populated IC (RTC, temp sensor, clock generator, both PMICs, the
    optional LPDDR buck, the secure element, and the GD32 supervisor
    over its I2C transport), ending in a PASS/FAIL/SKIP table.

tests:
  alp_sdk.examples.v2n.brd_i2c_bringup.native_sim:
    platform_allow:
      - native_sim/native/64
    tags:
      - alp-sdk
      - example
      - v2n
      - i2c
    build_only: true
```

## examples/v2n/v2n-eeprom-manifest-dump/testcase.yaml
```yaml
# SPDX-License-Identifier: Apache-2.0

sample:
  name: v2n-eeprom-manifest-dump
  description: |
    Dump the 128-byte EEPROM manifest packed by
    `scripts/program_eeprom.py` into a human-readable form
    (serial, mfg date, sku, hw_rev).  Useful as a production-line
    sanity-check binary.

tests:
  alp_sdk.examples.v2n.eeprom_manifest_dump.native_sim:
    platform_allow:
      - native_sim/native/64
    tags:
      - alp-sdk
      - example
      - v2n
      - eeprom
      - hw-info
    build_only: true
```

## examples/v2n/v2n-emmc-block-stat/testcase.yaml
```yaml
# SPDX-License-Identifier: Apache-2.0

sample:
  name: v2n-emmc-block-stat
  description: |
    Read block-device statistics (sector count, erase block size,
    error counters) from the V2N's on-module eMMC 5.1 via
    Zephyr's disk-access API.  This is low-level V2N storage
    bring-up, not coverage for the portable SDK storage facade.

tests:
  alp_sdk.examples.v2n.emmc_block_stat.native_sim:
    platform_allow:
      - native_sim/native/64
    # native_sim has no SDHC controller -- this overlay swaps the
    # real MMC/SDMMC stack for the in-RAM disk driver so the build
    # links (real V2N keeps the eMMC stack from prj.conf).
    extra_args: EXTRA_CONF_FILE=generated/native_sim.conf
    tags:
      - alp-sdk
      - example
      - v2n
      - storage
      - emmc
    build_only: true
```

## examples/v2n/v2n-ethernet-dual/testcase.yaml
```yaml
# SPDX-License-Identifier: Apache-2.0

sample:
  name: v2n-ethernet-dual
  description: |
    V2N's dual on-module RTL8211FDI Ethernet PHYs: bring both
    links up, report MDIO link state per port, exercise the
    `<alp/iot.h>` net surface across both PHYs.

tests:
  alp_sdk.examples.v2n.ethernet_dual.native_sim:
    platform_allow:
      - native_sim/native/64
    tags:
      - alp-sdk
      - example
      - v2n
      - ethernet
      - iot
    build_only: true
```

## examples/v2n/v2n-gd32-bridge-functional/testcase.yaml
```yaml
# SPDX-License-Identifier: Apache-2.0

sample:
  name: v2n-gd32-bridge-functional
  description: |
    V2N-specific single-pass FUNCTIONAL validation of the GD32 bridge:
    value-asserting tests (not just status checks) for the math (TMU),
    TRNG, PWM-configure, ADC-configure and DSP-chain surfaces, then a
    forever PWM7 duty staircase as a live oscilloscope observable
    (PWM7 doubles as the EVK LED pad).  Exercises the gd32g553
    chip-driver surface directly (intentional for this bridge demo
    per spec §4.5).

tests:
  alp_sdk.examples.v2n.gd32_bridge_functional.native_sim:
    platform_allow:
      - native_sim/native/64
    tags:
      - alp-sdk
      - example
      - v2n
      - supervisor-mcu
      - gd32-bridge
      - hil
      - functional
    build_only: true
```

## examples/v2n/v2n-gd32-bridge-hil-soak/testcase.yaml
```yaml
# SPDX-License-Identifier: Apache-2.0

sample:
  name: v2n-gd32-bridge-hil-soak
  description: |
    V2N-specific pass/fail HiL soak: exercises the WHOLE GD32 bridge
    command set over the 25 MHz SPI fast path with per-opcode
    self-verification (readback compare, range sanity, sentinel
    asserts) and per-cycle pass/fail accounting.  Exercises the
    gd32g553 chip-driver surface directly (intentional for this
    bridge demo per spec §4.5).

tests:
  alp_sdk.examples.v2n.gd32_bridge_hil_soak.native_sim:
    platform_allow:
      - native_sim/native/64
    tags:
      - alp-sdk
      - example
      - v2n
      - supervisor-mcu
      - gd32-bridge
      - hil
    build_only: true
```
