## CMakeLists.txt
```
# SPDX-License-Identifier: Apache-2.0

cmake_minimum_required(VERSION 3.20)

# Resolve the alp-sdk root.  In-tree the SDK is the example's
# grandparent directory; out-of-tree customers point ALP_SDK_ROOT
# at their checkout.
if(DEFINED ENV{ALP_SDK_ROOT})
    set(ALP_SDK_ROOT $ENV{ALP_SDK_ROOT})
else()
    get_filename_component(ALP_SDK_ROOT ${CMAKE_CURRENT_SOURCE_DIR}/../.. ABSOLUTE)
endif()

find_package(Python3 REQUIRED COMPONENTS Interpreter)

set(_alp_generated ${CMAKE_BINARY_DIR}/generated/alp.conf)
execute_process(
    COMMAND ${Python3_EXECUTABLE} ${ALP_SDK_ROOT}/scripts/alp_project.py
            --input ${CMAKE_CURRENT_SOURCE_DIR}/board.yaml
            --emit zephyr-conf
            --output ${_alp_generated}
    RESULT_VARIABLE _alp_rv
    OUTPUT_VARIABLE _alp_stdout
    ERROR_VARIABLE  _alp_stderr
)
if(NOT _alp_rv EQUAL 0)
    message(FATAL_ERROR
        "alp_project.py failed (rv=${_alp_rv}); "
        "check ${CMAKE_CURRENT_SOURCE_DIR}/board.yaml.\n"
        "stderr: ${_alp_stderr}")
endif()

# Layer generated CONFIG_* over prj.conf via OVERLAY_CONFIG.
list(APPEND OVERLAY_CONFIG ${_alp_generated})

find_package(Zephyr REQUIRED HINTS $ENV{ZEPHYR_BASE})
project(qenc_readout LANGUAGES C)

target_sources(app PRIVATE src/main.c)
```

## prj.conf
```kconfig
# SPDX-License-Identifier: Apache-2.0

CONFIG_ALP_SDK=y
CONFIG_SENSOR=y
CONFIG_LOG=y
CONFIG_PRINTK=y
CONFIG_THREAD_LOCAL_STORAGE=y
```

## boards/native_sim_native_64.overlay
```dts
/*
 * Copyright 2026 ALP Lab AB
 * SPDX-License-Identifier: Apache-2.0
 *
 * native_sim has no quadrature-decoder device.  alp_qenc_open
 * returns NULL with last_error = ALP_ERR_NOT_READY.  On real
 * silicon, alp-qenc0 must point at a SoC QDEC node that exposes
 * the SENSOR_CHAN_ROTATION channel.
 */
```

## src/main.c
```c
/*
 * Copyright 2026 ALP Lab AB
 * SPDX-License-Identifier: Apache-2.0
 *
 * qenc-readout — open the EVK rotary encoder and poll the
 * accumulated position for ~1 second.
 *
 * Quadrature encoders are the standard interface for rotary
 * controls (volume knobs, position dials, motor feedback).  Two
 * out-of-phase signals (A and B) let the SoC's QDEC peripheral
 * detect direction as well as count -- positive ticks for one
 * direction, negative for the other.
 *
 * The E1M spec reserves four encoders (ENC0..ENC3), each routed
 * as a complementary pad pair (ENCn_X / ENCn_Y).  Apps that only
 * use E1M_ENCn for n < E1M_ENC_COUNT (= 4) stay portable
 * across every E1M-conformant SoM.
 */

#include <stdio.h>

#include <zephyr/kernel.h>

#include "alp/counter.h"

/* EVK_ENC_ROTARY is a board-macro from the generated routes header
 * (= E1M_ENC0); rebind it in board.yaml `pins:` to port to another board. */
#include "alp/boards/alp_e1m_evk_routes.h"

int main(void) {
    printf("[qenc] open EVK_ENC_ROTARY\n");

    alp_qenc_t *enc = alp_qenc_open(&(alp_qenc_config_t){
        /* EVK_ENC_ROTARY = E1M_ENC0 = index 0 -- an index into the
         * alp-qenc<N> DT alias table; the SoC binds it to a specific
         * QDEC peripheral. */
        .encoder_id = EVK_ENC_ROTARY,
        /* Mechanical resolution -- informational only at the
         * wrapper level.  24 PPR is typical for a Bourns PEC11R
         * panel-mount knob; AS5048A magnetic encoders are 14-bit
         * (16384 PPR).  Apps use this hint to scale "ticks per
         * full rotation". */
        .pulses_per_rev = 24,
    });
    if (enc == NULL) {
        printf("[qenc] open failed: alp_last_error=%d\n",
               (int)alp_last_error());
        printf("[qenc] done\n");
        return 0;
    }

    /* Reset the accumulator so we start from zero.  Without this,
     * the position read first reflects whatever rotation
     * happened before we opened the handle. */
    alp_status_t s = alp_qenc_reset_position(enc);
    printf("[qenc] reset_position -> %d\n", (int)s);

    /* Poll the position 10 times at 100 ms intervals = 1 s of
     * sampling.  Real apps would use either:
     *   - A k_timer with a higher rate (10 ms) for low-latency UI.
     *   - The Zephyr input subsystem for event-driven dispatch.
     * Polling is simplest for a demo. */
    for (int i = 0; i < 10; i++) {
        int32_t pos = 0;
        s = alp_qenc_get_position(enc, &pos);
        printf("[qenc] t=%d ms  status=%d  pos=%d\n",
               (i + 1) * 100, (int)s, (int)pos);
        k_msleep(100);
    }

    /* Close releases the handle.  The hardware QDEC keeps running
     * -- if you reopen with the same encoder_id, you'll read the
     * accumulated position as it was when you closed (modulo any
     * intervening rotation). */
    alp_qenc_close(enc);
    printf("[qenc] done\n");
    return 0;
}
```
