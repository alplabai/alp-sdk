## CMakeLists.txt
```
# SPDX-License-Identifier: Apache-2.0
cmake_minimum_required(VERSION 3.20.0)

# Resolve the alp-sdk root.  In-tree the SDK is the example's
# grandparent directory; out-of-tree customers point ALP_SDK_ROOT
# at their checkout.
if(DEFINED ENV{ALP_SDK_ROOT})
    set(ALP_SDK_ROOT $ENV{ALP_SDK_ROOT})
else()
    get_filename_component(ALP_SDK_ROOT ${CMAKE_CURRENT_SOURCE_DIR}/../../.. ABSOLUTE)
endif()

# PYTHON_EXECUTABLE is only set after find_package(Zephyr);
# we need a Python interpreter at configure time *before*
# that, so resolve one ourselves here.
find_package(Python3 REQUIRED COMPONENTS Interpreter)

execute_process(
    COMMAND ${Python3_EXECUTABLE}
            ${ALP_SDK_ROOT}/scripts/alp_project.py
            --input  ${CMAKE_CURRENT_SOURCE_DIR}/board.yaml
            --output ${CMAKE_CURRENT_BINARY_DIR}/alp.conf
            --emit zephyr-conf --core m55_hp
    RESULT_VARIABLE rc
    OUTPUT_VARIABLE _alp_stdout
    ERROR_VARIABLE  _alp_stderr
)
if(NOT rc EQUAL 0)
    message(FATAL_ERROR
        "alp_project.py failed (rc=${rc}); "
        "check ${CMAKE_CURRENT_SOURCE_DIR}/board.yaml.\n"
        "stderr: ${_alp_stderr}")
endif()
list(APPEND EXTRA_CONF_FILE ${CMAKE_CURRENT_BINARY_DIR}/alp.conf)

find_package(Zephyr REQUIRED HINTS $ENV{ZEPHYR_BASE})
project(rail_predictive_maintenance LANGUAGES C)

# _GNU_SOURCE makes M_PI visible under the host glibc (native_sim).
# The M55 cross-compiler sees M_PI via the #ifndef guard in the sources.
target_compile_definitions(app PRIVATE _GNU_SOURCE)

target_sources(app PRIVATE
    src/main.c
    src/rail_features.c
    src/rail_position.c
)
```

## prj.conf
```kconfig
# SPDX-License-Identifier: Apache-2.0
CONFIG_MAIN_STACK_SIZE=16384

CONFIG_LOG=y
CONFIG_LOG_PRINTK=y
CONFIG_CBPRINTF_FP_SUPPORT=y

CONFIG_ALP_SDK_INFERENCE_BACKEND_TFLM=y

# <alp/dsp.h> chain (FFT/magnitude) for the spectral features.  Its
# backend runs CMSIS-DSP arm_rfft_fast_f32 on the M55 and a portable-C
# radix-2 fallback under native_sim.
CONFIG_ALP_SDK_DSP=y
```

## boards/native_sim_native_64.conf
```kconfig
# SPDX-License-Identifier: Apache-2.0
#
# native_sim has no real I2C controller; pull in the emul drivers so the
# ICM-42670 chip driver can open the sensor bus (alp-i2c0) at boot.  No
# GNSS UART is provided on native_sim -- main.c tolerates a NULL GNSS
# handle and replays a built-in canned NMEA track instead.
# Auto-loaded by Zephyr when building for native_sim/native/64.

CONFIG_EMUL=y
CONFIG_I2C_EMUL=y
```

## boards/native_sim_native_64.overlay
```dts
/*
 * Copyright 2026 Alp Lab AB
 * SPDX-License-Identifier: Apache-2.0
 *
 * Host-build overlay -- exposes one emulated I2C controller via the
 * alp-i2c0 alias so alp_i2c_open(BOARD_I2C_SENSORS) resolves and the
 * ICM-42670 bring-up runs.  No emul target is attached, so the WHO_AM_I
 * read fails and main.c falls back to its synthetic vibration generator.
 * The GNSS UART is intentionally absent here; main.c replays a canned
 * NMEA track when the GNSS port is unavailable.  On real silicon this
 * file is NOT applied.
 */
#include <zephyr/dt-bindings/i2c/i2c.h>

/ {
    aliases {
        alp-i2c0 = &i2c0_emul;
    };

    soc {
        i2c0_emul: i2c@100 {
            compatible = "zephyr,i2c-emul-controller";
            status = "okay";
            reg = <0 0x100 4>;
            #address-cells = <1>;
            #size-cells = <0>;
            clock-frequency = <I2C_BITRATE_FAST>;
        };
    };
};
```

## src/main.c
```c
/*
 * Copyright 2026 Alp Lab AB
 * SPDX-License-Identifier: Apache-2.0
 *
 * rail-predictive-maintenance
 * ===========================
 *
 * Train-mounted rail-condition survey.  Pipeline:
 *
 *   ICM-42670 accel (I2C) --256-sample window @ 800 Hz-->
 *     rail_features (DSP: RMS/crest/kurtosis/FFT bands/dom-freq/wavelength)
 *       --feature vector--> <alp/inference.h> AI classifier
 *                           (deterministic fallback when no model)
 *   NEO-M9N GNSS (UART NMEA) --> rail_position (haversine chainage + 25 m
 *                                segment binning)
 *     --> one CSV record per segment (worst class in the segment wins).
 *
 * The model is a stub: drop a Vela-compiled (AEN / Ethos-U) or DX-M1
 * (V2N) .tflite into models/ and point alp_inference_open at it.  With no
 * model (native_sim), the deterministic fallback classifier runs so the
 * survey still produces sensible geotagged output.
 *
 * Asset boundary: this surveys the RAIL (track), not the wheel.  Wheel
 * flats (periodic at wheel-rotation frequency) are out of scope.
 */
#include <zephyr/kernel.h>
#include <zephyr/logging/log.h>
#include <math.h>
#include <string.h>

#ifndef M_PI
#define M_PI 3.14159265358979323846
#endif

#include "alp/board.h"
#include "alp/inference.h"
#include "alp/peripheral.h"
#include "alp/chips/icm42670.h"
#include "alp/chips/ublox_neo_m9n.h"

#include "rail_features.h"
#include "rail_position.h"

LOG_MODULE_REGISTER(rail_pdm, LOG_LEVEL_INF);

/* ICM-42670 ±2 g sensitivity: 16384 LSB/g (datasheet DS-000451). */
#define ICM_LSB_PER_G 16384.0f
#define IMU_I2C_ADDR  ICM42670_I2C_ADDR_HIGH /* E1M EVK straps AP_AD0 high. */

/* Number of windows to process in the bounded demo run. */
#define RAIL_DEMO_WINDOWS 64

/* 1-byte stub model -- real deployment drops a Vela / DX-M1 .tflite here.
 * The stub causes alp_inference_open to return a handle; the invoke /
 * get_output path produces an unusable tensor, so classify() falls back to
 * the deterministic rail_classify_fallback().  native_sim proves the full
 * pipeline end-to-end without a trained model. */
static const uint8_t s_model[] = { 0x00 };

/* Canned native_sim track. Checksums are placeholders (*00) -- rail_pos_parse_rmc
 * is checksum-agnostic by design; real NMEA from the GNSS carries valid checksums. */
static const char *const s_canned_track[] = {
	"$GNRMC,083559.00,A,5919.99990,N,01803.74400,E,12.0,0.0,250626,,,A*00",
	"$GNRMC,083600.00,A,5920.01000,N,01803.74400,E,12.0,0.0,250626,,,A*00",
	"$GNRMC,083601.00,A,5920.02000,N,01803.74400,E,12.0,0.0,250626,,,A*00",
	"$GNRMC,083602.00,A,5920.03000,N,01803.74400,E,12.0,0.0,250626,,,A*00",
};

/* Synthetic vibration when no real IMU answers: alternate clean / tone /
 * impulse so the demo emits a mix of classes.
 * Period-64 joint impulses give crest~7.94 and high kurtosis, which
 * exceeds the fallback classifier's crest>6 threshold for JOINT_WELD. */
static float synth_sample(int window, int i)
{
	switch (window % 3) {
	case 0: /* clean */
		return 0.001f;
	case 1: /* corrugation tone ~120 Hz */
		return sinf(2.0f * (float)M_PI * 120.0f * (float)i / RAIL_ODR_HZ);
	default: /* joint impulses -- period 64 -> crest~7.94, kurtosis high */
		return (i % 64 == 0) ? 1.0f : 0.0f;
	}
}

/*
 * All cross-window state for one survey run lives here so main() can pass a
 * single pointer around instead of threading five separate locals through
 * classify()/emit_record().  imu_ok/gps_uart track whether the real sensors
 * answered at boot -- once false, the run stays on synthetic data / the
 * canned NMEA track for its whole lifetime (no per-window re-probe).
 */
struct rail_ctx {
	icm42670_t       imu;
	bool             imu_ok;
	ublox_neo_m9n_t  gps;
	alp_uart_t      *gps_uart;
	alp_inference_t *inf;

	struct rail_pos_state pos;
	/* worst verdict seen in the current segment. */
	rail_class_t         worst_cls;
	float                worst_sev;
	struct rail_features worst_feat;
};

/* Leading '#' marks this as a comment line to CSV consumers (most CSV
 * readers and MQTT/GIS ingest scripts skip '#'-prefixed lines by
 * convention), so the field-name header can live in the same stream as
 * the data records below without a separate schema file. */
static void emit_header(void)
{
	printk("# RAIL,chainage_m,lat,lon,speed_mps,class,severity,dom_freq_hz,"
	       "rail_wavelength_m,fix\n");
}

/* Field order here must track emit_header() above -- there is no named-field
 * encoding, so a reordered printk here silently desyncs the CSV schema. */
static void emit_record(const struct rail_ctx *c, double lat, double lon, float speed, bool fix)
{
	printk("RAIL,%.1f,%.6f,%.6f,%.1f,%s,%.2f,%.1f,%.4f,%d\n",
	       c->pos.chainage_m,
	       lat,
	       lon,
	       (double)speed,
	       rail_class_name(c->worst_cls),
	       (double)c->worst_sev,
	       (double)c->worst_feat.dom_freq_hz,
	       (double)c->worst_feat.rail_wavelength_m,
	       fix ? 1 : 0);
}

/*
 * Classify a feature vector via the AI model, else the deterministic fallback.
 *
 * c->inf is non-NULL whenever alp_inference_open() accepted s_model, which
 * happens even for the 1-byte stub (open only checks the container, not that
 * the payload is a real graph).  So the dtype/size_bytes checks below are the
 * real gate: they catch a stub or mismatched model at RUN time and drop to
 * rail_classify_fallback() instead of reading/writing past a tensor that
 * does not exist.  On native_sim with the stub model every one of these
 * checks fails and every window takes the fallback path -- that is the
 * expected, exercised behaviour, not an error.
 */
static struct rail_verdict classify(struct rail_ctx *c, const struct rail_features *f)
{
	if (c->inf != NULL) {
		float vec[RAIL_FEATURE_DIM];
		(void)rail_feat_pack(f, vec, RAIL_FEATURE_DIM);

		alp_inference_tensor_t in = { 0 };
		if (alp_inference_get_input(c->inf, 0, &in) == ALP_OK && in.data != NULL &&
		    in.dtype == ALP_INFERENCE_DTYPE_F32 && in.size_bytes >= sizeof(vec)) {
			memcpy(in.data, vec, sizeof(vec));
			if (alp_inference_invoke(c->inf) == ALP_OK) {
				alp_inference_tensor_t out = { 0 };
				if (alp_inference_get_output(c->inf, 0, &out) == ALP_OK &&
				    out.dtype == ALP_INFERENCE_DTYPE_F32 && out.data != NULL &&
				    out.size_bytes >= RAIL_CLASS_COUNT * sizeof(float)) {
					/* argmax over the per-class scores selects the predicted
					 * class; severity is derived from 1 - P(HEALTHY) rather
					 * than the winning score, so a confident non-healthy
					 * call and a low-margin one still rank by how far the
					 * model is from calling it healthy. */
					const float *scores = (const float *)out.data;
					int          best   = 0;
					float        bestv  = scores[0];
					for (int k = 1; k < RAIL_CLASS_COUNT; k++) {
						if (scores[k] > bestv) {
							bestv = scores[k];
							best  = k;
						}
					}
					struct rail_verdict v = { (rail_class_t)best, 1.0f - scores[RAIL_HEALTHY] };
					/* Clamp: scores are not guaranteed to be a normalised
					 * softmax (a raw-logit model would violate [0,1]), and
					 * downstream severity display/thresholds assume [0,1]. */
					if (v.severity < 0.0f) {
						v.severity = 0.0f;
					}
					if (v.severity > 1.0f) {
						v.severity = 1.0f;
					}
					return v;
				}
			}
		}
	}
	return rail_classify_fallback(f);
}

static void seg_reset(struct rail_ctx *c)
{
	c->worst_cls = RAIL_HEALTHY;
	c->worst_sev = -1.0f;
}

int main(void)
{
	static struct rail_ctx c;
	struct rail_feat_state st;

	memset(&c, 0, sizeof(c));
	rail_feat_state_reset(&st);
	/* 25 m along-track segment length: matches the README's contract of one
	 * CSV record per 25 m of track, independent of survey speed. */
	rail_pos_init(&c.pos, 25.0f);
	seg_reset(&c);

	/* --- I2C accelerometer (tolerate a missing chip on native_sim). --- */
	/* BOARD_I2C_SENSORS is the board-level alias for the sensor I2C bus
	 * (see board.yaml pins:) -- using it instead of a raw bus index keeps
	 * this source portable across the E1M-EVK and E1M-X-EVK carriers, which
	 * wire the ICM-42670 to different underlying I2C controllers. */
	alp_i2c_t *bus = alp_i2c_open(&(alp_i2c_config_t){
	    .bus_id     = BOARD_I2C_SENSORS,
	    .bitrate_hz = 400000,
	});
	if (bus != NULL && icm42670_init(&c.imu, bus, IMU_I2C_ADDR) == ALP_OK &&
	    icm42670_set_accel(&c.imu, ICM42670_ODR_800_HZ, ICM42670_ACCEL_FS_2G) == ALP_OK) {
		c.imu_ok = true;
	} else {
		/* Open or config failure is expected on native_sim (no real I2C
		 * device answers) -- the demo keeps running on synth_sample()
		 * rather than treating this as fatal. */
		LOG_WRN("ICM-42670 unavailable; using synthetic vibration");
	}

	/* --- GNSS UART (tolerate absence on native_sim -> canned track). --- */
	c.gps_uart = alp_uart_open(&(alp_uart_config_t){
	    .port_id  = BOARD_UART_ARDUINO,
	    .baudrate = 9600,
	});
	if (c.gps_uart != NULL) {
		(void)ublox_neo_m9n_init(&c.gps, c.gps_uart);
	} else {
		/* No UART backend -> every window below falls through to
		 * s_canned_track so the pipeline still exercises chainage/segment
		 * binning end-to-end without live GNSS. */
		LOG_WRN("GNSS UART unavailable; replaying canned NMEA track");
	}

	/* --- AI model: stub backend; fallback classifier runs on native_sim. --- */
	/* s_model is a 1-byte placeholder, not a trained graph: it exists only
	 * so alp_inference_open's non-NULL model_data contract is satisfied.
	 * classify() detects the resulting unusable tensor and calls
	 * rail_classify_fallback() every time -- see classify() above. */
	c.inf = alp_inference_open(&(alp_inference_config_t){
	    .backend    = ALP_INFERENCE_BACKEND_AUTO,
	    .format     = ALP_INFERENCE_MODEL_TFLITE,
	    .model_data = s_model,
	    .model_size = sizeof(s_model),
	});

	emit_header();

	double  lat = 0.0, lon = 0.0;
	float   speed = 0.0f;
	bool    fix   = false;
	uint8_t nmea[128];
	size_t  track_i = 0;

	/* Each outer iteration is one 256-sample IMU window (320 ms of vibration
	 * at 800 Hz), paired with one GNSS sentence -- the demo treats "one
	 * window" and "one GNSS read" as roughly synchronous, which is close
	 * enough at survey speed since GNSS updates far slower than the IMU. */
	for (int w = 0; w < RAIL_DEMO_WINDOWS; w++) {
		/* Fill one window. */
		rail_feat_state_reset(&st);
		for (int i = 0; i < RAIL_WINDOW_N; i++) {
			float sample;
			if (c.imu_ok) {
				icm42670_axes_t ax;
				if (icm42670_read_accel(&c.imu, &ax) == ALP_OK) {
					/* Vector magnitude of all three axes, not a single axis:
					 * the ICM-42670's mount orientation on the bogie is not
					 * fixed by this example, so |a| stays valid regardless
					 * of which axis actually faces the rail. */
					float g = sqrtf((float)ax.x * ax.x + (float)ax.y * ax.y + (float)ax.z * ax.z) /
					          ICM_LSB_PER_G;
					sample  = g;
				} else {
					sample = synth_sample(w, i);
				}
			} else {
				sample = synth_sample(w, i);
			}
			rail_feat_window_push(&st, sample);
		}

		/* Position: one GNSS sentence per window. */
		size_t      len  = 0;
		const char *line = NULL;
		if (c.gps_uart != NULL &&
		    ublox_neo_m9n_read_nmea_line(&c.gps, nmea, sizeof(nmea), &len, 5) == ALP_OK) {
			line = (const char *)nmea;
		} else {
			/* No live sentence this window (uart absent, or the read timed
			 * out/returned nothing) -- replay the canned track so the demo
			 * still advances chainage deterministically on native_sim. */
			line = s_canned_track[track_i % ARRAY_SIZE(s_canned_track)];
			track_i++;
		}
		double plat = lat, plon = lon;
		float  pspd = speed;
		bool   pfix = false;
		if (rail_pos_parse_rmc(line, &plat, &plon, &pspd, &pfix) && pfix) {
			/* Only commit a fresh fix: an unfixed sentence (pfix == false)
			 * leaves lat/lon/speed at their last known values rather than
			 * resetting to 0, since this demo does not dead-reckon between
			 * fixes. */
			lat   = plat;
			lon   = plon;
			speed = pspd;
			fix   = true;
		}

		/* Features + classification. */
		struct rail_features f;
		rail_feat_extract(&st, RAIL_ODR_HZ, speed, &f);
		struct rail_verdict v = classify(&c, &f);

		/* Track the worst verdict in the current segment: a segment is
		 * reported once (on segment change, below), so multiple windows
		 * within the same 25 m stretch must be reduced to the single worst
		 * finding rather than emitting one record per window. */
		if (v.severity > c.worst_sev) {
			c.worst_sev  = v.severity;
			c.worst_cls  = v.cls;
			c.worst_feat = f;
		}

		/* Advance position; emit a record on segment change. rail_pos_update
		 * returns true exactly when the chainage crosses into a new 25 m
		 * segment, which is the trigger to flush the worst verdict
		 * accumulated for the segment just completed. */
		if (rail_pos_update(&c.pos, lat, lon, fix)) {
			emit_record(&c, lat, lon, speed, fix);
			seg_reset(&c);
		}
	}

	/* Teardown mirrors the open order above; guard each close on the
	 * corresponding _ok/handle so a partially-initialised run (e.g. IMU
	 * absent) does not deinit a chip that was never inited. */
	alp_inference_close(c.inf);
	if (c.imu_ok) {
		icm42670_deinit(&c.imu);
	}
	alp_i2c_close(bus);
	printk("[rail] done\n");
	return 0;
}
```

## src/rail_features.c
```c
/*
 * Copyright 2026 Alp Lab AB
 * SPDX-License-Identifier: Apache-2.0
 *
 * rail_features implementation -- see rail_features.h.
 */
#include "rail_features.h"

#include <math.h>
#include <string.h>

/*
 * SPECTRAL + STATISTICAL MATH -- via <alp/dsp.h>, not hand-rolled.
 * ---------------------------------------------------------------
 * This example does NOT re-derive an FFT or the moment statistics by
 * hand, and it does NOT call CMSIS-DSP arm_* directly.  Both go through
 * the portable <alp/dsp.h> surface, so the SAME source builds for
 * native_sim and the Cortex-M55 alike and the SDK -- not the app --
 * owns the CMSIS-vs-portable choice:
 *
 *   1. FFT -> alp_dsp_chain (ALP_DSP_STAGE_FFT).  The backend runs
 *      CMSIS-DSP arm_rfft_fast_f32 (Helium-vectorised) on the M55, a
 *      hardware DSP block where the SoM has one, and a portable-C radix-2
 *      fallback under native_sim -- selected by the backend registry.
 *
 *   2. Scalar window statistics (mean, RMS, abs-peak, variance) ->
 *      alp_dsp_stats_f32, which the SDK backs with CMSIS-DSP
 *      arm_mean/rms/absmax_f32 on Cortex-M and a portable-C pass
 *      elsewhere.  Keeping both on <alp/dsp> lets the identical source
 *      run on the V2N (A55 + DRP-AI) path, which has no CMSIS-M.
 *
 * Only kurtosis stays a hand-written loop -- it is a 4th standardised
 * moment with no CMSIS (or alp_dsp) kernel.
 */
#include <alp/dsp.h>

/*
 * rail_feat_state_reset
 *
 * The samples[] array is intentionally NOT zeroed: every push overwrites
 * entries starting at index 0, and rail_feat_extract reads only the first
 * st->count elements.  Clearing just the counter avoids writing 1 kB of
 * data (RAIL_WINDOW_N * sizeof(float) = 256 * 4 bytes) on every reset.
 */
void rail_feat_state_reset(struct rail_feat_state *st)
{
	st->count = 0;
}

/*
 * rail_feat_window_push
 *
 * Append one vibration-magnitude sample to the sliding window.  Samples
 * are expected at RAIL_ODR_HZ (800 Hz) from the IMU output stage.  Once
 * the window is full (count == RAIL_WINDOW_N) pushes are silently dropped;
 * the caller must call rail_feat_extract then rail_feat_state_reset before
 * resuming collection.
 */
void rail_feat_window_push(struct rail_feat_state *st, float sample)
{
	if (st->count < RAIL_WINDOW_N) {
		st->samples[st->count++] = sample;
	}
}

/*
 * rail_feat_window_full
 *
 * Predicate: returns true once RAIL_WINDOW_N samples have accumulated.
 * The caller polls this after each push to decide when to trigger feature
 * extraction without tracking the counter externally.
 */
bool rail_feat_window_full(const struct rail_feat_state *st)
{
	return st->count >= RAIL_WINDOW_N;
}

/*
 * rail_feat_extract -- reduce one vibration window to a feature vector.
 *
 * PIPELINE OVERVIEW
 * -----------------
 * 1. Subtract the window mean to remove DC (gravity bias, sensor offset).
 * 2. Compute time-domain statistics: RMS, peak absolute value, kurtosis.
 * 3. Zero-pad the mean-centred signal to RAIL_WINDOW_N and run the FFT.
 * 4. Find the dominant spectral bin (peak magnitude-squared, DC skipped).
 * 5. Convert dominant bin to Hz; from Hz and speed, derive wavelength.
 * 6. Accumulate log-spaced spectral band energies; normalise to sum = 1.
 *
 * The feature vector produced here feeds both the deterministic fallback
 * classifier (rail_classify_fallback) and the AI runtime when a model
 * has been loaded over OTA.
 */
void rail_feat_extract(const struct rail_feat_state *st,
                       float                         odr_hz,
                       float                         speed_mps,
                       struct rail_features         *out)
{
	const int n = (st->count < RAIL_WINDOW_N) ? st->count : RAIL_WINDOW_N;

	memset(out, 0, sizeof(*out));
	if (n <= 0) {
		return;
	}

	static float xc[RAIL_WINDOW_N];

	/*
	 * One alp_dsp_stats_f32 pass over the raw window yields the mean; a
	 * second over the mean-centred buffer yields the AC (vibration) RMS
	 * and abs-peak with the DC bias (gravity, sensor offset) removed.
	 * The SDK backs these with CMSIS-DSP arm_mean/rms/absmax_f32 on the
	 * M55 and a portable-C pass under native_sim -- no arm_* here.
	 */
	alp_dsp_stats_t raw;
	alp_dsp_stats_f32(st->samples, (size_t)n, &raw);
	const float mean = raw.mean;

	/*
	 * xc = the mean-centred window, reused by both the AC stats and the
	 * FFT.  The tail [n, N) is zero-padded so the fixed-size FFT can run
	 * on a short window; zero-padding adds no spectral energy, it only
	 * interpolates the spectrum to finer bin spacing.  xc is static
	 * (single sensor thread, no re-entrancy) to keep it off the stack.
	 */
	for (int i = 0; i < n; i++) {
		xc[i] = st->samples[i] - mean;
	}
	for (int i = n; i < RAIL_WINDOW_N; i++) {
		xc[i] = 0.0f;
	}

	alp_dsp_stats_t ac;
	alp_dsp_stats_f32(xc, (size_t)n, &ac);
	const float peak = ac.abs_max;  /* peak |xc|                       */
	const float var  = ac.variance; /* == mean(xc^2) since mean(xc)~=0 */
	out->rms         = ac.rms;      /* AC RMS = sqrt(mean(xc^2))       */

	/*
	 * TIME-DOMAIN FEATURES derived from the centred window:
	 *
	 *   Crest factor (peak/RMS) -- for band-limited Gaussian noise
	 *     CF ~= 3-4; a single-cycle impulse (wheel flat, joint impact)
	 *     drives CF to 10-20.  Guard rms < 1e-9 clamps CF to 0.
	 *   Kurtosis (K = E[x^4]/E[x^2]^2) -- the 4th standardised moment;
	 *     Gaussian noise gives K ~= 3, impulsive events push K past 5.
	 *     CMSIS-DSP ships no 4th-moment kernel, so the sum-of-4th-powers
	 *     stays a portable loop over xc.  Guard var < 1e-12 clamps K to 0.
	 */
	out->crest_factor = (out->rms > 1e-9f) ? (peak / out->rms) : 0.0f;
	float sum4        = 0.0f;
	for (int i = 0; i < n; i++) {
		float x2 = xc[i] * xc[i];
		sum4 += x2 * x2;
	}
	out->kurtosis = (var > 1e-12f) ? ((sum4 / (float)n) / (var * var)) : 0.0f;

	/*
	 * SPECTRUM via the portable <alp/dsp.h> chain (NOT a hand-rolled FFT).
	 * ------------------------------------------------------------------
	 * A single ALP_DSP_STAGE_FFT (rectangular, no window) transforms the
	 * centred window to magnitude bins.  The backend runs CMSIS-DSP
	 * arm_rfft_fast_f32 on the M55 and a portable-C radix-2 FFT under
	 * native_sim -- the example source is identical either way.
	 *
	 * The chain consumes int16 samples (the accelerometer's native ADC
	 * format).  We scale the float window to fill the int16 range before
	 * feeding it: the absolute scale is irrelevant here because every
	 * downstream spectral feature -- the dominant bin (an argmax) and the
	 * normalised band energies -- is scale-invariant.
	 */
	static int16_t samp_q15[RAIL_WINDOW_N];
	float          scale = (peak > 1e-9f) ? (30000.0f / peak) : 0.0f;
	for (int i = 0; i < RAIL_WINDOW_N; i++) {
		samp_q15[i] = (int16_t)lrintf(xc[i] * scale);
	}

	static float    mag[RAIL_WINDOW_N];
	alp_dsp_stage_t stages[] = {
		{ .kind  = ALP_DSP_STAGE_FFT,
		  .u.fft = { .n_points = RAIL_WINDOW_N, .output_format = ALP_DSP_FFT_OUTPUT_MAGNITUDE } },
	};
	alp_dsp_chain_t *chain = alp_dsp_chain_open(stages, 1u);
	size_t           got   = 0;
	memset(mag, 0, sizeof(mag));
	if (chain != NULL) {
		(void)alp_dsp_chain_apply_bins(chain, samp_q15, RAIL_WINDOW_N, mag, RAIL_WINDOW_N, &got);
		alp_dsp_chain_close(chain);
	}

	/*
	 * DOMINANT FREQUENCY BIN
	 * ----------------------
	 *
	 * For a real N-point signal sampled at fs Hz, the FFT produces a
	 * two-sided spectrum; the physically meaningful positive-frequency
	 * content occupies bins 0 .. N/2.  Bin k represents:
	 *
	 *   f_k = k * fs / N    [Hz]
	 *
	 * The search starts at k = 1 to skip bin 0 (DC).  Even after
	 * mean removal a floating-point residual can linger in bin 0,
	 * and the relevant vibration content always starts at k >= 1.
	 */
	/* Magnitude-squared over the first half; find the dominant bin. */
	const int half = RAIL_WINDOW_N / 2;
	float     mag2[RAIL_WINDOW_N / 2];
	int       dom_bin = 1;
	float     dom_val = -1.0f;
	for (int k = 0; k < half; k++) {
		mag2[k] = mag[k] * mag[k];         /* magnitude-squared (power) per bin */
		if (k >= 1 && mag2[k] > dom_val) { /* skip DC bin 0 */
			dom_val = mag2[k];
			dom_bin = k;
		}
	}
	/*
	 * FREQUENCY-TO-WAVELENGTH CONVERSION
	 * ------------------------------------
	 *
	 * A train travelling at speed v [m/s] over a corrugation of
	 * spatial period lambda [m] excites sinusoidal vibration at:
	 *
	 *   f = v / lambda   [Hz]
	 *
	 * Inverting: lambda = v / f.
	 *
	 * Short-pitch rail corrugation has a FIXED spatial wavelength
	 * (typically 20-300 mm) that is a property of the rail surface,
	 * independent of train speed.  Because the observed frequency f
	 * scales with speed, a raw frequency reading cannot be compared
	 * across trains running at different speeds.  The wavelength
	 * lambda = v/f is the speed-invariant descriptor that identifies
	 * a corrugation's physical defect length regardless of how fast
	 * the measuring vehicle travels.
	 *
	 * Guards: both dom_freq_hz and speed_mps must exceed 1e-6; when
	 * either is near zero (train at standstill, or no spectral peak),
	 * wavelength is set to 0.0 to signal "not available".
	 */
	out->dom_freq_hz = (float)dom_bin * odr_hz / (float)RAIL_WINDOW_N;
	out->rail_wavelength_m =
	    (out->dom_freq_hz > 1e-6f && speed_mps > 1e-6f) ? (speed_mps / out->dom_freq_hz) : 0.0f;

	/*
	 * LOG-SPACED SPECTRAL BAND ENERGIES
	 * -----------------------------------
	 *
	 * The positive-frequency bins 1 .. N/2-1 are accumulated into
	 * RAIL_N_BANDS = 8 bands with logarithmically-spaced boundaries.
	 *
	 * Why log-spacing?
	 *   (a) Rail defect excitation spans several decades: ~10 Hz for
	 *       long-pitch corrugation to ~400 Hz for short-pitch.
	 *   (b) Linear equal-bandwidth bands devote the majority of bins
	 *       to high frequencies where defect energy is low, wasting
	 *       diagnostic resolution where defects actually appear.
	 *   (c) Log-spacing mirrors the 1/f^alpha character of vibration
	 *       spectra, giving equal diagnostic weight to each decade.
	 *
	 * Assignment rule: bin k maps to band:
	 *   b = floor( log(k) / log(N/2) * B )
	 * where B = RAIL_N_BANDS.  log(1)=0 -> band 0; approaching
	 * log(N/2-1) ~= log(N/2) -> band B-1.
	 *
	 * Normalisation: each band energy is divided by the total spectral
	 * energy so that the feature vector is amplitude-scale-invariant --
	 * a heavier train produces the same band pattern for the same
	 * defect type, regardless of absolute vibration level.
	 */
	/* Log-spaced band energies over bins 1..half-1, normalised to sum 1. */
	float total = 0.0f;
	for (int k = 1; k < half; k++) {
		total += mag2[k];
	}
	if (total < 1e-20f) {
		return; /* bands stay zero */
	}
	for (int k = 1; k < half; k++) {
		/* Map bin -> band by log position across [1, half). */
		float pos = logf((float)k) / logf((float)half);
		int   b   = (int)(pos * (float)RAIL_N_BANDS);
		if (b < 0) {
			b = 0;
		}
		if (b >= RAIL_N_BANDS) {
			b = RAIL_N_BANDS - 1;
		}
		out->band_energy[b] += mag2[k];
	}
	for (int b = 0; b < RAIL_N_BANDS; b++) {
		out->band_energy[b] /= total;
	}
}

/*
 * rail_feat_pack -- serialise features to a flat float vector.
 *
 * Output layout (RAIL_FEATURE_DIM = 3 + RAIL_N_BANDS + 2 = 13 floats):
 *   [0]      rms
 *   [1]      crest_factor
 *   [2]      kurtosis
 *   [3..10]  band_energy[0..7]   (log-spaced, normalised, sum to 1)
 *   [11]     dom_freq_hz
 *   [12]     rail_wavelength_m
 *
 * This exact layout is the input contract for the companion .alpmodel
 * classifier; reordering the fields requires retraining the model.
 */
size_t rail_feat_pack(const struct rail_features *f, float *vec, size_t cap)
{
	if (cap < (size_t)RAIL_FEATURE_DIM) {
		return 0;
	}
	size_t i = 0;
	vec[i++] = f->rms;
	vec[i++] = f->crest_factor;
	vec[i++] = f->kurtosis;
	for (int b = 0; b < RAIL_N_BANDS; b++) {
		vec[i++] = f->band_energy[b];
	}
	vec[i++] = f->dom_freq_hz;
	vec[i++] = f->rail_wavelength_m;
	return i; /* == RAIL_FEATURE_DIM */
}

/*
 * rail_classify_fallback -- deterministic rule-based classifier.
 *
 * PURPOSE
 * -------
 * When no trained .alpmodel is available (native_sim builds, or first
 * boot before OTA model delivery), this function produces physically
 * meaningful verdicts from the feature vector without any floating-point
 * weight tables.  It covers all four taxonomy classes and is calibrated
 * to match the AI path on unambiguous cases.
 *
 * BRANCH ORDER
 * ------------
 * The conditions can overlap at boundary values, so the more specific
 * and physically severe defect class is tested first.  A signal that
 * qualifies for multiple classes (e.g., a rough weld with a narrowband
 * spectral peak) is assigned the most severe matching class.
 *
 * 1. JOINT_WELD  (crest_factor > 6 AND kurtosis > 5)
 *    A rail joint or weld produces a discrete transient: a brief,
 *    high-amplitude spike that dominates the window.  This spike
 *    simultaneously drives crest factor (spike/RMS ratio) and kurtosis
 *    (4th-moment sensitivity to rare large deviations) above their
 *    respective thresholds.  The dual criterion suppresses false
 *    positives: corrugation alone rarely elevates both features at
 *    the same time.
 *    Severity: linear from 0 at CF = 6.0 to 1.0 at CF = 12.0.
 *    Checked FIRST because a severe weld may also look narrowband
 *    (high band_max), but the dual criterion catches it here.
 *
 * 2. CORRUGATION  (band_max > 0.5)
 *    Rail corrugation is a quasi-periodic surface wave; the wheel
 *    rolls over peaks and troughs at a near-fixed spatial wavelength,
 *    producing near-sinusoidal excitation concentrated in one frequency
 *    band.  When the strongest log-band holds more than 50 % of total
 *    spectral energy the spectrum is "narrowband" -- the definitive
 *    corrugation signature.
 *    Severity: band_max itself (already in [0.5, 1], clipped to 1).
 *    Checked after JOINT_WELD, which already handles the overlap with
 *    the dual criterion above.
 *
 * 3. ROUGH_RCF  (rms > 0.30)
 *    Rolling Contact Fatigue (RCF) develops as micro-cracks and
 *    spalling across a wide track section.  The resulting vibration
 *    is broadband (no single dominant frequency), but the overall
 *    energy level is elevated.  RMS > 0.30 m/s^2 (tuned for an ODR
 *    of 800 Hz and a +/-2 g accelerometer range) flags significant
 *    broadband roughness.
 *    Severity: linear from 0 at rms = 0.30 to 1.0 at rms = 0.60.
 *    Checked after CORRUGATION: corrugated track also has elevated RMS,
 *    but the narrowband test already classified it at step 2.
 *
 * 4. HEALTHY  (fallthrough)
 *    Low RMS, no narrowband spectral peak, no impulsive transient.
 *    Severity is 0.0 (no defect energy detected).
 */
struct rail_verdict rail_classify_fallback(const struct rail_features *f)
{
	struct rail_verdict v = { RAIL_HEALTHY, 0.0f };

	/* Narrowband ratio: fraction of spectral energy in the strongest band. */
	float band_max = 0.0f;
	for (int b = 0; b < RAIL_N_BANDS; b++) {
		if (f->band_energy[b] > band_max) {
			band_max = f->band_energy[b];
		}
	}

	if (f->crest_factor > 6.0f && f->kurtosis > 5.0f) {
		v.cls      = RAIL_JOINT_WELD;
		v.severity = fminf(1.0f, (f->crest_factor - 6.0f) / 6.0f);
	} else if (band_max > 0.5f) {
		v.cls      = RAIL_CORRUGATION;
		v.severity = fminf(1.0f, band_max);
	} else if (f->rms > 0.30f) {
		v.cls      = RAIL_ROUGH_RCF;
		v.severity = fminf(1.0f, (f->rms - 0.30f) / 0.30f);
	} else {
		v.cls      = RAIL_HEALTHY;
		v.severity = 0.0f;
	}
	return v;
}

/*
 * rail_class_name -- stable string representation of a rail_class_t.
 *
 * Returns a NUL-terminated upper-case ASCII literal in static storage;
 * the caller must not free or mutate it.  Used to embed class labels in
 * CSV output records and structured log lines.
 */
const char *rail_class_name(rail_class_t c)
{
	switch (c) {
	case RAIL_HEALTHY:
		return "HEALTHY";
	case RAIL_CORRUGATION:
		return "CORRUGATION";
	case RAIL_JOINT_WELD:
		return "JOINT_WELD";
	case RAIL_ROUGH_RCF:
		return "ROUGH_RCF";
	default:
		return "UNKNOWN";
	}
}
```

## src/rail_features.h
```c
/*
 * Copyright 2026 Alp Lab AB
 * SPDX-License-Identifier: Apache-2.0
 *
 * rail_features -- pure-C DSP feature extraction for rail-vibration
 * predictive maintenance.  Arch-neutral (stdint/math only): builds for
 * native_sim and the Cortex-M55 alike, and is host-unit-tested.
 *
 * Pipeline role: a sliding window of per-sample vibration magnitude is
 * reduced to a small fixed-length feature vector (the AI classifier's
 * input) plus the physically-meaningful dominant-frequency / rail-
 * wavelength pair.  Corrugation is fixed in wavelength (lambda = v/f),
 * so the speed-normalised wavelength is the speed-invariant feature.
 */
#ifndef RAIL_FEATURES_H
#define RAIL_FEATURES_H

#include <stddef.h>
#include <stdint.h>
#include <stdbool.h>

#ifdef __cplusplus
extern "C" {
#endif

/*
 * Tuning constants for the feature extraction pipeline.
 *
 * RAIL_WINDOW_N  Sliding window length in samples.
 *   256 samples at 800 Hz = 320 ms of data.  Must be a power of 2
 *   (radix-2 FFT requirement); 256 gives 3.125 Hz per bin at 800 Hz ODR.
 *
 * RAIL_N_BANDS  Number of log-spaced spectral energy bands.
 *   8 bands span bins 1..127 on a log scale -- roughly one octave per
 *   band across the 3.125-400 Hz analysis range.
 *
 * RAIL_ODR_HZ  Default accelerometer output data rate in Hz.
 *   800 Hz gives a Nyquist of 400 Hz, covering the short-pitch
 *   corrugation range (100-400 Hz at typical survey speeds).
 */
#define RAIL_WINDOW_N 256
#define RAIL_N_BANDS  8
#define RAIL_ODR_HZ   800.0f
/** 3 scalars (rms, crest, kurtosis) + 8 bands + dom_freq + wavelength. */
#define RAIL_FEATURE_DIM (3 + RAIL_N_BANDS + 2)

/**
 * Accumulating sample window.
 *
 * count grows from 0 to RAIL_WINDOW_N as samples are pushed.  The
 * feature extractor reads exactly count entries (or RAIL_WINDOW_N when
 * full); the trailing portion of samples[] is not accessed.
 */
struct rail_feat_state {
	float    samples[RAIL_WINDOW_N]; /**< Raw vibration-magnitude samples (m/s^2). */
	uint16_t count;                  /**< Number of valid samples currently held. */
};

/** Extracted per-window features. */
struct rail_features {
	float rms;                       /**< AC RMS (DC removed) -- broadband energy. */
	float crest_factor;              /**< peak/RMS -- impulsive defects. */
	float kurtosis;                  /**< 4th moment -- impulsiveness. */
	float band_energy[RAIL_N_BANDS]; /**< normalised log-band energy. */
	float dom_freq_hz;               /**< frequency of the peak spectral bin. */
	float rail_wavelength_m;         /**< speed/dom_freq (0 when guarded). */
};

/** Reset the window (count = 0). */
void rail_feat_state_reset(struct rail_feat_state *st);

/** Append one vibration-magnitude sample; ignored once the window is full. */
void rail_feat_window_push(struct rail_feat_state *st, float sample);

/**
 * True once RAIL_WINDOW_N samples have been pushed into the window.
 * Poll after each rail_feat_window_push to decide when to call
 * rail_feat_extract and rail_feat_state_reset.
 */
bool rail_feat_window_full(const struct rail_feat_state *st);

/**
 * Reduce a full window to features.  @p odr_hz is the sample rate (Hz),
 * @p speed_mps the train speed (m/s, 0 if unknown).  Safe on a partial
 * window (treats count as the length).
 */
void rail_feat_extract(const struct rail_feat_state *st,
                       float                         odr_hz,
                       float                         speed_mps,
                       struct rail_features         *out);

/**
 * Pack @p f into the AI feature vector.  Writes exactly RAIL_FEATURE_DIM
 * floats when @p cap is large enough; returns the number written.
 */
size_t rail_feat_pack(const struct rail_features *f, float *vec, size_t cap);

/** Rail-defect taxonomy (reference-grade; customers retrain/retune). */
typedef enum {
	RAIL_HEALTHY     = 0, /**< No anomaly: all features below thresholds. */
	RAIL_CORRUGATION = 1, /**< Quasi-periodic corrugation (narrowband spectral peak). */
	RAIL_JOINT_WELD  = 2, /**< Discrete transient at a rail joint or weld. */
	RAIL_ROUGH_RCF   = 3, /**< Elevated broadband energy from RCF surface damage. */
	RAIL_CLASS_COUNT
} rail_class_t;

/**
 * Classifier output: class + 0..1 severity.
 *
 * severity = 0.0 means no detected defect contribution; 1.0 means the
 * feature magnitude is at or above the upper saturation point.  For
 * RAIL_HEALTHY the severity is always 0.0.
 */
struct rail_verdict {
	rail_class_t cls;      /**< Predicted defect class. */
	float        severity; /**< Severity in [0, 1]; 0 = healthy, 1 = max defect. */
};

/**
 * Deterministic rule-of-thumb classifier over the feature vector.  Used
 * when no AI model is loaded (e.g. native_sim) so the demo still produces
 * sensible geotagged output; the AI path overrides it when present.
 */
struct rail_verdict rail_classify_fallback(const struct rail_features *f);

/** Stable upper-case name for a class (for the CSV record). */
const char *rail_class_name(rail_class_t c);

#ifdef __cplusplus
}
#endif

#endif /* RAIL_FEATURES_H */
```

## src/rail_position.c
```c
/*
 * Copyright 2026 Alp Lab AB
 * SPDX-License-Identifier: Apache-2.0
 *
 * rail_position implementation -- see rail_position.h.
 */
#include "rail_position.h"

#include <math.h>
#include <stdlib.h>
#include <string.h>

#ifndef M_PI
#define M_PI 3.14159265358979323846
#endif

/*
 * Physical constants.
 *
 * RAIL_EARTH_R_M  Mean Earth radius in metres (6 371 000 m).
 *   The Earth is an oblate spheroid; its equatorial radius is
 *   ~6 378 137 m and its polar radius is ~6 356 752 m.  The MEAN
 *   radius (radius of a sphere of equal volume) is 6 371 008.8 m,
 *   rounded here to 6 371 000 m.  The haversine formula assumes a
 *   perfect sphere; the mean radius gives a maximum distance error
 *   of ~0.33 % compared with the WGS84 ellipsoid.  For rail survey
 *   purposes (segment lengths of 25 m, GPS accuracy of 2-5 m) this
 *   error is negligible.
 *
 * RAIL_DEG2RAD  Conversion factor from degrees to radians (pi/180).
 *   All trigonometric functions in <math.h> operate in radians; GNSS
 *   coordinates arrive in decimal degrees, so every latitude and
 *   longitude must be multiplied by this factor before use.
 *
 * RAIL_KNOT_MPS  Knots to metres-per-second conversion (0.514444 m/s/kn).
 *   One knot = one nautical mile per hour = 1852 m / 3600 s.
 *   NMEA $--RMC reports speed over ground in knots; multiplying by
 *   this constant converts to SI units (m/s) for the wavelength
 *   computation (lambda = speed_mps / dom_freq_hz).
 */
#define RAIL_EARTH_R_M 6371000.0 /* mean Earth radius (haversine standard) */
#define RAIL_DEG2RAD   (M_PI / 180.0)
#define RAIL_KNOT_MPS  0.514444f

/*
 * rail_pos_init -- initialise position-tracking state.
 *
 * Zeroes all fields and sets the segment length.  The default segment
 * length of 25 m is used when the caller passes zero or a negative
 * value; 25 m corresponds to a standard EN 13848 short-wavelength
 * measurement base and gives ~40 samples/km at typical survey speeds.
 */
void rail_pos_init(struct rail_pos_state *st, float segment_len_m)
{
	memset(st, 0, sizeof(*st));
	st->segment_len_m = (segment_len_m > 0.0f) ? segment_len_m : 25.0f;
}

/*
 * rail_pos_haversine_m -- great-circle distance between two WGS84 points.
 *
 * HAVERSINE FORMULA
 * -----------------
 * The haversine formula computes the shortest-arc distance on the
 * surface of a sphere (the great-circle distance).  For two points
 * (lat1, lon1) and (lat2, lon2) in decimal degrees:
 *
 *   dlat = (lat2 - lat1) * DEG2RAD
 *   dlon = (lon2 - lon1) * DEG2RAD
 *   a    = sin^2(dlat/2) + cos(lat1)*cos(lat2)*sin^2(dlon/2)
 *   c    = 2 * atan2( sqrt(a), sqrt(1-a) )
 *   d    = R * c
 *
 * The intermediate value 'a' is the square of the haversine of the
 * central angle; it lies in [0, 1].  Using atan2(sqrt(a), sqrt(1-a))
 * instead of asin(sqrt(a)) improves numerical stability for nearly
 * antipodal points where a approaches 1, and also avoids domain errors
 * if floating-point rounding pushes a slightly above 1.
 *
 * All four coordinate arguments are in DECIMAL DEGREES (not the NMEA
 * ddmm.mmmm format); call nmea_to_deg first when parsing NMEA strings.
 *
 * The function returns metres as a double to preserve sub-metre
 * precision for the chainage accumulation loop.
 */
double rail_pos_haversine_m(double lat1, double lon1, double lat2, double lon2)
{
	double dlat = (lat2 - lat1) * RAIL_DEG2RAD;
	double dlon = (lon2 - lon1) * RAIL_DEG2RAD;
	double a = sin(dlat / 2.0) * sin(dlat / 2.0) + cos(lat1 * RAIL_DEG2RAD) *
	                                                   cos(lat2 * RAIL_DEG2RAD) * sin(dlon / 2.0) *
	                                                   sin(dlon / 2.0);
	double c = 2.0 * atan2(sqrt(a), sqrt(1.0 - a));
	return RAIL_EARTH_R_M * c;
}

/*
 * rail_pos_update -- feed one GNSS sample into the chainage accumulator.
 *
 * CHAINAGE ACCUMULATION
 * ---------------------
 * Chainage is the along-track running distance from the survey start
 * point, accumulated by summing haversine distances between successive
 * GNSS fixes.  Each new fix extends chainage by the distance from the
 * previous fix:
 *
 *   chainage_m += haversine(prev_lat, prev_lon, lat, lon)
 *
 * SEGMENT BINNING
 * ---------------
 * The segment index is simply the integer part of the chainage divided
 * by the segment length:
 *
 *   segment_index = floor( chainage_m / segment_len_m )
 *
 * The function returns true when segment_index advances (i.e., the
 * train crosses into the next segment), enabling the caller to trigger
 * a per-segment feature aggregation step without tracking the previous
 * index itself.
 *
 * NO-FIX HOLD
 * -----------
 * When has_fix is false (NMEA status 'V' = void), the sample is
 * ignored entirely: chainage and segment_index are not updated, and
 * the function returns false immediately.  This prevents GPS outages
 * (tunnels, bridges) from creating phantom distance increments that
 * would corrupt the chainage record.
 *
 * FIRST-FIX BOOTSTRAP
 * --------------------
 * On the very first call with a valid fix, have_last is false so no
 * distance is added; the fix is simply recorded as the starting point.
 * Distance accumulation begins on the second fix.
 */
bool rail_pos_update(struct rail_pos_state *st, double lat, double lon, bool has_fix)
{
	if (!has_fix) {
		return false;
	}
	int32_t prev_seg = st->segment_index;
	if (st->have_last) {
		st->chainage_m += rail_pos_haversine_m(st->last_lat, st->last_lon, lat, lon);
		st->segment_index = (int32_t)(st->chainage_m / (double)st->segment_len_m);
	}
	st->last_lat  = lat;
	st->last_lon  = lon;
	st->have_last = true;
	return st->segment_index != prev_seg;
}

/*
 * nmea_to_deg -- convert NMEA ddmm.mmmm + hemisphere to decimal degrees.
 *
 * NMEA COORDINATE ENCODING
 * -------------------------
 * NMEA 0183 encodes coordinates in the format ddmm.mmmm where:
 *   dd    = integer degrees (may be 2 or 3 digits for longitude)
 *   mm    = integer minutes
 *   .mmmm = decimal fraction of a minute
 *
 * Example: latitude "5930.1500" with hemisphere 'N' means
 *   59 degrees 30.1500 minutes North
 *   = 59 + 30.1500/60 = 59.5025 decimal degrees.
 *
 * CONVERSION STEPS
 * ----------------
 * 1. Parse the raw string as a floating-point number v (e.g., 5930.15).
 * 2. Extract integer degrees: deg = floor(v / 100).
 * 3. Extract minutes: min = v - deg * 100  (e.g., 30.15).
 * 4. Convert: dec = deg + min / 60.0.
 * 5. Apply sign: S (South) and W (West) hemispheres are negative.
 *
 * A NULL or empty field string returns 0.0 (coordinates unavailable).
 */
/* Convert ddmm.mmmm + hemisphere to signed decimal degrees. */
static double nmea_to_deg(const char *field, char hemi)
{
	if (field == NULL || field[0] == '\0') {
		return 0.0;
	}
	double v       = atof(field);
	double degrees = floor(v / 100.0);
	double minutes = v - degrees * 100.0;
	double dec     = degrees + minutes / 60.0;
	if (hemi == 'S' || hemi == 'W') {
		dec = -dec;
	}
	return dec;
}

/*
 * rail_pos_parse_rmc -- parse an NMEA $--RMC sentence.
 *
 * RMC SENTENCE FORMAT
 * -------------------
 * RMC = "Recommended Minimum navigation information".  Example:
 *
 *   $GNRMC,123519,A,5930.1500,N,01831.7600,E,022.4,084.4,230394,003.1,W*6A
 *
 * Field index (0-based, comma-separated):
 *   [0]  Sentence ID ($GPRMC, $GNRMC, $GLRMC, ...)
 *   [1]  UTC time (hhmmss.ss)
 *   [2]  Status: 'A' = active (valid fix), 'V' = void (no fix)
 *   [3]  Latitude (ddmm.mmmm)
 *   [4]  N/S hemisphere
 *   [5]  Longitude (dddmm.mmmm)
 *   [6]  E/W hemisphere
 *   [7]  Speed over ground in KNOTS
 *   [8]  Track angle (degrees true)
 *   [9]  Date (ddmmyy)
 *   ...  (magnetic variation, checksum, etc.)
 *
 * TALKER PREFIX DETECTION
 * ------------------------
 * The function accepts any two-character talker prefix ($GP, $GN, $GL,
 * $GB, ...) by checking only positions 3-5 for 'R', 'M', 'C'.  This
 * makes the parser work with single-constellation GPS receivers ($GPRMC)
 * and multi-constellation GNSS chipsets ($GNRMC) without configuration.
 *
 * TOKENISATION
 * ------------
 * The sentence is copied to a local buffer and tokenised in-place by
 * replacing commas with NUL bytes.  This avoids heap allocation and is
 * safe on any platform; the copy also preserves the caller's string.
 *
 * SPEED CONVERSION
 * ----------------
 * NMEA reports speed in knots (nautical miles per hour).  The result is
 * converted to m/s by multiplying by RAIL_KNOT_MPS = 0.514444 m/s/kn
 * (1 nautical mile = 1852 m; 1 hour = 3600 s; 1852/3600 = 0.514444).
 */
bool rail_pos_parse_rmc(const char *nmea, double *lat, double *lon, float *speed_mps, bool *has_fix)
{
	if (nmea == NULL) {
		return false;
	}
	/* Accept any talker: $__RMC (e.g. GNRMC, GPRMC). */
	if (!(nmea[0] == '$' && nmea[3] == 'R' && nmea[4] == 'M' && nmea[5] == 'C')) {
		return false;
	}

	/* Tokenise a local copy on commas.  RMC fields:
	 * 0:$xxRMC 1:time 2:status 3:lat 4:N/S 5:lon 6:E/W 7:speed(kn) ... */
	char buf[128];
	strncpy(buf, nmea, sizeof(buf) - 1);
	buf[sizeof(buf) - 1] = '\0';

	char *fields[16] = { 0 };
	int   nf         = 0;
	char *p          = buf;
	fields[nf++]     = p;
	for (; *p && nf < 16; p++) {
		if (*p == ',') {
			*p           = '\0';
			fields[nf++] = p + 1;
		}
	}

	bool fix = (nf > 2 && fields[2][0] == 'A');
	if (has_fix) {
		*has_fix = fix;
	}
	if (fix && nf > 7) {
		if (lat) {
			*lat = nmea_to_deg(fields[3], fields[4][0]);
		}
		if (lon) {
			*lon = nmea_to_deg(fields[5], fields[6][0]);
		}
		if (speed_mps) {
			*speed_mps = (float)atof(fields[7]) * RAIL_KNOT_MPS;
		}
	}
	return true;
}
```

## src/rail_position.h
```c
/*
 * Copyright 2026 Alp Lab AB
 * SPDX-License-Identifier: Apache-2.0
 *
 * rail_position -- pure-C geotagging for the rail survey: turn GNSS
 * fixes into an along-track distance (chainage) and a fixed-length
 * segment index, and parse the minimum NMEA needed (RMC).  Arch-neutral
 * (stdint/math only); host-unit-tested.
 */
#ifndef RAIL_POSITION_H
#define RAIL_POSITION_H

#include <stdbool.h>
#include <stdint.h>

#ifdef __cplusplus
extern "C" {
#endif

/**
 * Running geotag state.
 *
 * Holds the previous GNSS fix for incremental haversine distance steps,
 * the accumulated along-track distance (chainage), and the derived
 * segment index for per-segment feature aggregation.
 */
struct rail_pos_state {
	double  last_lat;      /**< Latitude of the previous valid fix (decimal degrees). */
	double  last_lon;      /**< Longitude of the previous valid fix (decimal degrees). */
	bool    have_last;     /**< False until the first valid fix has been received. */
	double  chainage_m;    /**< accumulated along-track distance. */
	int32_t segment_index; /**< floor(chainage / segment_len_m). */
	float   segment_len_m; /**< segment size (default 25 m). */
};

/**
 * Initialise position-tracking state.
 *
 * Zeroes all fields; @p segment_len_m <= 0 falls back to the default
 * 25 m segment length.
 */
void rail_pos_init(struct rail_pos_state *st, float segment_len_m);

/**
 * Great-circle distance between two WGS84 points in metres.
 *
 * Uses the haversine formula with mean Earth radius 6 371 000 m;
 * all four coordinates must be in decimal degrees (not NMEA ddmm.mmmm).
 */
double rail_pos_haversine_m(double lat1, double lon1, double lat2, double lon2);

/**
 * Feed one GNSS sample.  With @p has_fix, accumulates distance from the
 * previous fixed point into chainage and recomputes the segment index;
 * without a fix the sample is ignored (chainage holds).  Returns true
 * iff the segment index advanced.
 */
bool rail_pos_update(struct rail_pos_state *st, double lat, double lon, bool has_fix);

/**
 * Parse a $--RMC sentence.  On success sets decimal-degree @p lat/@p lon,
 * @p speed_mps, and @p has_fix (status 'A' = fix, 'V' = void).  Returns
 * false if the sentence is not an RMC line.
 */
bool rail_pos_parse_rmc(const char *nmea,
                        double     *lat,
                        double     *lon,
                        float      *speed_mps,
                        bool       *has_fix);

#ifdef __cplusplus
}
#endif

#endif /* RAIL_POSITION_H */
```
