## examples/ai/cold-chain-monitor/boards/native_sim_native_64.conf
```kconfig
# SPDX-License-Identifier: Apache-2.0
# native_sim has no real I2C controller; pull in the emul drivers so the BME280
# chip driver can open the sensor bus at boot.  No emul target is attached, so
# main.c falls back to synthetic environment data.
CONFIG_EMUL=y
CONFIG_I2C_EMUL=y
```

## examples/ai/cold-chain-monitor/testcase.yaml
```yaml
# SPDX-License-Identifier: Apache-2.0

sample:
  name: cold-chain-monitor
  description: |
    Cold-chain integrity monitor: BME280 T/RH/P -> sliding-window metrics
    (MKT / dewpoint / excursion time) -> 4-state classifier (OK / TEMP_EXCURSION
    / MKT_EXCEEDED / CONDENSATION_RISK) + AI anomaly score (deterministic
    fallback).  native_sim runs synthetic environment data covering the states.
common:
  tags: ai inference industrial environmental cold-chain marketing showcase
tests:
  alp_sdk.example.cold_chain_monitor.e1m_evk:
    extra_configs:
      - 'CONFIG_COMPILER_OPT="-DALP_BOARD_E1M_EVK"'
    platform_allow:
      - native_sim/native/64
    integration_platforms:
      - native_sim/native/64
    tags:
      - alp-sdk
      - example
      - ai
      - environmental
    harness: console
    harness_config:
      type: one_line
      regex:
        - "\\[cc\\] done"

  alp_sdk.example.cold_chain_monitor.aen_build:
    extra_configs:
      - 'CONFIG_COMPILER_OPT="-DALP_BOARD_E1M_EVK"'
    platform_allow:
      - ensemble_e8_dk/ae402fa0e5597le0/rtss_hp
    build_only: true
    tags:
      - alp-sdk
      - example
      - ai
      - environmental
```

## examples/ai/motor-current-signature/testcase.yaml
```yaml
# SPDX-License-Identifier: Apache-2.0

sample:
  name: motor-current-signature
  description: |
    DC motor current-signature health monitor: INA236 current/voltage/power
    -> windowed features -> 5-state classifier (OFF/NORMAL/INRUSH/OVERLOAD/
    STALL) + AI anomaly score (deterministic fallback).  native_sim runs
    synthetic current covering all five states.
common:
  tags: ai inference industrial predictive-maintenance power marketing showcase
tests:
  alp_sdk.example.motor_current_signature.e1m_evk:
    extra_configs:
      - 'CONFIG_COMPILER_OPT="-DALP_BOARD_E1M_EVK"'
    platform_allow:
      - native_sim/native/64
    integration_platforms:
      - native_sim/native/64
    tags:
      - alp-sdk
      - example
      - ai
      - industrial
    harness: console
    harness_config:
      type: one_line
      regex:
        - "\\[curr\\] done"

  alp_sdk.example.motor_current_signature.e1m_x_evk:
    extra_configs:
      - 'CONFIG_COMPILER_OPT="-DALP_BOARD_E1M_X_EVK"'
    platform_allow:
      - native_sim/native/64
    integration_platforms:
      - native_sim/native/64
    tags:
      - alp-sdk
      - example
      - ai
      - industrial
    harness: console
    harness_config:
      type: one_line
      regex:
        - "\\[curr\\] done"

  alp_sdk.example.motor_current_signature.aen_build:
    extra_configs:
      - 'CONFIG_COMPILER_OPT="-DALP_BOARD_E1M_EVK"'
    platform_allow:
      - ensemble_e8_dk/ae402fa0e5597le0/rtss_hp
    build_only: true
    tags:
      - alp-sdk
      - example
      - ai
      - industrial
```

## examples/ai/multimodal-fusion-pdm/testcase.yaml
```yaml
# SPDX-License-Identifier: Apache-2.0

sample:
  name: multimodal-fusion-pdm
  description: |
    Multi-sensor motor-health monitor: ICM-42670 (vibration) + INA236 (current)
    + BME280 (temperature) fused via cross-modal corroboration into a fault
    hypothesis (HEALTHY / BEARING_WEAR / ELECTRICAL_FAULT / MECHANICAL_OVERLOAD
    / UNCORROBORATED) + a confidence-weighted health score.  native_sim runs
    synthetic per-modality data covering every scenario.
common:
  tags: ai inference industrial predictive-maintenance fusion marketing showcase
tests:
  alp_sdk.example.multimodal_fusion_pdm.e1m_evk:
    extra_configs:
      - 'CONFIG_COMPILER_OPT="-DALP_BOARD_E1M_EVK"'
    platform_allow:
      - native_sim/native/64
    integration_platforms:
      - native_sim/native/64
    tags:
      - alp-sdk
      - example
      - ai
      - industrial
    harness: console
    harness_config:
      type: one_line
      regex:
        - "\\[fuse\\] done"

  alp_sdk.example.multimodal_fusion_pdm.aen_build:
    extra_configs:
      - 'CONFIG_COMPILER_OPT="-DALP_BOARD_E1M_EVK"'
    platform_allow:
      - ensemble_e8_dk/ae402fa0e5597le0/rtss_hp
    build_only: true
    tags:
      - alp-sdk
      - example
      - ai
      - industrial
```

## examples/ai/rail-predictive-maintenance/testcase.yaml
```yaml
# SPDX-License-Identifier: Apache-2.0

sample:
  name: rail-predictive-maintenance
  description: |
    Train-mounted rail-condition survey: ICM-42670 vibration -> DSP
    features -> AI classifier (deterministic fallback) -> geotagged to
    GNSS lat/lon + chainage -> one CSV record per 25 m segment.
    native_sim replays a canned NMEA track + synthetic vibration.
common:
  tags: ai inference industrial predictive-maintenance gnss marketing showcase
tests:
  alp_sdk.example.rail_predictive_maintenance.e1m_evk:
    extra_configs:
      - 'CONFIG_COMPILER_OPT="-DALP_BOARD_E1M_EVK"'
    platform_allow:
      - native_sim/native/64
      - ensemble_e8_dk/ae402fa0e5597le0/rtss_hp
    integration_platforms:
      - native_sim/native/64
    tags:
      - alp-sdk
      - example
      - ai
      - industrial
      - aen
    harness: console
    harness_config:
      type: one_line
      regex:
        - "\\[rail\\] done"

  alp_sdk.example.rail_predictive_maintenance.e1m_x_evk:
    extra_configs:
      - 'CONFIG_COMPILER_OPT="-DALP_BOARD_E1M_X_EVK"'
    platform_allow:
      - native_sim/native/64
    integration_platforms:
      - native_sim/native/64
    tags:
      - alp-sdk
      - example
      - ai
      - industrial
      - v2n
    harness: console
    harness_config:
      type: one_line
      regex:
        - "\\[rail\\] done"
```

## examples/ai/visual-defect-detection/testcase.yaml
```yaml
# SPDX-License-Identifier: Apache-2.0

sample:
  name: visual-defect-detection
  description: |
    Camera-fed surface-anomaly inspection: an autoencoder reconstructs the
    "normal" surface and high reconstruction error flags a defect.  The frame is
    tiled, the worst region localized, and a PASS/FAIL verdict reported with a
    severity score and defect-coverage %.  native_sim runs synthetic clean +
    defect frames; the deterministic statistical fallback runs without a model.
common:
  tags: ai inference vision industrial defect-detection marketing showcase
tests:
  alp_sdk.example.visual_defect_detection.e1m_evk:
    extra_configs:
      - 'CONFIG_COMPILER_OPT="-DALP_BOARD_E1M_EVK"'
    platform_allow:
      - native_sim/native/64
    integration_platforms:
      - native_sim/native/64
    tags:
      - alp-sdk
      - example
      - ai
      - vision
    harness: console
    harness_config:
      type: one_line
      regex:
        - "\\[defect\\] done"

  alp_sdk.example.visual_defect_detection.aen_build:
    extra_configs:
      - 'CONFIG_COMPILER_OPT="-DALP_BOARD_E1M_EVK"'
    platform_allow:
      - ensemble_e8_dk/ae402fa0e5597le0/rtss_hp
    build_only: true
    tags:
      - alp-sdk
      - example
      - ai
      - vision
```

## examples/ai/wearable-activity-fall/testcase.yaml
```yaml
# SPDX-License-Identifier: Apache-2.0

sample:
  name: wearable-activity-fall
  description: |
    Body-worn IMU edge node: ICM-42670 accel+gyro -> windowed motion
    features -> activity classifier (idle/walk/run/stairs, deterministic
    fallback) + a rule-based 3-phase fall detector.  native_sim runs
    synthetic motion incl. one injected fall.
common:
  tags: ai inference wearable imu predictive-health marketing showcase
tests:
  alp_sdk.example.wearable_activity_fall.e1m_evk:
    extra_configs:
      - 'CONFIG_COMPILER_OPT="-DALP_BOARD_E1M_EVK"'
    platform_allow:
      - native_sim/native/64
    integration_platforms:
      - native_sim/native/64
    tags:
      - alp-sdk
      - example
      - ai
      - wearable
    harness: console
    harness_config:
      type: one_line
      regex:
        - "\\[wact\\] done"

  alp_sdk.example.wearable_activity_fall.aen_build:
    platform_allow:
      - ensemble_e8_dk/ae402fa0e5597le0/rtss_hp
    build_only: true
    tags:
      - alp-sdk
      - example
      - ai
      - wearable
```

## examples/audio-loopback/testcase.yaml
```yaml
# SPDX-License-Identifier: Apache-2.0

sample:
  name: audio-loopback
  description: |
    Per-peripheral example for <alp/audio.h>.  Reads PDM mic
    blocks, runs them through the ALP DSP chain (DC-block in v0.2),
    and pushes them straight back out over I2S.  Demonstrates the
    full audio_in / audio_out lifecycle on AEN-Zephyr.  Under
    native_sim the example skips the open() calls (no audio
    devices) and prints "[audio] done".

tests:
  alp_sdk.example.audio_loopback:
    platform_allow:
      - native_sim
      - native_sim/native/64
    integration_platforms:
      - native_sim/native/64
    extra_args: CONFIG_AUDIO_DMIC=y
    tags:
      - alp-sdk
      - example
      - audio
    harness: console
    harness_config:
      type: one_line
      regex:
        - "\\[audio\\] done"
```

## examples/audio-wake-word/testcase.yaml
```yaml
# SPDX-License-Identifier: Apache-2.0

sample:
  name: audio-wake-word
  description: |
    Always-on "Hey Alp" keyword spotter on the E1M-AEN family's
    low-power AI subsystem.  Cortex-M55 HE @ 50 MHz reads a PDM
    mic at 16 kHz, extracts MFCC features, runs a ~30k-param CNN
    on the on-die Ethos-U55 NPU.  Average draw <1 mW for 24/7
    listening; detection wakes the M55 HP for the heavy work.

tests:
  alp_sdk.examples.audio_wake_word.native_sim:
    platform_allow:
      - native_sim/native/64
    extra_args: CONFIG_AUDIO_DMIC=y
    tags:
      - alp-sdk
      - example
      - audio
      - ai
      - low-power
    build_only: true
    harness: console
    harness_config:
      type: one_line
      regex:
        - "\\[wake\\] done"

  alp_sdk.examples.audio_wake_word.aen:
    platform_allow:
      - ensemble_e8_dk/ae402fa0e5597le0/rtss_hp
    tags:
      - alp-sdk
      - example
      - audio
      - ai
      - low-power
    build_only: true
    harness: console
    harness_config:
      type: one_line
      regex:
        - "\\[wake\\] done"
```

## examples/audio/acoustic-anomaly-wind-turbine/testcase.yaml
```yaml
# SPDX-License-Identifier: Apache-2.0

sample:
  name: acoustic-anomaly-wind-turbine
  description: |
    Nacelle acoustic condition monitor: PDM mic -> DSP features ->
    rotor-order (BPF) normalisation -> anomaly score (deterministic
    fallback) for drivetrain tonals + gross blade aero-anomalies.
    native_sim runs synthetic acoustics + a canned RPM track.
common:
  tags: audio ai inference industrial predictive-maintenance marketing showcase
tests:
  alp_sdk.example.acoustic_anomaly_wind_turbine.native_sim:
    platform_allow:
      - native_sim/native/64
    integration_platforms:
      - native_sim/native/64
    extra_args: CONFIG_AUDIO_DMIC=y
    tags:
      - alp-sdk
      - example
      - audio
      - ai
      - industrial
    harness: console
    harness_config:
      type: one_line
      regex:
        - "\\[wtac\\] done"

  alp_sdk.example.acoustic_anomaly_wind_turbine.aen_build:
    platform_allow:
      - ensemble_e8_dk/ae402fa0e5597le0/rtss_hp
    build_only: true
    tags:
      - alp-sdk
      - example
      - audio
      - ai
      - industrial
```

## examples/audio/acoustic-safety-events/boards/native_sim_native_64.conf
```kconfig
# SPDX-License-Identifier: Apache-2.0
# Link the DMIC audio layer so alp_audio_in_open resolves; no DMIC device is
# present on native_sim, so it returns NULL and main.c uses synthetic audio.
CONFIG_AUDIO=y
CONFIG_AUDIO_DMIC=y
```

## examples/audio/acoustic-safety-events/testcase.yaml
```yaml
# SPDX-License-Identifier: Apache-2.0

sample:
  name: acoustic-safety-events
  description: |
    Always-listening safety/security node: PDM mic -> per-frame DSP features
    -> 4-class sound-event classifier (ambient/glass-break/alarm/scream) with
    a deterministic fallback.  native_sim runs synthetic audio cycling the
    four event types.
common:
  tags: ai inference audio safety security marketing showcase
tests:
  alp_sdk.example.acoustic_safety_events.native_sim:
    platform_allow:
      - native_sim/native/64
    integration_platforms:
      - native_sim/native/64
    extra_args: CONFIG_AUDIO_DMIC=y
    tags:
      - alp-sdk
      - example
      - audio
      - ai
      - safety
    harness: console
    harness_config:
      type: one_line
      regex:
        - "\\[ase\\] done"

  alp_sdk.example.acoustic_safety_events.aen_build:
    platform_allow:
      - ensemble_e8_dk/ae402fa0e5597le0/rtss_hp
    build_only: true
    tags:
      - alp-sdk
      - example
      - audio
      - ai
      - safety
```

## examples/audio/audio-noise-suppression/testcase.yaml
```yaml
# SPDX-License-Identifier: Apache-2.0

sample:
  name: audio-noise-suppression
  description: |
    Real-time noise suppression demo for headsets / hearables /
    conferencing.  TAS2563 mic -> <alp/dsp.h> Hann+FFT spectrum ->
    <alp/inference.h> RNNoise-style denoiser -> TAS2563 speaker,
    ~10 ms end-to-end latency target.  Targets V2N (and V2H by
    SKU flip); native_sim exercises the framing path.

tests:
  alp_sdk.examples.audio_noise_suppression.native_sim:
    platform_allow:
      - native_sim/native/64
    # native_sim has no I2S controller / NPU -- this overlay keeps the
    # build host-only (DSP runs the CMSIS-DSP/C fallback; audio opens
    # return NULL and the loop tolerates it).
    extra_args: EXTRA_CONF_FILE=native_sim.conf
    tags:
      - alp-sdk
      - example
      - audio
      - dsp
      - ai
    build_only: true
    harness: console
    harness_config:
      type: one_line
      regex:
        - "\\[ns\\] done"

  alp_sdk.examples.audio_noise_suppression.v2n:
    # Build-only until the alp_e1m_evk_v2n Zephyr board file lands
    # in alplabai/alp-zephyr-modules.  Twister rejects unknown
    # platforms in platform_allow, so we list the upstream Renesas
    # RZ/V2N EVK as a stand-in target -- the source compiles
    # cleanly against the V2N supervisor M33 once that board file
    # is published.
    platform_allow:
      - rzv2n_evk/r9a09g056n48gbg/cm33
    tags:
      - alp-sdk
      - example
      - audio
      - dsp
      - ai
      - v2n
    build_only: true
    harness: console
    harness_config:
      type: one_line
      regex:
        - "\\[ns\\] done"
```
