## examples/audio/butterworth-lowpass/testcase.yaml
```yaml
# SPDX-License-Identifier: Apache-2.0

sample:
  name: butterworth-lowpass
  description: |
    Design a 2nd-order Butterworth low-pass biquad and run passband +
    stopband tones through the <alp/dsp.h> IIR chain stage (CMSIS-DSP
    arm_biquad on the M55, portable-C under native_sim); report the
    per-tone gain.  Pure compute -- native_sim runs it end-to-end.
common:
  tags: dsp filter iir cmsis example
tests:
  # native_sim runs the full pipeline to completion (console-matched).
  # The example is board-agnostic compute, but both EVK variants build
  # so the SoM-swap path stays covered.
  alp_sdk.example.butterworth_lowpass.e1m_evk:
    extra_configs:
      - 'CONFIG_COMPILER_OPT="-DALP_BOARD_E1M_EVK"'
    platform_allow:
      - native_sim/native/64
    integration_platforms:
      - native_sim/native/64
    tags:
      - alp-sdk
      - example
      - dsp
    harness: console
    harness_config:
      type: one_line
      regex:
        - "\\[bwlp\\] done"

  alp_sdk.example.butterworth_lowpass.e1m_x_evk:
    extra_configs:
      - 'CONFIG_COMPILER_OPT="-DALP_BOARD_E1M_X_EVK"'
    platform_allow:
      - native_sim/native/64
    integration_platforms:
      - native_sim/native/64
    tags:
      - alp-sdk
      - example
      - dsp
    harness: console
    harness_config:
      type: one_line
      regex:
        - "\\[bwlp\\] done"

  # AEN silicon cross-build is build-only (CI is the AEN gate).
  alp_sdk.example.butterworth_lowpass.aen_build:
    extra_configs:
      - 'CONFIG_COMPILER_OPT="-DALP_BOARD_E1M_EVK"'
    platform_allow:
      - ensemble_e8_dk/ae402fa0e5597le0/rtss_hp
    build_only: true
    tags:
      - alp-sdk
      - example
      - dsp
      - aen
```

## examples/audio/i2s-tone/testcase.yaml
```yaml
# SPDX-License-Identifier: Apache-2.0

sample:
  name: i2s-tone
  description: |
    Per-peripheral example for <alp/i2s.h>.  Generates a 1 kHz
    triangle wave and streams it as 16-bit stereo PCM.  Uses
    BOARD_I2S_AUDIO for portability across E1M EVK (AEN) and
    E1M-X EVK (V2N).

tests:
  alp_sdk.example.i2s_tone.e1m_evk:
    extra_configs:
      - 'CONFIG_COMPILER_OPT="-DALP_BOARD_E1M_EVK"'
    platform_allow:
      - native_sim
      - native_sim/native/64
    integration_platforms:
      - native_sim/native/64
    tags:
      - alp-sdk
      - example
      - i2s
      - aen
    harness: console
    harness_config:
        type: one_line
        regex:
          - "\\[i2s\\] done"

  alp_sdk.example.i2s_tone.e1m_x_evk:
    extra_configs:
      - 'CONFIG_COMPILER_OPT="-DALP_BOARD_E1M_X_EVK"'
    platform_allow:
      - native_sim
      - native_sim/native/64
    integration_platforms:
      - native_sim/native/64
    tags:
      - alp-sdk
      - example
      - i2s
      - v2n
    harness: console
    harness_config:
        type: one_line
        regex:
          - "\\[i2s\\] done"
```

## examples/audio/libhelix-decode/testcase.yaml
```yaml
# SPDX-License-Identifier: Apache-2.0
#
# Builds + runs on native_sim (the portable MP3 frame-sync + header
# parse path).  The real Helix fixed-point PCM decode is ARM-only
# (real/assembly.h #errors on generic x86-64) and is not exercised
# here -- see README.md "What this teaches".

sample:
  name: libhelix-decode
  description: |
    Demonstrates the Helix MP3 decoder workflow.  On native_sim it runs
    the portable MP3 frame-sync + header parse (frame count, sample
    rate, samples/frame) that mirrors Helix's MP3FindSyncWord() +
    MP3GetLastFrameInfo(); the real MP3Decode() PCM path compiles on an
    ARM SoM with the west-fetched module (extras-tier1, RCSL licence).

tests:
  alp_sdk.example.libhelix_decode:
    platform_allow:
      - native_sim
      - native_sim/native/64
    integration_platforms:
      - native_sim/native/64
    tags:
      - alp-sdk
      - example
      - libhelix-decode
    harness: console
    harness_config:
        type: one_line
        regex:
          - "\\[libhelix-decode\\] done"
```

## examples/audio/minimp3-decode/testcase.yaml
```yaml
# SPDX-License-Identifier: Apache-2.0

sample:
  name: minimp3-decode
  description: |
    Decodes a canned MP3 byte array to PCM with the vendored
    minimp3 single-header decoder (vendors/minimp3/) and prints the
    sample count + RMS of the decoded audio.  Pure compute -- no
    I2S/codec HW required.

tests:
  alp_sdk.example.minimp3_decode:
    platform_allow:
      - native_sim
      - native_sim/native/64
    integration_platforms:
      - native_sim/native/64
    tags:
      - alp-sdk
      - example
      - minimp3-decode
    harness: console
    harness_config:
        type: one_line
        regex:
          - "\\[minimp3-decode\\] done"
```

## examples/bringup/board-selftest/boards/native_sim_native_64.conf
```kconfig
# SPDX-License-Identifier: Apache-2.0
#
# native_sim has no real I2C controller; pull in the emul I2C
# driver so the management bus enumerates at boot and the address
# scan can probe every 7-bit address (each NACKs because no target
# is registered -- so the scan reports 0 devices, which is still a
# PASS of the scan machinery).  Auto-loaded by Zephyr when building
# for native_sim/native/64.

CONFIG_EMUL=y
CONFIG_I2C_EMUL=y
```

## examples/bringup/board-selftest/testcase.yaml
```yaml
# SPDX-License-Identifier: Apache-2.0

sample:
  name: board-selftest
  description: |
    Board bring-up / self-test.  Reads the SoM + SoC identity, reads
    the RUN operating-point profile, and scans the on-module I2C
    management bus, then prints a pass/fail report.  Portable
    <alp/*> APIs only -- no chip driver -- so the same source runs
    on every E1M family.  On native_sim the identity/power checks
    have no backend and report SKIP; the emul I2C bus scans clean.

tests:
  alp_sdk.example.board_selftest.e1m_x_evk:
    platform_allow:
      - native_sim
      - native_sim/native/64
    integration_platforms:
      - native_sim/native/64
    extra_configs:
      - 'CONFIG_COMPILER_OPT="-DALP_BOARD_E1M_X_EVK"'
    tags:
      - alp-sdk
      - example
      - bringup
      - selftest
      - v2n
    harness: console
    harness_config:
        type: one_line
        regex:
          - "\\[selftest\\] done"
  alp_sdk.example.board_selftest.e1m_evk:
    platform_allow:
      - native_sim
      - native_sim/native/64
    integration_platforms:
      - native_sim/native/64
    extra_configs:
      - 'CONFIG_COMPILER_OPT="-DALP_BOARD_E1M_EVK"'
    tags:
      - alp-sdk
      - example
      - bringup
      - selftest
      - aen
    harness: console
    harness_config:
        type: one_line
        regex:
          - "\\[selftest\\] done"
```

## examples/can-loopback/testcase.yaml
```yaml
# SPDX-License-Identifier: Apache-2.0

sample:
  name: can-loopback
  description: |
    Per-peripheral example for <alp/can.h>.  Brings up CAN0 in
    loopback mode, sends a frame, demonstrates the rx callback.

tests:
  alp_sdk.example.can_loopback:
    platform_allow:
      - native_sim
      - native_sim/native/64
    integration_platforms:
      - native_sim/native/64
    tags:
      - alp-sdk
      - example
      - can
      harness: console
  harness_config:
      type: one_line
      regex:
        - "\\[can\\] done"
```

## examples/connectivity/coap-client-get/testcase.yaml
```yaml
# SPDX-License-Identifier: Apache-2.0

sample:
  name: coap-client-get
  description: |
    CoAP (RFC 7252) teaching example. Builds a CoAP GET request PDU offline
    and parses a canned CoAP response PDU -- no socket. Builds and runs on
    native_sim against the in-tree Zephyr `subsys/net/lib/coap` subsystem
    (CONFIG_COAP), the low-level packet codec only -- no CONFIG_COAP_CLIENT
    socket layer.

tests:
  alp_sdk.examples.coap_client_get.native_sim:
    platform_allow:
      - native_sim
      - native_sim/native/64
    integration_platforms:
      - native_sim/native/64
    tags:
      - alp-sdk
      - example
      - coap-client-get
    harness: console
    harness_config:
      type: one_line
      regex:
        - "\\[coap-client-get\\] done"
```

## examples/connectivity/iot-connected-camera/testcase.yaml
```yaml
# SPDX-License-Identifier: Apache-2.0

sample:
  name: iot-connected-camera
  description: |
    Connected-camera reference application for the V2N family.
    v0.1: skeleton — compiles under native_sim and prints the
    pipeline stages with v0.2 / v0.3 stubs.

tests:
  alp_sdk.example.iot_connected_camera.skeleton:
    platform_allow:
      - native_sim
      - native_sim/native/64
    integration_platforms:
      - native_sim/native/64
    tags:
      - alp-sdk
      - example
      - iot
    build_only: false
    harness: console
    harness_config:
        type: one_line
        regex:
          - "\\[iotcam\\] done"

  # alp_sdk.example.iot_connected_camera.evk_v2n — HW-in-loop
  # variant for the E1M-X EVK populated with an E1M-V2N101 SoM. The
  # real board target, alp_e1m_v2n101_m33_sm/r9a09g056n48gbg/cm33,
  # ships in-tree under zephyr/boards/alp/ -- this scenario stays
  # parked pending HW-in-loop CI wiring, not a missing board file.
```

## examples/connectivity/jsmn-json-parse/testcase.yaml
```yaml
# SPDX-License-Identifier: Apache-2.0

sample:
  name: jsmn-json-parse
  description: |
    jsmn teaching example. Tokenizes an in-RAM JSON config string with
    jsmn_parse and walks the token array to extract a string + an int
    field. Builds and runs on native_sim (no hardware, no vendored
    module fetch beyond the checked-in vendors/jsmn/ header).

tests:
  alp_sdk.examples.jsmn_json_parse.native_sim:
    platform_allow:
      - native_sim
      - native_sim/native/64
    integration_platforms:
      - native_sim/native/64
    tags:
      - alp-sdk
      - example
      - jsmn-json-parse
    harness: console
    harness_config:
      type: one_line
      regex:
        - "\\[jsmn-json-parse\\] done"
```

## examples/connectivity/modbus-server/testcase.yaml
```yaml
# SPDX-License-Identifier: Apache-2.0

sample:
  name: modbus-server
  description: |
    ADR 0018 Modbus teaching example.  Uses Zephyr's RAW_ADU backend so
    native_sim can run an in-process client/server register round trip.

tests:
  alp_sdk.examples.modbus_server.native_sim:
    platform_allow:
      - native_sim
      - native_sim/native/64
    integration_platforms:
      - native_sim/native/64
    tags:
      - alp-sdk
      - example
      - modbus
      - connectivity
    harness: console
    harness_config:
      type: one_line
      regex:
        - "\\[modbus\\] done"
```

## examples/connectivity/mqtt-sn-publish/testcase.yaml
```yaml
# SPDX-License-Identifier: Apache-2.0

sample:
  name: mqtt-sn-publish
  description: |
    coreMQTT-SN teaching example. Encodes an MQTT-SN PUBLISH packet
    into a buffer and parses it back out, asserting the topic id +
    payload survive the round trip. No socket, no gateway. The pinned
    coreMQTT-SN module checkout is empty on this machine (see README
    "Integration reality"), so this hand-rolls the OASIS MQTT-SN v1.2
    PUBLISH wire format instead of calling the real library.

tests:
  alp_sdk.examples.mqtt_sn_publish.native_sim:
    platform_allow:
      - native_sim
      - native_sim/native/64
    integration_platforms:
      - native_sim/native/64
    tags:
      - alp-sdk
      - example
      - mqtt-sn-publish
    harness: console
    harness_config:
      type: one_line
      regex:
        - "\\[mqtt-sn-publish\\] done"
```
