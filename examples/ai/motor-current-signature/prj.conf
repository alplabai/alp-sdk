## CMakeLists.txt
```
# SPDX-License-Identifier: Apache-2.0
cmake_minimum_required(VERSION 3.20.0)

find_package(Zephyr REQUIRED HINTS $ENV{ZEPHYR_BASE})
project(motor_current_signature LANGUAGES C)

target_compile_definitions(app PRIVATE _GNU_SOURCE)
target_sources(app PRIVATE
    src/main.c
    src/current_features.c
)
```

## prj.conf
```kconfig
# SPDX-License-Identifier: Apache-2.0
CONFIG_MAIN_STACK_SIZE=16384

CONFIG_LOG=y
CONFIG_LOG_PRINTK=y
CONFIG_CBPRINTF_FP_SUPPORT=y

CONFIG_ALP_SDK_INFERENCE_BACKEND_TFLM=y

# <alp/dsp.h> chain (FFT/magnitude) for the ripple-frequency feature.  Its
# backend runs CMSIS-DSP arm_rfft_fast_f32 on the M55 and a portable-C
# radix-2 fallback under native_sim.
CONFIG_ALP_SDK_DSP=y
```

## boards/native_sim_native_64.conf
```kconfig
# SPDX-License-Identifier: Apache-2.0
# native_sim has no real I2C controller; pull in the emul drivers so the INA236
# chip driver can open the sensor bus at boot.  No emul target is attached, so
# main.c falls back to synthetic current.
CONFIG_EMUL=y
CONFIG_I2C_EMUL=y
```

## boards/native_sim_native_64.overlay
```dts
/*
 * Copyright 2026 Alp Lab AB
 * SPDX-License-Identifier: Apache-2.0
 *
 * Host-build overlay -- exposes one emulated I2C controller via the alp-i2c0
 * alias so alp_i2c_open(BOARD_I2C_SENSORS) resolves and the INA236 bring-up
 * runs.  No emul target is attached, so the chip-ID read fails and main.c
 * falls back to synthetic current.  On real silicon this file is NOT applied.
 */
#include <zephyr/dt-bindings/i2c/i2c.h>

/ {
	aliases {
		alp-i2c0 = &i2c0_emul;
	};

	soc {
		i2c0_emul: i2c@100 {
			compatible = "zephyr,i2c-emul-controller";
			status = "okay";
			reg = <0 0x100 4>;
			#address-cells = <1>;
			#size-cells = <0>;
			clock-frequency = <I2C_BITRATE_FAST>;
		};
	};
};
```

## src/main.c
```c
/*
 * Copyright 2026 Alp Lab AB
 * SPDX-License-Identifier: Apache-2.0
 *
 * motor-current-signature
 * =======================
 *
 * DC motor / load current-signature health monitor.  Pipeline:
 *
 *   INA236 current/voltage/power (I2C, ~200 Hz read_all) --256-sample window-->
 *     current_features (mean/ripple/crest/slope/power) -> current_classify
 *       (OFF/NORMAL/INRUSH/OVERLOAD/STALL) + <alp/inference.h> anomaly score
 *       (deterministic fallback) --> one CURR record per window.
 *
 * Honest scope: DC-rail / brushed-DC-motor current-signature analysis (the
 * INA236's domain) -- NOT AC-mains NILM.  Monitor-only.  The model is a stub
 * (see models/README.md); with no model the deterministic classifier + anomaly
 * fallback run.  At 200 Hz the resolvable ripple is < 100 Hz (Nyquist);
 * sensorless RPM from faster commutation ripple is bench-gated.
 */
#include <string.h>
#include <math.h>
#include <zephyr/kernel.h>
#include <zephyr/logging/log.h>

#include "alp/board.h"
#include "alp/inference.h"
#include "alp/peripheral.h"
#include "alp/chips/ina236.h"

#include "current_features.h"

#ifndef M_PI
#define M_PI 3.14159265358979323846
#endif

LOG_MODULE_REGISTER(curr, LOG_LEVEL_INF);

#define INA236_ADDR       0x40u
#define INA236_SHUNT_OHMS 0.01f /* 10 mOhm sense resistor */
#define INA236_MAX_A      8.0f
#define N_WINDOWS         5 /* one window per state in the synth_sample demo track */

/*
 * Reference thresholds for a generic brushed-DC motor; a real deployment
 * tunes these to the specific motor's rated current and expected ripple
 * (see current_features.h for what each field gates). Held as a single
 * static config rather than per-instance state because this demo runs one
 * motor for its whole lifetime -- a multi-motor product would carry one
 * curr_config per monitored motor.
 */
static const struct curr_config CFG = { .off_a          = 0.05f,
	                                    .overload_a     = 2.5f,
	                                    .ripple_min_a   = 0.05f,
	                                    .inrush_slope_a = 1.0f };

/* 1-byte stub so alp_inference_open's non-NULL contract is met; an unusable
 * tensor forces the deterministic anomaly fallback.  See models/README.md. */
static const uint8_t s_model[] = { 0x00 };

/* Synthetic current per window: one window per operating state.  The 40 Hz
 * ripple tone stands in for commutation ripple; a real motor's ripple
 * frequency instead tracks its rotor speed (see the MCSA overview at the
 * top of current_features.c), but a fixed tone is enough to exercise
 * ripple_freq_hz end-to-end on native_sim without simulating a full motor
 * model. */
static struct curr_sample synth_sample(int window, int i)
{
	float              t   = (float)i / CURR_SR_HZ;
	float              rip = 0.1f * sinf(2.0f * (float)M_PI * 40.0f * t);
	struct curr_sample s   = { .current_a = 0.0f, .bus_v = 12.0f, .power_w = 0.0f };
	switch (window) {
	case 0: /* OFF */
		s.current_a = 0.01f;
		break;
	case 1: /* NORMAL: 1 A + ripple */
		s.current_a = 1.0f + rip;
		break;
	case 2: { /* INRUSH: 5 A decaying to 1 A */
		float frac  = (float)i / (float)(CURR_WINDOW_N - 1);
		s.current_a = 5.0f - 4.0f * frac;
		break;
	}
	case 3: /* OVERLOAD: 3 A + ripple */
		s.current_a = 3.0f + rip;
		break;
	default: /* STALL: 3 A, no ripple */
		s.current_a = 3.0f;
		break;
	}
	s.power_w = s.current_a * s.bus_v;
	return s;
}

/*
 * anomaly_score returns a 0..1 severity independent of current_classify()'s
 * discrete state: the deterministic classifier answers "which of the five
 * known states is this", while the anomaly score (AI, or curr_anomaly_fallback
 * when no usable model is loaded) answers "how far outside normal bounds is
 * this", including off-taxonomy faults the five-state classifier cannot
 * name.  The tensor dtype/size_bytes checks below are the real fallback
 * trigger: alp_inference_open() accepts the 1-byte stub model_data, so
 * inf != NULL alone does not mean a usable model is loaded.
 */
static float anomaly_score(alp_inference_t *inf, const struct curr_features *f)
{
	if (inf != NULL) {
		float vec[CURR_FEATURE_DIM];
		(void)curr_feat_pack(f, vec, CURR_FEATURE_DIM);
		alp_inference_tensor_t in = { 0 };
		if (alp_inference_get_input(inf, 0, &in) == ALP_OK && in.dtype == ALP_INFERENCE_DTYPE_F32 &&
		    in.data != NULL && in.size_bytes >= sizeof(vec)) {
			memcpy(in.data, vec, sizeof(vec));
			if (alp_inference_invoke(inf) == ALP_OK) {
				alp_inference_tensor_t out = { 0 };
				if (alp_inference_get_output(inf, 0, &out) == ALP_OK &&
				    out.dtype == ALP_INFERENCE_DTYPE_F32 && out.data != NULL &&
				    out.size_bytes >= sizeof(float)) {
					return ((const float *)out.data)[0];
				}
			}
		}
	}
	return curr_anomaly_fallback(f, &CFG);
}

int main(void)
{
	static ina236_t                 mon;
	static struct curr_window_state win;
	bool                            mon_ok = false;

	/* BOARD_I2C_SENSORS is the portable sensor-bus alias from board.yaml's
	 * pins: section -- it resolves to whichever underlying I2C controller
	 * the target carrier wires the INA236 to, so this source does not need
	 * a carrier-specific bus index. */
	alp_i2c_t *bus =
	    alp_i2c_open(&(alp_i2c_config_t){ .bus_id = BOARD_I2C_SENSORS, .bitrate_hz = 400000 });
	/* INA236_ADCRANGE_81MV selects the ±81.92 mV shunt full-scale range,
	 * matched to INA236_SHUNT_OHMS/INA236_MAX_A (10 mOhm * 8 A = 80 mV): the
	 * narrower range gives finer ADC resolution than the alternative
	 * ±20.48 V range would, at the cost of clipping above ~8 A. */
	if (bus != NULL &&
	    ina236_init(
	        &mon, bus, INA236_ADDR, INA236_SHUNT_OHMS, INA236_MAX_A, INA236_ADCRANGE_81MV) ==
	        ALP_OK) {
		mon_ok = true;
	} else {
		/* Expected on native_sim (no real I2C device answers); the loop
		 * below falls back to synth_sample() for every sample. */
		LOG_WRN("INA236 unavailable; using synthetic current");
	}

	/* s_model is a 1-byte placeholder, not a trained autoencoder -- it only
	 * satisfies alp_inference_open's non-NULL model_data contract.
	 * anomaly_score() detects the resulting unusable tensor and falls back
	 * to curr_anomaly_fallback() on every call. */
	alp_inference_t *inf = alp_inference_open(&(alp_inference_config_t){
	    .backend    = ALP_INFERENCE_BACKEND_AUTO,
	    .format     = ALP_INFERENCE_MODEL_TFLITE,
	    .model_data = s_model,
	    .model_size = sizeof(s_model),
	});

	printk("# CURR,t_s,state,mean_a,mean_w,ripple_hz,anomaly_score\n");

	for (int w = 0; w < N_WINDOWS; w++) {
		curr_window_reset(&win);
		for (int i = 0; i < CURR_WINDOW_N; i++) {
			struct curr_sample s;
			if (mon_ok) {
				/* Raw INA236 register units are micro-A/milli-V/micro-W;
				 * convert once here so the rest of the pipeline (features,
				 * classifier, printk) works in plain SI units throughout. */
				ina236_sample_t r;
				if (ina236_read_all(&mon, &r) == ALP_OK) {
					s.current_a = (float)r.current_ua / 1e6f;
					s.bus_v     = (float)r.bus_mv / 1e3f;
					s.power_w   = (float)r.power_uw / 1e6f;
				} else {
					s = synth_sample(w, i);
				}
			} else {
				s = synth_sample(w, i);
			}
			curr_window_push(&win, s);
		}

		/* One CURR record per 1.28 s window (CURR_WINDOW_N / CURR_SR_HZ):
		 * the classifier gives the discrete operating state, the anomaly
		 * score gives a continuous severity that can flag drift even
		 * within a single named state. */
		struct curr_features f;
		curr_feat_extract(&win, CURR_SR_HZ, &f);
		curr_state_t st = current_classify(&f, &CFG);
		float        an = anomaly_score(inf, &f);

		printk("CURR,%.2f,%s,%.2f,%.1f,%.1f,%.2f\n",
		       (double)(w * 1.28f),
		       curr_state_name(st),
		       (double)f.mean_current_a,
		       (double)f.mean_power_w,
		       (double)f.ripple_freq_hz,
		       (double)an);
	}

	/* Teardown mirrors the open order; each close is guarded on the
	 * matching _ok flag / non-NULL handle so a partially-initialised run
	 * does not deinit hardware that was never brought up. */
	if (inf != NULL) {
		alp_inference_close(inf);
	}
	if (mon_ok) {
		(void)ina236_reset(&mon);
		ina236_deinit(&mon);
	}
	if (bus != NULL) {
		alp_i2c_close(bus);
	}
	printk("[curr] done\n");
	return 0;
}
```

## src/current_features.c
```c
/*
 * Copyright 2026 Alp Lab AB
 * SPDX-License-Identifier: Apache-2.0
 *
 * current_features implementation -- see current_features.h.
 */

/*
 * Motor Current Signature Analysis (MCSA) -- module overview
 * -----------------------------------------------------------
 * A healthy DC motor draws current with a characteristic commutation ripple
 * whose frequency equals (rotor speed in rev/s) × (commutator segment count).
 * Monitoring this ripple in the current waveform lets firmware distinguish
 * five motor states without any additional speed sensor.
 *
 * Sampling parameters used throughout this file:
 *   CURR_SR_HZ    = 200 Hz  →  Nyquist ceiling at 100 Hz (resolves ripple on
 *                               the low-pole-count motors targeted here).
 *   CURR_WINDOW_N = 256 samples  →  1.28 s window; long enough for several
 *                               commutation cycles at low speed, short enough
 *                               to keep state-update latency under 2 seconds.
 *   FFT bin width = 200 / 256 ≈ 0.78 Hz  →  frequency resolution per bin.
 *
 * Features extracted per window (see struct curr_features in the header):
 *
 *   mean_current_a  DC operating point; primary threshold for OFF / OVERLOAD.
 *   rms_ac_a        RMS of (I − mean): the commutation ripple magnitude.
 *                   KEY MCSA discriminant -- a stalled rotor cannot commutate
 *                   so rms_ac_a collapses even while mean_current_a stays high.
 *   crest           peak|I−mean| / rms_ac; high for spiky transients vs.
 *                   steady periodic ripple.
 *   slope_a         (last-quarter mean) − (first-quarter mean).  Negative
 *                   during decaying inrush; near-zero or positive when running.
 *   mean_power_w    Window-averaged power; corroborates load level.
 *   mean_bus_v      Window-averaged bus voltage; tracks load-induced voltage sag.
 *   ripple_freq_hz  Frequency of the dominant FFT bin; tracks rotor speed.
 */

#include "current_features.h"

#include <math.h>
#include <string.h>

/*
 * SPECTRAL + STATISTICAL MATH -- via <alp/dsp.h>, not hand-rolled.
 * ---------------------------------------------------------------
 * This example does NOT re-derive an FFT or the window statistics by
 * hand, and it does NOT call CMSIS-DSP arm_* directly.  Both go through
 * the portable <alp/dsp.h> surface, so the SAME source builds for
 * native_sim and the Cortex-M55 alike and the SDK -- not the app --
 * owns the CMSIS-vs-portable choice:
 *
 *   1. The dominant-ripple FFT goes through alp_dsp_chain
 *      (ALP_DSP_STAGE_FFT).  The backend runs CMSIS-DSP arm_rfft_fast_f32
 *      (Helium-vectorised) on the M55 and a portable-C radix-2 fallback
 *      under native_sim -- selected by the backend registry, not an
 *      #ifdef here.  Keeping the example on it lets the identical source
 *      run on the V2N (A55 + DRP-AI) path too.
 *
 *   2. The scalar window statistics (per-channel mean, RMS, abs-peak) go
 *      through alp_dsp_stats_f32, which the SDK backs with CMSIS-DSP
 *      arm_mean/rms/absmax_f32 on Cortex-M and a portable-C pass
 *      elsewhere -- no arm_* here.
 *
 * alp_dsp_stats_f32 operates on a single contiguous float array.  The
 * INA236 sample stream is an array-of-structs (current_a/bus_v/power_w
 * interleaved per sample), so each channel is de-interleaved into its own
 * contiguous buffer once per window before the stats run -- see the
 * de-interleave loop in curr_feat_extract, which stays a plain portable
 * loop (there is no "strided gather" kernel to replace it with).  The
 * first/last-quarter inrush-slope means and the mean-centring subtraction
 * also stay plain loops -- both are trivial and not worth wrapping.
 */
#include <alp/dsp.h>

/* ---------------------------------------------------------------------------
 * Window management
 *
 * The window is a simple front-to-back fill buffer (not a circular ring).
 * This design choice keeps the FFT input contiguous in memory (no modular
 * index arithmetic) and makes zero-padding of partial windows trivial.
 * The caller is responsible for calling curr_window_reset() after each
 * successful extraction and before accumulating the next window.
 * -------------------------------------------------------------------------*/

void curr_window_reset(struct curr_window_state *st)
{
	st->count = 0;
}

void curr_window_push(struct curr_window_state *st, struct curr_sample s)
{
	/* Silently discard samples that arrive after the window is full.
	 * The caller should poll curr_window_full() and stop pushing once
	 * true; the silent-drop guard is a safety net against race conditions
	 * in interrupt-driven sample delivery. */
	if (st->count < CURR_WINDOW_N) {
		st->s[st->count++] = s;
	}
}

bool curr_window_full(const struct curr_window_state *st)
{
	return st->count >= CURR_WINDOW_N;
}

/* ---------------------------------------------------------------------------
 * Feature extraction
 * -------------------------------------------------------------------------*/

void curr_feat_extract(const struct curr_window_state *st, float sr_hz, struct curr_features *out)
{
	/* Use however many samples are available; may be < CURR_WINDOW_N if the
	 * window is not yet full (e.g. during the first window after reset). */
	const int n = (st->count < CURR_WINDOW_N) ? st->count : CURR_WINDOW_N;

	/* Zero the output struct unconditionally so all fields have defined
	 * values even in the early-return path (n == 0).  Callers may read
	 * individual fields without first checking if extraction ran. */
	memset(out, 0, sizeof(*out));
	if (n <= 0) {
		return;
	}

	/* De-interleave the AoS sample stream into three contiguous per-channel
	 * buffers.  This pass is NOT a "stat" itself -- it is unavoidable data
	 * staging: alp_dsp_stats_f32 (called below for each channel) requires
	 * a plain contiguous float array, and the INA236 sample struct
	 * interleaves current/bus/power per sample.  One combined pass here
	 * is cheaper than three separate per-channel copy passes.  cur_buf is
	 * reused below for the AC-ripple stats and the FFT input; it is
	 * static to keep the 3 * 256 * 4 = 3 KB of buffers off the stack. */
	static float cur_buf[CURR_WINDOW_N];
	static float pwr_buf[CURR_WINDOW_N];
	static float bus_buf[CURR_WINDOW_N];
	for (int i = 0; i < n; i++) {
		cur_buf[i] = st->s[i].current_a;
		pwr_buf[i] = st->s[i].power_w;
		bus_buf[i] = st->s[i].bus_v;
	}

	/* --- DC features: mean current, power, bus voltage ---
	 * The means serve as the DC operating-point features.  mean_current_a
	 * is the primary classifier threshold (OFF / OVERLOAD boundary).
	 * mean_bus_v lets the caller detect load-induced voltage sag
	 * independently of the current level.  One alp_dsp_stats_f32 pass per
	 * channel yields the mean; the SDK backs this with CMSIS-DSP
	 * arm_mean_f32 on the M55 and a portable-C pass under native_sim --
	 * no arm_* here. */
	alp_dsp_stats_t st_cur, st_pwr, st_bus;
	alp_dsp_stats_f32(cur_buf, (size_t)n, &st_cur);
	alp_dsp_stats_f32(pwr_buf, (size_t)n, &st_pwr);
	alp_dsp_stats_f32(bus_buf, (size_t)n, &st_bus);
	out->mean_current_a = st_cur.mean;
	out->mean_power_w   = st_pwr.mean;
	out->mean_bus_v     = st_bus.mean;

	/* --- AC ripple features: rms_ac_a and crest factor ---
	 * Removing the DC mean before squaring is the software equivalent of AC
	 * coupling: only the commutation ripple energy is measured.
	 *
	 *   rms_ac_a = sqrt( (1/N) · Σ (Iᵢ − mean)² )
	 *
	 * This is the KEY MCSA discriminant.  A stalled rotor produces no
	 * commutation ripple, so rms_ac_a stays near zero while mean_current_a
	 * remains elevated -- the stall/overload fork in current_classify()
	 * exploits exactly this contrast.
	 *
	 * Crest factor = peak_ac / rms_ac.  A high value (>3) indicates that one
	 * or a few large spikes dominate the window rather than a sustained
	 * periodic ripple.  Guard against divide-by-zero with the 1e-6 A floor.
	 *
	 * xc[] (the mean-centred current) is reused below as the FFT input, so
	 * it is computed here once with a plain loop (trivial, not worth
	 * wrapping) rather than recomputed per stage.  A second
	 * alp_dsp_stats_f32 pass over xc then yields rms_ac_a and the abs-peak
	 * -- the SDK backs this with CMSIS-DSP arm_rms/absmax_f32 on the M55
	 * and a portable-C pass under native_sim -- no arm_* here. */
	static float xc[CURR_WINDOW_N];
	for (int i = 0; i < n; i++) {
		xc[i] = cur_buf[i] - out->mean_current_a;
	}
	alp_dsp_stats_t st_ac;
	alp_dsp_stats_f32(xc, (size_t)n, &st_ac);
	float peak    = st_ac.abs_max; /* peak |xc| */
	out->rms_ac_a = st_ac.rms;     /* AC RMS = sqrt(mean(xc^2)) */
	/* Crest factor is undefined when there is no ripple (e.g. motor OFF or
	 * perfectly smooth supply).  Return 0 rather than +Inf in that case;
	 * the classifier treats 0 and a genuine low crest value identically
	 * because both indicate an absence of peaky transients. */
	out->crest = (out->rms_ac_a > 1e-6f) ? (peak / out->rms_ac_a) : 0.0f;
	for (int i = n; i < CURR_WINDOW_N; i++) {
		xc[i] = 0.0f; /* zero-pad the FFT tail on a short window */
	}

	/* --- Inrush slope (last-quarter mean − first-quarter mean) ---
	 * During motor start-up, current spikes and then decays as back-EMF
	 * builds.  Averaging the first and last quarters of the window gives a
	 * robust slope estimate that is negative (last < first) while inrush is
	 * decaying and near-zero or positive once running steadily.
	 * q = n/4 with a minimum of 1 to handle tiny partial windows. */
	/* q = number of samples in one quarter.  Minimum of 1 ensures the slope
	 * is computable even when fewer than 4 samples have arrived (the first
	 * ISR tick after a reset), avoiding a divide-by-zero and ensuring the
	 * first and last sums each contain at least one sample. */
	int q = n / 4;
	if (q < 1) {
		q = 1;
	}
	/* mean-of-first-q and mean-of-last-q via two alp_dsp_stats_f32 passes
	 * over sub-ranges of cur_buf -- algebraically identical to
	 * (last_sum - first_sum) / q, and again no arm_* here. */
	alp_dsp_stats_t st_first, st_last;
	alp_dsp_stats_f32(cur_buf, (size_t)q, &st_first);
	alp_dsp_stats_f32(&cur_buf[n - q], (size_t)q, &st_last);
	out->slope_a = st_last.mean - st_first.mean;

	/*
	 * SPECTRUM via the portable <alp/dsp.h> chain (NOT a hand-rolled FFT).
	 * ------------------------------------------------------------------
	 * A single ALP_DSP_STAGE_FFT (rectangular, no window) transforms the
	 * mean-centred current xc[] to magnitude bins.  The backend runs
	 * CMSIS-DSP arm_rfft_fast_f32 on the M55 and a portable-C radix-2 FFT
	 * under native_sim -- the example source is identical either way.
	 *
	 * The chain consumes int16 samples (the wire format used elsewhere in
	 * alp-sdk for ADC-derived streams).  We scale the float window to fill
	 * the int16 range before feeding it: the absolute scale is irrelevant
	 * here because the dominant bin is an argmax over magnitude-squared,
	 * which is scale-invariant.
	 */
	static int16_t samp_q15[CURR_WINDOW_N];
	float          scale = (peak > 1e-9f) ? (30000.0f / peak) : 0.0f;
	for (int i = 0; i < CURR_WINDOW_N; i++) {
		samp_q15[i] = (int16_t)lrintf(xc[i] * scale);
	}

	static float    mag[CURR_WINDOW_N];
	alp_dsp_stage_t stages[] = {
		{ .kind  = ALP_DSP_STAGE_FFT,
		  .u.fft = { .n_points = CURR_WINDOW_N, .output_format = ALP_DSP_FFT_OUTPUT_MAGNITUDE } },
	};
	alp_dsp_chain_t *chain = alp_dsp_chain_open(stages, 1u);
	size_t           got   = 0;
	memset(mag, 0, sizeof(mag));
	if (chain != NULL) {
		(void)alp_dsp_chain_apply_bins(chain, samp_q15, CURR_WINDOW_N, mag, CURR_WINDOW_N, &got);
		alp_dsp_chain_close(chain);
	}

	/* Search only the positive-frequency half-spectrum (bins 1 to N/2−1).
	 * Bin 0 (DC) is excluded because the input was already mean-removed.
	 * Bins N/2 and above are mirror images (Nyquist aliases) of bins below.
	 * We track |X[k]|² (magnitude squared, from the chain's magnitude
	 * output) rather than |X[k]| to preserve the original argmax ordering.
	 * dom_val starts at −1 so the first bin (k=1) always wins the first
	 * comparison. */
	const int half    = CURR_WINDOW_N / 2;
	int       dom_bin = 1;
	float     dom_val = -1.0f;
	for (int k = 1; k < half; k++) {
		float m2 = mag[k] * mag[k]; /* |X[k]|² */
		if (m2 > dom_val) {
			dom_val = m2;
			dom_bin = k;
		}
	}
	/* Convert winning bin index to Hz: Δf = sr_hz / N per bin. */
	out->ripple_freq_hz = (float)dom_bin * sr_hz / (float)CURR_WINDOW_N;
}

/* ---------------------------------------------------------------------------
 * Feature vector packing
 *
 * Serialises the seven scalar features into a flat float array in a fixed
 * canonical order that must match the training-time feature ordering used by
 * any downstream ML model.  Returning the count (== CURR_FEATURE_DIM) lets
 * the caller assert at run time that packing succeeded; returning 0 on a
 * too-small buffer flags configuration mismatches early.
 * -------------------------------------------------------------------------*/
size_t curr_feat_pack(const struct curr_features *f, float *vec, size_t cap)
{
	if (cap < (size_t)CURR_FEATURE_DIM) {
		return 0;
	}
	size_t i = 0;
	vec[i++] = f->mean_current_a;
	vec[i++] = f->rms_ac_a;
	vec[i++] = f->crest;
	vec[i++] = f->slope_a;
	vec[i++] = f->mean_power_w;
	vec[i++] = f->mean_bus_v;
	vec[i++] = f->ripple_freq_hz;
	return i; /* == CURR_FEATURE_DIM */
}

/* ---------------------------------------------------------------------------
 * Deterministic five-state classifier
 *
 * Branch order encodes diagnostic priority -- each guard eliminates an
 * ambiguous case before the next test can fire:
 *
 *   1. OFF (mean_current_a < off_a)
 *      Checked first.  A de-energised motor produces noise in every feature;
 *      classifying it as OFF early prevents all subsequent guards from
 *      misfiring on that noise.
 *
 *   2. INRUSH (slope_a < −inrush_slope_a, i.e. current is falling fast)
 *      Checked before the overcurrent guard because startup inrush often
 *      briefly exceeds the overload threshold.  Without this priority the
 *      motor would be misclassified as STALL or OVERLOAD during every cold
 *      start.  A negative slope means last-quarter current < first-quarter
 *      current -- the signature of a decaying startup spike.
 *
 *   3. OVERLOAD vs. STALL (mean_current_a > overload_a)
 *      Both states present with elevated current.  The MCSA ripple
 *      discriminant resolves them:
 *        rms_ac_a < ripple_min_a  →  rotor not turning  →  STALL
 *        rms_ac_a ≥ ripple_min_a  →  rotor still turning →  OVERLOAD
 *      This is the core MCSA insight: a stalled rotor produces no
 *      commutation ripple even though the winding current is high.
 *
 *   4. NORMAL  (fall-through catch-all for everything in-spec)
 * -------------------------------------------------------------------------*/
curr_state_t current_classify(const struct curr_features *f, const struct curr_config *cfg)
{
	if (f->mean_current_a < cfg->off_a) {
		return CURR_OFF;
	}
	if (f->slope_a < -cfg->inrush_slope_a) {
		return CURR_INRUSH; /* current decaying from a startup spike */
	}
	if (f->mean_current_a > cfg->overload_a) {
		/* Ripple discriminant: stall has no commutation ripple, overload does. */
		return (f->rms_ac_a < cfg->ripple_min_a) ? CURR_STALL : CURR_OVERLOAD;
	}
	return CURR_NORMAL;
}

/* curr_state_name -- string table for logging and telemetry.
 * Returns a stable upper-case ASCII identifier; callers may log the pointer
 * directly without copying.  The default branch catches any value outside the
 * defined enum range (e.g. an uninitialised variable). */
const char *curr_state_name(curr_state_t s)
{
	switch (s) {
	case CURR_OFF:
		return "OFF";
	case CURR_NORMAL:
		return "NORMAL";
	case CURR_INRUSH:
		return "INRUSH";
	case CURR_OVERLOAD:
		return "OVERLOAD";
	case CURR_STALL:
		return "STALL";
	default:
		return "UNKNOWN";
	}
}

/* ---------------------------------------------------------------------------
 * Deterministic anomaly fallback  (no AI model loaded)
 *
 * Returns a 0..1 severity score for overcurrent conditions.  This is the
 * fallback path when the AI inference engine is unavailable (model not yet
 * loaded, NPU offline, first-boot before OTA delivers the model file).
 *
 * Scoring:
 *   Proportional overcurrent:
 *     score = (I_mean − I_overload) / I_overload
 *     Gives 0.0 exactly at the overload threshold, rising linearly with
 *     excess current.  The cfg->overload_a > 1e-6 guard prevents divide-
 *     by-zero when the config is uninitialised.
 *
 *   Stall guard:
 *     If high current AND near-zero ripple (rms_ac_a < ripple_min_a), the
 *     rotor has stopped.  A stalled winding dissipates full supply power
 *     with no mechanical output -- the most thermally destructive common
 *     fault.  The score is saturated to 0.9 regardless of the proportional
 *     value so that a stall always triggers the highest-priority alert tier.
 *
 *   Hard clamp to [0.0, 1.0] for a normalised downstream interface.
 * -------------------------------------------------------------------------*/
float curr_anomaly_fallback(const struct curr_features *f, const struct curr_config *cfg)
{
	float score = 0.0f;
	if (f->mean_current_a > cfg->overload_a && cfg->overload_a > 1e-6f) {
		/* Fractional excess: 0 at threshold, grows linearly above it. */
		score = (f->mean_current_a - cfg->overload_a) / cfg->overload_a;
	}
	/* High current with no ripple = stalled rotor: a strong anomaly. */
	if (f->mean_current_a > cfg->overload_a && f->rms_ac_a < cfg->ripple_min_a) {
		score = fmaxf(score, 0.9f);
	}
	/* Clamp to [0, 1].  The proportional formula can only produce ≥ 0, but
	 * the clamps guard against future extensions that might compute a
	 * negative score and ensure a normalised output contract regardless. */
	if (score < 0.0f) {
		score = 0.0f;
	}
	if (score > 1.0f) {
		score = 1.0f;
	}
	return score;
}
```

## src/current_features.h
```c
/*
 * Copyright 2026 Alp Lab AB
 * SPDX-License-Identifier: Apache-2.0
 *
 * current_features -- pure-C windowed current/voltage/power feature extraction
 * for the DC motor current-signature health example.  Arch-neutral (stdint/math
 * only): builds for native_sim and the Cortex-M55 alike; host-unit-tested.
 */
#ifndef CURRENT_FEATURES_H
#define CURRENT_FEATURES_H

#include <stdbool.h>
#include <stddef.h>
#include <stdint.h>

#ifdef __cplusplus
extern "C" {
#endif

/*
 * Sampling and window parameters
 * --------------------------------
 * CURR_SR_HZ = 200 Hz gives a Nyquist ceiling of 100 Hz -- sufficient to
 * resolve commutation ripple on the low-pole-count motors targeted here.
 *
 * CURR_WINDOW_N = 256 samples spans 1.28 s: long enough for several
 * commutation cycles at low speed, short enough for sub-2-second latency.
 * 256 is a power of 2 so the FFT needs no zero-padding of its own.
 *
 * FFT bin resolution = CURR_SR_HZ / CURR_WINDOW_N = 200 / 256 ≈ 0.78 Hz.
 */
#define CURR_WINDOW_N 256
#define CURR_SR_HZ    200.0f
/** mean_current + rms_ac + crest + slope + mean_power + mean_bus + ripple_freq. */
#define CURR_FEATURE_DIM 7

/** One INA236 sample, SI units. */
struct curr_sample {
	float current_a; /**< Phase current in Amperes (shunt-sense, signed). */
	float bus_v;     /**< Bus voltage in Volts. */
	float power_w;   /**< Instantaneous power in Watts (current_a × bus_v). */
};

/*
 * curr_window_state -- fixed-length sample accumulator.
 *
 * Holds up to CURR_WINDOW_N raw samples collected at CURR_SR_HZ.  When
 * count == CURR_WINDOW_N the window is ready for feature extraction.  Push
 * silently stops at capacity; call curr_window_reset() to begin the next
 * window after processing the previous one.
 */
struct curr_window_state {
	struct curr_sample s[CURR_WINDOW_N]; /**< Sample buffer, filled front-to-back. */
	uint16_t           count;            /**< Number of valid samples stored so far. */
};

/*
 * curr_features -- one feature vector derived from a complete window.
 *
 * All fields are in SI units.  The vector is designed to feed both the
 * deterministic rule-based classifier (current_classify) and a trained ML
 * model delivered via the tan model pipeline.  Field order is fixed and must
 * match the training-time feature order used by any downstream model (see
 * curr_feat_pack for the serialisation order).
 */
struct curr_features {
	float mean_current_a; /**< DC mean current over the window (A). */
	float rms_ac_a;       /**< RMS of (I − mean): commutation ripple magnitude (A). */
	float crest;          /**< peak|I−mean| / rms_ac; 0 when rms_ac is negligible. */
	float slope_a;        /**< last-quarter mean − first-quarter mean (A); < 0 during inrush. */
	float mean_power_w;   /**< DC mean power over the window (W). */
	float mean_bus_v;     /**< DC mean bus voltage over the window (V). */
	float ripple_freq_hz; /**< Frequency of the dominant FFT bin of the AC current (Hz). */
};

/**
 * @brief Reset a window accumulator, discarding all stored samples.
 *
 * @param st  Window state to reset.  Must not be NULL.
 */
void curr_window_reset(struct curr_window_state *st);

/**
 * @brief Push one sample into the window accumulator.
 *
 * Silently drops the sample once the window is full.  Check
 * curr_window_full() to detect when the window is ready for extraction.
 *
 * @param st  Window accumulator.
 * @param s   Sample to append (copied by value).
 */
void curr_window_push(struct curr_window_state *st, struct curr_sample s);

/**
 * @brief Return true when the window holds CURR_WINDOW_N samples.
 *
 * @param st  Window accumulator (read-only).
 * @return    true if full, false otherwise.
 */
bool curr_window_full(const struct curr_window_state *st);

/**
 * @brief Extract all features from a (possibly partial) window.
 *
 * Computes DC means, AC ripple RMS, crest factor, inrush slope, and the
 * dominant ripple frequency (via the <alp/dsp.h> FFT chain) and writes them
 * into @p out.  A partial window (count < CURR_WINDOW_N) is zero-padded for
 * the FFT.  If the window is empty all output fields are zero.
 *
 * @param st      Window accumulator (read-only).
 * @param sr_hz   Sampling rate in Hz; converts FFT bin index to frequency.
 *                Pass CURR_SR_HZ unless the hardware rate has changed.
 * @param out     Output feature struct; fully overwritten on return.
 */
void curr_feat_extract(const struct curr_window_state *st, float sr_hz, struct curr_features *out);

/**
 * @brief Serialise features into a flat float array for model inference.
 *
 * Writes exactly CURR_FEATURE_DIM floats into @p vec in the fixed order:
 * mean_current_a, rms_ac_a, crest, slope_a, mean_power_w, mean_bus_v,
 * ripple_freq_hz.  This order must match the feature order used at model
 * training time.
 *
 * @param f    Feature struct to serialise.
 * @param vec  Output buffer.  Must have capacity >= CURR_FEATURE_DIM.
 * @param cap  Capacity of @p vec in number of floats.
 * @return     Number of floats written (== CURR_FEATURE_DIM), or 0 if
 *             @p cap < CURR_FEATURE_DIM.
 */
size_t curr_feat_pack(const struct curr_features *f, float *vec, size_t cap);

/** Operating-state taxonomy (reference-grade; customers retune the config). */
typedef enum {
	CURR_OFF      = 0, /**< Motor de-energised; mean current below off_a. */
	CURR_NORMAL   = 1, /**< Running within spec; current and ripple nominal. */
	CURR_INRUSH   = 2, /**< Decaying startup spike; slope_a < −inrush_slope_a. */
	CURR_OVERLOAD = 3, /**< High current, rotor turning; commutation ripple present. */
	CURR_STALL    = 4, /**< High current, no ripple; rotor has stopped. */
	CURR_STATE_COUNT   /**< Sentinel; not a valid operating state. */
} curr_state_t;

/** Motor-specific thresholds (all in Amperes unless noted). */
struct curr_config {
	float off_a;          /**< Mean current below this → motor is OFF. */
	float overload_a;     /**< Mean current above this → OVERLOAD or STALL. */
	float ripple_min_a;   /**< rms_ac below this at high current → STALL (no commutation). */
	float inrush_slope_a; /**< slope_a below −this magnitude → INRUSH. */
};

/**
 * @brief Classify the operating state from a feature vector.
 *
 * Implements the deterministic five-state MCSA classifier.  Branch priority:
 * OFF → INRUSH (slope) → STALL/OVERLOAD (ripple discriminant) → NORMAL.
 * See current_features.c for the full rationale of the branch ordering.
 *
 * @param f    Extracted feature vector (from curr_feat_extract).
 * @param cfg  Motor-specific threshold configuration.
 * @return     One of: CURR_OFF, CURR_NORMAL, CURR_INRUSH, CURR_OVERLOAD,
 *             CURR_STALL.
 */
curr_state_t current_classify(const struct curr_features *f, const struct curr_config *cfg);

/**
 * @brief Return the upper-case ASCII name of a state (e.g. "STALL").
 *
 * @param s  State value.
 * @return   Null-terminated constant string; never NULL.
 */
const char *curr_state_name(curr_state_t s);

/**
 * @brief Deterministic 0..1 anomaly score for use when no AI model is loaded.
 *
 * Scores 0.0 within normal bounds, rises proportionally with overcurrent
 * severity, and saturates to 0.9 on a detected stall (high current with
 * near-zero ripple) -- the most thermally destructive common fault.
 * Output is hard-clamped to [0.0, 1.0].
 *
 * @param f    Extracted feature vector.
 * @param cfg  Motor-specific thresholds.
 * @return     Anomaly severity in [0.0, 1.0].
 */
float curr_anomaly_fallback(const struct curr_features *f, const struct curr_config *cfg);

#ifdef __cplusplus
}
#endif

#endif /* CURRENT_FEATURES_H */
```
