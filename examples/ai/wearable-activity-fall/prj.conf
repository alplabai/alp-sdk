## CMakeLists.txt
```
# SPDX-License-Identifier: Apache-2.0
cmake_minimum_required(VERSION 3.20.0)

find_package(Zephyr REQUIRED HINTS $ENV{ZEPHYR_BASE})
project(wearable_activity_fall LANGUAGES C)

target_compile_definitions(app PRIVATE _GNU_SOURCE)
target_sources(app PRIVATE
    src/main.c
    src/motion_features.c
    src/fall_detect.c
)
```

## prj.conf
```kconfig
# SPDX-License-Identifier: Apache-2.0
CONFIG_MAIN_STACK_SIZE=16384

CONFIG_LOG=y
CONFIG_LOG_PRINTK=y
CONFIG_CBPRINTF_FP_SUPPORT=y

CONFIG_ALP_SDK_INFERENCE_BACKEND_TFLM=y

# <alp/dsp.h> chain (FFT/magnitude) for the cadence feature.  Its backend
# runs CMSIS-DSP arm_rfft_fast_f32 on the M55 and a portable-C radix-2
# fallback under native_sim.
CONFIG_ALP_SDK_DSP=y
```

## boards/native_sim_native_64.conf
```kconfig
# SPDX-License-Identifier: Apache-2.0
# native_sim has no real I2C controller; pull in the emul drivers so the
# ICM-42670 chip driver can open the sensor bus at boot.  No emul target is
# attached, so main.c falls back to synthetic motion.
CONFIG_EMUL=y
CONFIG_I2C_EMUL=y
```

## boards/native_sim_native_64.overlay
```dts
/*
 * Copyright 2026 Alp Lab AB
 * SPDX-License-Identifier: Apache-2.0
 *
 * Host-build overlay -- exposes one emulated I2C controller via the alp-i2c0
 * alias so alp_i2c_open(BOARD_I2C_SENSORS) resolves and the ICM-42670 bring-up
 * runs.  No emul target is attached, so the WHO_AM_I read fails and main.c
 * falls back to synthetic motion.  On real silicon this file is NOT applied.
 */
#include <zephyr/dt-bindings/i2c/i2c.h>

/ {
    aliases {
        alp-i2c0 = &i2c0_emul;
    };

    soc {
        i2c0_emul: i2c@100 {
            compatible = "zephyr,i2c-emul-controller";
            status = "okay";
            reg = <0 0x100 4>;
            #address-cells = <1>;
            #size-cells = <0>;
            clock-frequency = <I2C_BITRATE_FAST>;
        };
    };
};
```

## src/main.c
```c
/*
 * Copyright 2026 Alp Lab AB
 * SPDX-License-Identifier: Apache-2.0
 *
 * wearable-activity-fall
 * ======================
 *
 * Body-worn IMU edge node.  Pipeline:
 *
 *   ICM-42670 accel+gyro (I2C, 100 Hz, +/-16 g) --every sample-->
 *     fall_detect (3-phase free-fall -> impact -> stillness state machine)
 *   ICM-42670 --256-sample window (2.56 s)-->
 *     motion_features (RMS/SMA/cadence/jerk/tilt) -> <alp/inference.h>
 *       activity classifier (idle/walk/run/stairs) + deterministic fallback
 *     --> one WACT record per window; falls flagged immediately.
 *
 * Honest scope: body-worn motion; coarse activity + fall detection.  NOT
 * medical-grade, not a certified fall alarm.  The model is a stub (see
 * models/README.md); with no model the deterministic fallback runs.
 */
#include <math.h>
#include <string.h>
#include <zephyr/kernel.h>
#include <zephyr/logging/log.h>

#include "alp/board.h"
#include "alp/chips/icm42670.h"
#include "alp/inference.h"
#include "alp/peripheral.h"

#include "fall_detect.h"
#include "motion_features.h"

#ifndef M_PI
#define M_PI 3.14159265358979323846
#endif

LOG_MODULE_REGISTER(wact, LOG_LEVEL_INF);

#define ICM_ACCEL_LSB_PER_G  2048.0f /* +/-16 g full-scale. */
#define ICM_GYRO_LSB_PER_DPS 16.4f   /* +/-2000 dps full-scale. */
#define IMU_I2C_ADDR         ICM42670_I2C_ADDR_HIGH
#define N_WINDOWS            8 /* bounded demo run: 8 * 2.56 s of activity/fall data */

/* 1-byte stub so alp_inference_open's non-NULL contract is met; an unusable
 * tensor forces the deterministic fallback.  See models/README.md. */
static const uint8_t s_model[] = { 0x00 };

/* Synthetic motion for native_sim: one window per activity, plus an injected
 * fall in window 5. */
static struct mot_sample synth_sample(int window, int i)
{
	float             t = (float)i / MOT_SR_HZ;
	struct mot_sample s = {
		.ax = 0.0f, .ay = 0.0f, .az = 1.0f, .gx = 0.0f, .gy = 0.0f, .gz = 0.0f
	};
	switch (window % 4) {
	case 0: /* idle */
		break;
	case 1: /* walk ~2 Hz */
		s.az = 1.0f + 0.3f * sinf(2.0f * (float)M_PI * 2.0f * t);
		s.gx = 10.0f * sinf(2.0f * (float)M_PI * 2.0f * t);
		break;
	case 2: /* run ~3 Hz */
		s.az = 1.0f + 1.2f * sinf(2.0f * (float)M_PI * 3.0f * t);
		s.gx = 40.0f * sinf(2.0f * (float)M_PI * 3.0f * t);
		break;
	default: /* stairs-ish: walk cadence + tilt */
		s.az = 0.9f + 0.3f * sinf(2.0f * (float)M_PI * 1.8f * t);
		s.ax = 0.3f;
		break;
	}
	return s;
}

/* Overlay a free-fall -> impact -> stillness sequence on window 5's |a|.
 * fall_detect.h's thresholds are in g and require >= ~80 ms below
 * FALL_FREEFALL_G (0.5 g) then an impact above FALL_IMPACT_G (2.5 g) --
 * 15 samples at 100 Hz = 150 ms comfortably clears the free-fall minimum,
 * and 5.0 g clears the impact threshold, so this track reliably fires
 * fall_push() without depending on real IMU timing. */
static float synth_fall_amag(int i)
{
	if (i < 20) {
		return 1.0f; /* normal */
	} else if (i < 35) {
		return 0.2f; /* free-fall (15 samples) */
	} else if (i < 37) {
		return 5.0f; /* impact */
	}
	return 1.0f; /* stillness */
}

/* AI activity classifier, else the deterministic fallback.  Unlike
 * fall_push() (called unconditionally, every sample, below), this only
 * runs once per completed window -- activity classification does not need
 * per-sample latency the way fall detection does. */
static struct mot_verdict classify(alp_inference_t *inf, const struct mot_features *f)
{
	if (inf != NULL) {
		float vec[MOT_FEATURE_DIM];
		(void)mot_feat_pack(f, vec, MOT_FEATURE_DIM);
		alp_inference_tensor_t in = { 0 };
		if (alp_inference_get_input(inf, 0, &in) == ALP_OK && in.dtype == ALP_INFERENCE_DTYPE_F32 &&
		    in.data != NULL && in.size_bytes >= sizeof(vec)) {
			memcpy(in.data, vec, sizeof(vec));
			if (alp_inference_invoke(inf) == ALP_OK) {
				alp_inference_tensor_t out = { 0 };
				if (alp_inference_get_output(inf, 0, &out) == ALP_OK &&
				    out.dtype == ALP_INFERENCE_DTYPE_F32 && out.data != NULL &&
				    out.size_bytes >= ACT_CLASS_COUNT * sizeof(float)) {
					/* argmax over the ACT_CLASS_COUNT per-class scores;
					 * the winning score itself is reported as confidence,
					 * unlike rail/current's severity-from-1-minus-healthy
					 * pattern -- here "how sure the model is" is exactly
					 * what the WACT record's confidence column means. */
					const float *sc   = (const float *)out.data;
					int          best = 0;
					float        bv   = sc[0];
					for (int k = 1; k < ACT_CLASS_COUNT; k++) {
						if (sc[k] > bv) {
							bv   = sc[k];
							best = k;
						}
					}
					return (struct mot_verdict){ (mot_activity_t)best, bv };
				}
			}
		}
	}
	return mot_activity_fallback(f);
}

int main(void)
{
	static icm42670_t              imu;
	static struct mot_window_state win;
	static struct fall_state       fall;
	bool                           imu_ok = false;

	fall_reset(&fall);

	/* BOARD_I2C_SENSORS resolves to the shared sensor I2C bus on whichever
	 * EVK is targeted.  alp_i2c_open() takes a config struct; failure is
	 * tolerated -- the loop falls back to synthetic motion. */
	alp_i2c_t *bus = alp_i2c_open(&(alp_i2c_config_t){
	    .bus_id     = BOARD_I2C_SENSORS,
	    .bitrate_hz = 400000,
	});
	/* +/-16 g full-scale (not a tighter range) so a hard fall impact -- which
	 * can spike to several g -- registers as a real reading instead of
	 * clipping at the ADC rail; +/-2000 dps similarly covers the fast
	 * rotation of a stumble or a stairs-related tilt. */
	if (bus != NULL && icm42670_init(&imu, bus, IMU_I2C_ADDR) == ALP_OK &&
	    icm42670_set_accel(&imu, ICM42670_ODR_100_HZ, ICM42670_ACCEL_FS_16G) == ALP_OK &&
	    icm42670_set_gyro(&imu, ICM42670_ODR_100_HZ, ICM42670_GYRO_FS_2000_DPS) == ALP_OK) {
		imu_ok = true;
	} else {
		LOG_WRN("ICM-42670 unavailable; using synthetic motion");
	}

	/* s_model is a 1-byte placeholder, not a trained activity classifier --
	 * it only satisfies alp_inference_open's non-NULL model_data contract.
	 * classify() detects the resulting unusable tensor and falls back to
	 * mot_activity_fallback() on every call below. */
	alp_inference_t *inf = alp_inference_open(&(alp_inference_config_t){
	    .backend    = ALP_INFERENCE_BACKEND_AUTO,
	    .format     = ALP_INFERENCE_MODEL_TFLITE,
	    .model_data = s_model,
	    .model_size = sizeof(s_model),
	});

	printk("# WACT,t_s,activity,confidence,fall,impact_g\n");

	for (int w = 0; w < N_WINDOWS; w++) {
		mot_window_reset(&win);
		/* Per-window latch: once fall_push() confirms a fall anywhere in
		 * this window, keep reporting it (and its peak impact) even though
		 * the sample loop continues and fall_detect self-resets to
		 * FALL_PHASE_NORMAL afterwards. */
		bool  fall_fired = false;
		float impact_g   = 0.0f;

		for (int i = 0; i < MOT_WINDOW_N; i++) {
			struct mot_sample s;
			if (imu_ok) {
				icm42670_axes_t a, g;
				if (icm42670_read_accel(&imu, &a) == ALP_OK &&
				    icm42670_read_gyro(&imu, &g) == ALP_OK) {
					s.ax = (float)a.x / ICM_ACCEL_LSB_PER_G;
					s.ay = (float)a.y / ICM_ACCEL_LSB_PER_G;
					s.az = (float)a.z / ICM_ACCEL_LSB_PER_G;
					s.gx = (float)g.x / ICM_GYRO_LSB_PER_DPS;
					s.gy = (float)g.y / ICM_GYRO_LSB_PER_DPS;
					s.gz = (float)g.z / ICM_GYRO_LSB_PER_DPS;
				} else {
					s = synth_sample(w, i);
				}
			} else {
				s = synth_sample(w, i);
			}

			/* Window 5 (native_sim) overlays a fall on the |a| magnitude. */
			float amag;
			if (!imu_ok && w == 5) {
				amag = synth_fall_amag(i);
				s.az = amag; /* drive the window features too */
				s.ax = 0.0f;
				s.ay = 0.0f;
			} else {
				/* Real/general-case path: |a| magnitude, not per-axis,
				 * because the wearable's mount orientation on the body is
				 * not fixed -- a fall must be detectable regardless of
				 * which axis happens to face down. */
				amag = sqrtf(s.ax * s.ax + s.ay * s.ay + s.az * s.az);
			}

			mot_window_push(&win, s);

			/* fall_push() runs every sample (not once per window): the
			 * free-fall -> impact -> stillness sequence it detects spans
			 * only ~1 s and must be caught at full 100 Hz resolution, far
			 * finer than the 2.56 s activity-classification window below. */
			float ig = 0.0f;
			if (fall_push(&fall, amag, MOT_SR_HZ, &ig)) {
				fall_fired = true;
				impact_g   = ig;
			}
		}

		/* Activity classification runs once per completed window, in
		 * parallel with (not gated by) the fall detector above -- a fall
		 * and an activity label can both be reported for the same window. */
		struct mot_features f;
		mot_feat_extract(&win, MOT_SR_HZ, &f);
		struct mot_verdict v = classify(inf, &f);

		printk("WACT,%.2f,%s,%.2f,%d,%.1f\n",
		       (double)(w * 2.56f),
		       mot_activity_name(v.cls),
		       (double)v.confidence,
		       fall_fired ? 1 : 0,
		       (double)impact_g);
	}

	/* Teardown mirrors the open order; each close is guarded so a
	 * partially-initialised run (e.g. IMU absent on native_sim) does not
	 * deinit hardware that was never brought up. */
	if (inf != NULL) {
		alp_inference_close(inf);
	}
	if (imu_ok) {
		icm42670_deinit(&imu);
	}
	alp_i2c_close(bus);
	printk("[wact] done\n");
	return 0;
}
```

## src/fall_detect.c
```c
/*
 * Copyright 2026 Alp Lab AB
 * SPDX-License-Identifier: Apache-2.0
 *
 * fall_detect implementation -- see fall_detect.h.
 *
 * Classic three-phase, rule-based fall detector implemented as a per-sample
 * state machine.  The algorithm is based on the approach documented in the
 * wearable health literature (Kangas et al.; Bourke et al.) and operates
 * reliably on wrist-worn accelerometers at 50--200 Hz.
 *
 * Why three phases instead of a single impact threshold?
 * -------------------------------------------------------
 * A naive impact detector (amag > FALL_IMPACT_G) generates many false
 * positives because ordinary activities easily exceed 2.5 g:
 *   - Sitting down forcefully                   (~3--4 g impact)
 *   - Placing a rigid wrist on a table          (~3 g)
 *   - Dropped device landing screen-down        (any peak)
 *   - Running heel-strike on hard pavement      (~2.5--4 g)
 *
 * Adding the preceding free-fall gate eliminates almost all non-fall impacts
 * because genuine falls are the only everyday event that produces BOTH:
 *   a) near-weightlessness (|a| < 0.5 g) for a sustained interval, AND
 *   b) a large impact shortly after.
 *
 * The post-impact stillness phase confirms the subject landed and remained
 * on the ground, ruling out stumble-and-recover events where the person
 * catches themselves (impact present, but immediately followed by renewed
 * dynamic motion rather than rest).
 *
 * State machine overview
 * -----------------------
 *
 *   NORMAL
 *     |  amag < 0.5g
 *     v
 *   FREEFALL ──────── (duration < ff_min) ──────────────────────> NORMAL
 *     |  amag >= 0.5g AND duration >= ff_min
 *     |
 *     +──── (amag > 2.5g on the first rising sample) ──────────> POST_IMPACT
 *     |
 *     v
 *   WAIT_IMPACT
 *     |  amag > 2.5g within impact_win samples
 *     v
 *   POST_IMPACT ───── (post_count > post_max, no settling) ────> NORMAL
 *     |  still_count >= still_min  (~1 s near-1g)
 *     v
 *   NORMAL  +  fire (return true, write peak impact_g)
 *
 * Phase timing at 100 Hz (sr_hz = MOT_SR_HZ)
 * --------------------------------------------
 *   ff_min     = round(0.08 * 100) =   8 samples   (~80 ms minimum free-fall)
 *   impact_win = round(0.30 * 100) =  30 samples   (~300 ms to find the impact)
 *   still_min  = round(1.00 * 100) = 100 samples   (~1 s post-impact stillness)
 *   post_max   = round(3.00 * 100) = 300 samples   (~3 s maximum wait)
 *
 * All counts scale linearly with sr_hz so the thresholds are sample-rate
 * independent in physical time.
 *
 * Single-fire + self-reset guarantee
 * ------------------------------------
 * fall_push() returns true EXACTLY ONCE per confirmed fall event (on the
 * sample where still_count reaches still_min), then immediately calls
 * fall_reset() to return to NORMAL.  The post_max timeout also calls
 * fall_reset() to prevent the machine from staying armed indefinitely if the
 * subject never settles after impact (e.g. rolls down a slope).  The caller
 * does NOT need to reset the state machine after receiving a confirmed fall.
 *
 * False-positive rejection summary
 * ----------------------------------
 *   Scenario                  ff gate   impact gate  stillness gate
 *   Hard table-tap            none      PASS         FAIL (no rest)   -> no fire
 *   Forceful sit-down         FAIL      PASS         N/A              -> no fire
 *   Running heel-strike       FAIL      PASS         N/A              -> no fire
 *   Arm-swing trough (<80ms)  FAIL      ---          N/A              -> no fire
 *   Stumble + recover         PASS      PASS         FAIL (resumes)   -> no fire
 *   Genuine fall              PASS      PASS         PASS             -> FIRE
 */
#include "fall_detect.h"

#include <math.h>

/* ===========================================================================
 * fall_reset  --  unconditional state machine reset
 *
 * Zeros all phase counters and clears the cached peak impact reading.  Must
 * be called on startup before the first fall_push() invocation.  Also called
 * internally after:
 *   - A confirmed fall (single-fire guarantee).
 *   - A free-fall interval that was too short (< ff_min samples).
 *   - The impact window expiring without detecting an impact.
 *   - The post-impact window timing out without settling.
 * =========================================================================== */
void fall_reset(struct fall_state *st)
{
	st->phase       = FALL_PHASE_NORMAL;
	st->ff_count    = 0;
	st->wait_count  = 0;
	st->post_count  = 0;
	st->still_count = 0;
	st->impact_g    = 0.0f;
}

/* ===========================================================================
 * fall_is_armed  --  query whether a fall sequence is in progress
 *
 * Returns true in FREEFALL, WAIT_IMPACT, or POST_IMPACT.  Useful for:
 *   - Telemetry: flag raw samples for closer review during a potential fall.
 *   - Unit tests: assert the state machine entered the expected phase without
 *     having to synthesise a complete three-phase stimulus.
 *   - Power management: suppress deep sleep while a fall may be in progress.
 * =========================================================================== */
bool fall_is_armed(const struct fall_state *st)
{
	return st->phase != FALL_PHASE_NORMAL;
}

/* ===========================================================================
 * fall_push  --  feed one accel-magnitude sample; advance the state machine
 *
 * @param amag_g       Euclidean magnitude of the accelerometer vector in g.
 *                     Caller computes: sqrtf(ax*ax + ay*ay + az*az).
 * @param sr_hz        Sample rate in Hz.  All phase windows are derived from
 *                     this value at call time; it may change between windows.
 * @param impact_g_out Optional.  On a confirmed fall, receives the peak |a|
 *                     recorded during the POST_IMPACT phase.  May be NULL.
 * @return             true exactly once per confirmed fall, false otherwise.
 *
 * Detailed phase transition notes
 * --------------------------------
 *
 * NORMAL → FREEFALL
 *   Any sample with amag_g < FALL_FREEFALL_G (0.5 g) triggers the
 *   free-fall phase.  0.5 g is above true weightlessness (0 g ideal) to
 *   tolerate sensor noise and soft falls from low heights.  ff_count is
 *   initialised to 1 because this first sample already qualifies.
 *
 * FREEFALL: accumulate or abort
 *   Samples below 0.5 g continue to increment ff_count.
 *   On the first sample that rises above 0.5 g:
 *     - ff_count < ff_min  : the excursion was too short to be a real fall
 *       (e.g. an arm-swing trough briefly grazes <0.5 g, typically < 50 ms).
 *       Reset to NORMAL without alerting the caller.
 *     - ff_count >= ff_min : valid free-fall ended.  Transition to
 *       WAIT_IMPACT.  The rising sample is tested immediately for impact
 *       because the impact can arrive on the very first post-freefall sample
 *       (zero-latency hard landing on a rigid floor).
 *
 * WAIT_IMPACT: search for the impact spike
 *   Increment wait_count each sample.  Accept any sample above FALL_IMPACT_G
 *   (2.5 g) as the impact; enter POST_IMPACT.  If wait_count exceeds
 *   impact_win (~300 ms) with no impact: the free-fall was real but the
 *   person may have landed on an extremely soft surface.  Reset to NORMAL
 *   (no confirmed fall -- the post-fall injury risk is low anyway).
 *
 * POST_IMPACT: wait for the body to settle
 *   - Track the running peak impact (impact_g) across all samples in this
 *     phase; a body can bounce, causing several high-g spikes.
 *   - Count consecutive samples within 0.3 g of 1 g (the still-on-ground
 *     condition) as "still".  The 0.3 g tolerance accepts minor breathing
 *     motion and sensor vibration.  Any sample outside the band resets the
 *     still_count (rolling, convulsing, rescuer moving the subject).
 *   - still_count >= still_min (~1 s): confirmed fall.  Write the peak
 *     impact to *impact_g_out, call fall_reset() (single-fire), return true.
 *   - post_count > post_max (~3 s): person never settled.  Reset silently;
 *     the caller gets no notification (device may have been dropped and is
 *     vibrating on a surface, or the subject recovered dynamically).
 * =========================================================================== */
bool fall_push(struct fall_state *st, float amag_g, float sr_hz, float *impact_g_out)
{
	/* Phase windows in samples, derived from the sample rate.  All constants
	 * are inline so the compiler can constant-fold when sr_hz is a literal. */
	const uint16_t ff_min     = (uint16_t)(0.08f * sr_hz); /* >= ~80 ms free-fall */
	const uint16_t impact_win = (uint16_t)(0.30f * sr_hz); /* impact within ~300 ms */
	const uint16_t still_min  = (uint16_t)(1.00f * sr_hz); /* ~1 s stillness */
	const uint16_t post_max   = (uint16_t)(3.00f * sr_hz); /* give up after ~3 s */

	switch (st->phase) {
	/* ---------------------------------------------------------------------- */
	case FALL_PHASE_NORMAL:
		/* Enter the free-fall phase on the first below-threshold sample.
		 * Initialise ff_count to 1: this sample already counts toward ff_min. */
		if (amag_g < FALL_FREEFALL_G) {
			st->phase    = FALL_PHASE_FREEFALL;
			st->ff_count = 1;
		}
		break;

	/* ---------------------------------------------------------------------- */
	case FALL_PHASE_FREEFALL:
		if (amag_g < FALL_FREEFALL_G) {
			/* Still in potential free-fall: count this sample. */
			st->ff_count++;
		} else if (st->ff_count >= ff_min) {
			/* Valid free-fall ended; look for the impact. */
			st->phase      = FALL_PHASE_WAIT_IMPACT;
			st->wait_count = 0;
			st->impact_g   = 0.0f;
			/* This same sample may already be the impact.
			 * Test it now so a zero-latency hard landing is not missed. */
			if (amag_g > FALL_IMPACT_G) {
				st->impact_g    = amag_g;
				st->phase       = FALL_PHASE_POST_IMPACT;
				st->post_count  = 0;
				st->still_count = 0;
			}
		} else {
			st->phase = FALL_PHASE_NORMAL; /* free-fall too short */
		}
		break;

	/* ---------------------------------------------------------------------- */
	case FALL_PHASE_WAIT_IMPACT:
		st->wait_count++;
		if (amag_g > FALL_IMPACT_G) {
			/* Impact detected: record the initial peak, start the post-impact
			 * stillness measurement. */
			st->impact_g    = amag_g;
			st->phase       = FALL_PHASE_POST_IMPACT;
			st->post_count  = 0;
			st->still_count = 0;
		} else if (st->wait_count > impact_win) {
			st->phase = FALL_PHASE_NORMAL; /* no impact after free-fall */
		}
		break;

	/* ---------------------------------------------------------------------- */
	case FALL_PHASE_POST_IMPACT:
		st->post_count++;
		/* Track the peak impact force: report the worst spike across any
		 * bounces or secondary impacts during the post-impact window. */
		if (amag_g > st->impact_g) {
			st->impact_g = amag_g; /* track the spike peak. */
		}
		/* Count consecutive near-1g samples as "settled on the ground".
		 * |amag_g - 1.0| < 0.3 means gravity dominates the reading.
		 * Any sample outside that band resets the counter (person rolling,
		 * rescuer picking them up, or convulsion). */
		if (fabsf(amag_g - 1.0f) < 0.3f) {
			st->still_count++;
		} else {
			st->still_count = 0;
		}
		if (st->still_count >= still_min) {
			/* CONFIRMED FALL.  Capture peak, self-reset, return true.
			 * fall_reset() must be called before returning so subsequent
			 * samples go to NORMAL (single-fire guarantee). */
			float impact = st->impact_g;
			fall_reset(st);
			if (impact_g_out != NULL) {
				*impact_g_out = impact;
			}
			return true; /* confirmed fall */
		}
		if (st->post_count > post_max) {
			fall_reset(st); /* never settled -> not a fall */
		}
		break;
	}
	return false;
}
```

## src/fall_detect.h
```c
/*
 * Copyright 2026 Alp Lab AB
 * SPDX-License-Identifier: Apache-2.0
 *
 * fall_detect -- pure-C 3-phase fall detector (free-fall -> impact ->
 * post-impact stillness) as a per-sample state machine.  Rule-based, no model
 * (well-understood physics).  Arch-neutral; host-unit-tested.
 *
 * Quick reference -- call sequence:
 *
 *   struct fall_state fs;
 *   fall_reset(&fs);                // once at startup
 *
 *   // per-sample loop at sr_hz:
 *   float amag_g = sqrtf(ax*ax + ay*ay + az*az);
 *   float peak;
 *   if (fall_push(&fs, amag_g, MOT_SR_HZ, &peak)) {
 *       // confirmed fall; peak holds the max |a| during impact phase
 *       alert_caregiver(peak);
 *   }
 *
 * Three-phase summary:
 *   Phase 1 FREEFALL    : |a| < 0.5 g for >= ~80 ms
 *   Phase 2 WAIT_IMPACT : |a| > 2.5 g within ~300 ms after free-fall
 *   Phase 3 POST_IMPACT : near-1g stillness for >= ~1 s
 * All time windows scale with the sr_hz argument to fall_push().
 */
#ifndef FALL_DETECT_H
#define FALL_DETECT_H

#include <stdbool.h>
#include <stddef.h>
#include <stdint.h>

#ifdef __cplusplus
extern "C" {
#endif

/* ---------------------------------------------------------------------------
 * Threshold constants
 *
 * FALL_FREEFALL_G : upper bound of |a| during genuine free-fall.  0.5 g is
 *   above true weightlessness (0 g ideal) to tolerate sensor noise and soft
 *   falls from low heights.
 * FALL_IMPACT_G   : lower bound of |a| that constitutes a hard impact.  2.5 g
 *   is above the peak of a normal heel-strike (~2 g) but below typical fall
 *   impacts (3--8 g onto a hard floor).
 * --------------------------------------------------------------------------- */
#define FALL_FREEFALL_G 0.5f /**< |a| below this = free-fall. */
#define FALL_IMPACT_G   2.5f /**< |a| above this = impact. */

/* ---------------------------------------------------------------------------
 * State machine types
 * --------------------------------------------------------------------------- */

/*
 * Phases of the fall detector.  The machine starts and returns to NORMAL;
 * the other three phases represent an in-progress potential fall sequence.
 * FREEFALL and WAIT_IMPACT are transient; POST_IMPACT can last up to ~3 s.
 */
enum fall_phase {
	FALL_PHASE_NORMAL = 0,  /**< no fall candidate in progress. */
	FALL_PHASE_FREEFALL,    /**< accumulating below-0.5g samples. */
	FALL_PHASE_WAIT_IMPACT, /**< free-fall ended; waiting for impact spike. */
	FALL_PHASE_POST_IMPACT, /**< impact seen; waiting for post-fall stillness. */
};

/** Per-instance state for one fall detector.  Initialise with fall_reset(). */
struct fall_state {
	enum fall_phase phase;
	uint16_t        ff_count;    /**< consecutive free-fall samples. */
	uint16_t        wait_count;  /**< samples since free-fall ended. */
	uint16_t        post_count;  /**< samples since impact. */
	uint16_t        still_count; /**< consecutive near-1g samples. */
	float           impact_g;    /**< peak |a| seen during POST_IMPACT. */
};

/* ---------------------------------------------------------------------------
 * API
 * --------------------------------------------------------------------------- */

/** Reset all counters and return the detector to FALL_PHASE_NORMAL.
 *  Call once at startup and after any sensor reconfiguration. */
void fall_reset(struct fall_state *st);

/**
 * Feed one accel-magnitude sample (g).  Returns true exactly on the sample
 * that confirms a fall (free-fall >= ~80 ms -> impact > FALL_IMPACT_G within
 * ~300 ms -> post-impact stillness ~1 s), writing the peak impact to
 * @p impact_g_out (may be NULL).  Self-resets after a confirmed fall or a
 * phase timeout.  @p sr_hz sets all sample-count windows; pass MOT_SR_HZ
 * for the standard 100 Hz configuration.
 */
bool fall_push(struct fall_state *st, float amag_g, float sr_hz, float *impact_g_out);

/** True when a free-fall/impact sequence is in progress (phase != NORMAL).
 *  Useful for telemetry, power management, and unit-test assertions. */
bool fall_is_armed(const struct fall_state *st);

#ifdef __cplusplus
}
#endif

#endif /* FALL_DETECT_H */
```

## src/motion_features.c
```c
/*
 * Copyright 2026 Alp Lab AB
 * SPDX-License-Identifier: Apache-2.0
 *
 * motion_features implementation -- see motion_features.h.
 *
 * This file implements the windowed IMU feature extraction pipeline used by the
 * wearable activity-recognition + fall-detection example.  It builds identically
 * for native_sim and Cortex-M55.  Read this file alongside motion_features.h.
 *
 * Pipeline overview (one 2.56 s window at 100 Hz = 256 samples):
 *
 *   raw IMU samples  (ax, ay, az g;  gx, gy, gz deg/s)
 *       |
 *       v
 *   mot_window_push()   -- append samples until the ring is full
 *       |
 *       v
 *   mot_feat_extract()  -- compute the MOT_FEATURE_DIM = 12 features:
 *       |
 *       +-- a_rms[3]      per-axis accel AC RMS          (vibration per axis)
 *       +-- g_rms[3]      per-axis gyro  AC RMS          (rotation rate per axis)
 *       +-- amag_rms      accel-magnitude AC RMS          (overall motion level)
 *       +-- gmag_rms      gyro-magnitude  AC RMS          (overall rotation level)
 *       +-- sma           signal-magnitude area           (total accel energy)
 *       +-- dom_freq_hz   dominant FFT bin of |a|         (step / stride cadence)
 *       +-- jerk_rms      RMS of d|a|/dt                  (impact sharpness)
 *       +-- tilt_deg      tilt of the mean gravity vector  (body orientation)
 *       |
 *       v
 *   mot_feat_pack()     -- flatten to float[12] for the AI model input tensor
 *       |
 *       v
 *   model inference  OR  mot_activity_fallback()  (when no model is loaded)
 *
 * SPECTRAL + STATISTICAL MATH -- via <alp/dsp.h>, not hand-rolled.
 * ---------------------------------------------------------------
 * This example does NOT re-derive an FFT or the mean/RMS/peak statistics
 * by hand, and it does NOT call CMSIS-DSP arm_* directly.  Both go through
 * the portable <alp/dsp.h> surface, so the SAME source builds for
 * native_sim and the Cortex-M55 alike and the SDK -- not the app --
 * owns the CMSIS-vs-portable choice:
 *
 *   1. FFT -> alp_dsp_chain (ALP_DSP_STAGE_FFT).  The backend runs
 *      CMSIS-DSP arm_rfft_fast_f32 (Helium-vectorised) on the M55, a
 *      hardware DSP block where the SoM has one, and a portable-C radix-2
 *      fallback under native_sim -- selected by the backend registry.
 *
 *   2. The |a| / |gyro| magnitude-series statistics (mean, AC RMS,
 *      abs-peak) and the jerk RMS -> alp_dsp_stats_f32, which the SDK
 *      backs with CMSIS-DSP arm_mean/rms/absmax_f32 on Cortex-M and a
 *      portable-C pass elsewhere.  The per-axis accel/gyro AC RMS and the
 *      SMA stay portable loops (see the comments at their call sites)
 *      because the IMU sample buffer is array-of-structs, not a
 *      stride-1 layout a stats call can consume directly.
 */
#include "motion_features.h"

#include <math.h>
#include <string.h>

#ifndef M_PI
#define M_PI 3.14159265358979323846
#endif

#include <alp/dsp.h>

/* ===========================================================================
 * Window management
 *
 * The window is a fixed-length linear buffer of MOT_WINDOW_N IMU samples.
 * mot_window_push() appends samples one at a time; mot_window_full() signals
 * the caller to drain the window by calling mot_feat_extract() and then
 * mot_window_reset() before pushing the next batch.
 *
 * Overlapping windows (stride < MOT_WINDOW_N) are not built into this API
 * but can be achieved by the caller: copy the last (MOT_WINDOW_N - stride)
 * samples into a fresh mot_window_state before resetting.
 * =========================================================================== */

void mot_window_reset(struct mot_window_state *st)
{
	st->count = 0;
}

void mot_window_push(struct mot_window_state *st, struct mot_sample s)
{
	/* Silently drop samples that arrive after the buffer is full.  The
	 * caller is responsible for checking mot_window_full() and resetting
	 * before pushing the next window's samples. */
	if (st->count < MOT_WINDOW_N) {
		st->s[st->count++] = s;
	}
}

bool mot_window_full(const struct mot_window_state *st)
{
	return st->count >= MOT_WINDOW_N;
}

/* ===========================================================================
 * Feature extraction  --  mot_feat_extract()
 *
 * Computes all MOT_FEATURE_DIM = 12 features from a single filled window.
 * All features are dimensionally consistent: accel in g, gyro in deg/s,
 * frequency in Hz, angle in degrees.
 *
 * ---------------------------------------------------------------------------
 * AC (alternating-current) RMS
 * ---------------------------------------------------------------------------
 * "AC RMS" is the RMS of the mean-removed signal.  For a discrete signal x[i]
 * of length N:
 *
 *   mu   = (1/N) * sum_{i} x[i]          (DC mean)
 *   AC_RMS = sqrt( (1/N) * sum_{i} (x[i] - mu)^2 )
 *
 * Removing the DC mean isolates the dynamic (vibrational) component.
 * Gravity contributes ~1 g on the dominant accel axis; without DC removal
 * that constant term dominates and masks the small differences in vibration
 * intensity between walking (~0.2 g RMS) and running (~0.6 g RMS).
 *
 * ---------------------------------------------------------------------------
 * Signal-magnitude area (SMA)
 * ---------------------------------------------------------------------------
 * SMA = (1/N) * sum_{i} ( |ax[i]| + |ay[i]| + |az[i]| )
 *
 * SMA is the per-sample mean of the L1 norm of the accel vector.  It does
 * NOT subtract the mean, so gravity contributes ~1 g at rest.  This makes it
 * a simple but effective rest/active discriminator:
 *   resting      : SMA ≈ 1 g  (gravity only)
 *   walking      : SMA ≈ 1.2--1.5 g
 *   running      : SMA ≈ 1.8--2.5 g
 *   free-fall    : SMA → 0 g
 *
 * Dividing by N normalises across partial and full windows.  Left as a
 * portable loop: it combines three strided (array-of-structs) fields per
 * sample, which is not a shape a CMSIS elementwise kernel can consume.
 *
 * ---------------------------------------------------------------------------
 * Jerk RMS
 * ---------------------------------------------------------------------------
 * Jerk = d|a|/dt  (rate of change of acceleration magnitude).
 * Approximated as the first backward difference of the amag series scaled to
 * physical units by multiplying by sr_hz:
 *
 *   jerk[i] = ( amag[i] - amag[i-1] ) * sr_hz      (units: g/s)
 *
 *   jerk_rms = sqrt( (1/(N-1)) * sum_{i=1}^{N-1} jerk[i]^2 )
 *
 * amag[] is a contiguous time series, so the backward difference is a
 * plain portable loop (alp_dsp.h has no offset/sub/scale kernel to wrap),
 * and the RMS of the resulting jerk[] array goes through alp_dsp_stats_f32.
 * Scaling by sr_hz converts from "g per sample" to "g per second", making
 * the value sample-rate-independent so models trained at one sr_hz transfer
 * to another.  High jerk_rms indicates sharp, impulsive motion:
 *   walking      : moderate (~0.5 g/s)
 *   running      : elevated (~2 g/s, heel-strike spikes)
 *   fall impact  : very high (can exceed 10 g/s)
 *
 * ---------------------------------------------------------------------------
 * Tilt from vertical
 * ---------------------------------------------------------------------------
 * When motion is slow relative to gravity, the window-mean accel vector
 * approximates the gravity direction.  The tilt angle between that vector
 * and the device's Z-axis:
 *
 *   tilt = atan2( sqrt(mean_ax^2 + mean_ay^2), mean_az ) * 180/pi
 *
 * atan2 handles all quadrants and avoids division-by-zero when mean_az ≈ 0.
 * Example: device flat on a table → tilt ≈ 0°; worn on the side of the
 * wrist → tilt ≈ 90°.  The AI model uses tilt as a weak posture cue.  A
 * single atan2 call has no vector shape for CMSIS to accelerate, so it
 * stays a plain scalar expression.
 *
 * ---------------------------------------------------------------------------
 * Dominant cadence frequency via FFT
 * ---------------------------------------------------------------------------
 * Walking/running produces a nearly periodic oscillation in the accel
 * magnitude |a| at the step cadence (the "footfall frequency"):
 *   walking : ~1.5--2.5 Hz (doubles if two steps per oscillation)
 *   running : ~2.5--4.0 Hz
 *   cycling : ~1.0--1.5 Hz (pedal rate, not step rate)
 *
 * Frequency resolution:  delta_f = sr_hz / N = 100 / 256 ≈ 0.39 Hz/bin.
 * Nyquist limit:         f_max   = sr_hz / 2 = 50 Hz  (bin N/2-1 = 127).
 * Bin 0 is DC (suppressed by mean removal, explicitly skipped).
 * Negative-frequency bins (k >= N/2) mirror the positive bins for real input;
 * only bins 1..N/2-1 carry independent spectral information.  See the
 * "SPECTRUM" comment at the FFT call site below for how the transform itself
 * is obtained.
 * =========================================================================== */
void mot_feat_extract(const struct mot_window_state *st, float sr_hz, struct mot_features *out)
{
	const int n = (st->count < MOT_WINDOW_N) ? st->count : MOT_WINDOW_N;

	memset(out, 0, sizeof(*out));
	if (n <= 0) {
		return;
	}

	/*
	 * PASS A -- per-axis raw sums, |a| and |gyro| magnitude series, SMA.
	 *
	 * amag[i]/gmag[i] : Euclidean magnitude of sample i's accel/gyro vector.
	 *   These end up as CONTIGUOUS time series (unlike the raw AoS sample
	 *   buffer), which is exactly the shape the CMSIS-DSP mean/RMS kernels
	 *   below want -- that is why the per-sample combine of 3 strided
	 *   fields happens once here instead of being folded into each stat.
	 * mean_a[]/mean_g[] : running sums of the strided per-axis fields,
	 *   divided below.  Kept as a portable loop: CMSIS-DSP kernels require
	 *   stride-1 arrays, and the IMU sample buffer is array-of-structs
	 *   (ax,ay,az,gx,gy,gz interleaved per sample) -- deinterleaving 6
	 *   channels into 6 scratch buffers just to call arm_mean_f32 would
	 *   cost more (extra O(N) copies + 6 * MOT_WINDOW_N * 4B of static RAM)
	 *   than the 3-element running sum it would replace.
	 */
	float        mean_a[3] = { 0, 0, 0 }, mean_g[3] = { 0, 0, 0 };
	static float amag[MOT_WINDOW_N];
	static float gmag[MOT_WINDOW_N];
	float        sma = 0.0f;
	for (int i = 0; i < n; i++) {
		const struct mot_sample *s = &st->s[i];
		mean_a[0] += s->ax;
		mean_a[1] += s->ay;
		mean_a[2] += s->az;
		mean_g[0] += s->gx;
		mean_g[1] += s->gy;
		mean_g[2] += s->gz;
		amag[i] = sqrtf(s->ax * s->ax + s->ay * s->ay + s->az * s->az);
		gmag[i] = sqrtf(s->gx * s->gx + s->gy * s->gy + s->gz * s->gz);
		/* SMA numerator: L1 norm of the raw accel vector (gravity included). */
		sma += fabsf(s->ax) + fabsf(s->ay) + fabsf(s->az);
	}
	for (int k = 0; k < 3; k++) {
		mean_a[k] /= (float)n;
		mean_g[k] /= (float)n;
	}
	/* Normalise SMA to a per-sample mean (window-length independent). */
	out->sma = sma / (float)n;

	/*
	 * PASS B -- per-axis accel/gyro AC RMS.  Stays a portable loop for the
	 * same array-of-structs reason as mean_a[]/mean_g[] above: da[]/dg[]
	 * are 3-element per-sample vectors carved out of strided fields, not
	 * contiguous arrays a CMSIS elementwise kernel can walk.
	 */
	float sa[3] = { 0, 0, 0 }, sg[3] = { 0, 0, 0 };
	for (int i = 0; i < n; i++) {
		const struct mot_sample *s = &st->s[i];
		float da[3]                = { s->ax - mean_a[0], s->ay - mean_a[1], s->az - mean_a[2] };
		float dg[3]                = { s->gx - mean_g[0], s->gy - mean_g[1], s->gz - mean_g[2] };
		for (int k = 0; k < 3; k++) {
			sa[k] += da[k] * da[k];
			sg[k] += dg[k] * dg[k];
		}
	}
	for (int k = 0; k < 3; k++) {
		out->a_rms[k] = sqrtf(sa[k] / (float)n);
		out->g_rms[k] = sqrtf(sg[k] / (float)n);
	}

	/*
	 * |a| / |gyro| magnitude-series stats + jerk RMS -- via alp_dsp_stats_f32.
	 * ------------------------------------------------------------------------
	 * amag[]/gmag[] are contiguous, stride-1 float arrays (built in pass A
	 * above).  One alp_dsp_stats_f32 pass over each raw buffer yields the
	 * mean; mean-centring is a plain portable loop (alp_dsp.h has no
	 * offset kernel to wrap); a second alp_dsp_stats_f32 pass over the
	 * centred buffers yields the AC (vibration) RMS and, for amag_ac,
	 * the abs-peak used to scale the FFT input below.  The SDK backs
	 * alp_dsp_stats_f32 with CMSIS-DSP arm_mean/rms/absmax_f32 on the M55
	 * and a portable-C pass under native_sim -- no arm_* here.
	 * amag_ac[] doubles as the mean-centred series fed to the FFT below
	 * (zero-padded past n).
	 */
	static float amag_ac[MOT_WINDOW_N];
	static float gmag_ac[MOT_WINDOW_N];
	static float jerk[MOT_WINDOW_N];

	alp_dsp_stats_t raw_amag, raw_gmag;
	alp_dsp_stats_f32(amag, (size_t)n, &raw_amag);
	alp_dsp_stats_f32(gmag, (size_t)n, &raw_gmag);
	for (int i = 0; i < n; i++) {
		amag_ac[i] = amag[i] - raw_amag.mean;
		gmag_ac[i] = gmag[i] - raw_gmag.mean;
	}

	alp_dsp_stats_t ac_amag, ac_gmag;
	alp_dsp_stats_f32(amag_ac, (size_t)n, &ac_amag);
	alp_dsp_stats_f32(gmag_ac, (size_t)n, &ac_gmag);
	out->amag_rms = ac_amag.rms;
	out->gmag_rms = ac_gmag.rms;
	float peak    = ac_amag.abs_max; /* peak |amag_ac|; scales the FFT input below */

	if (n > 1) {
		/* jerk[k] = (amag[k+1] - amag[k]) * sr_hz -- backward difference,
		 * converted from "g per sample" to "g per second". */
		for (int i = 1; i < n; i++) {
			jerk[i - 1] = (amag[i] - amag[i - 1]) * sr_hz;
		}
		alp_dsp_stats_t jerk_stats;
		alp_dsp_stats_f32(jerk, (size_t)(n - 1), &jerk_stats);
		out->jerk_rms = jerk_stats.rms;
	} else {
		out->jerk_rms = 0.0f;
	}
	for (int i = n; i < MOT_WINDOW_N; i++) {
		amag_ac[i] = 0.0f; /* zero-pad the FFT tail on a short window */
	}

	/* ---- Tilt of the mean accel vector from vertical (Z) ------------------ */
	/*
	 * The horizontal component of the mean gravity vector is the L2 norm of
	 * (mean_ax, mean_ay).  atan2 gives the angle from the Z-axis in [0, pi].
	 * For Z-up mounting: tilt ≈ 0° when flat, ≈ 90° when upright.
	 */
	out->tilt_deg = atan2f(sqrtf(mean_a[0] * mean_a[0] + mean_a[1] * mean_a[1]), mean_a[2]) *
	                180.0f / (float)M_PI;

	/*
	 * SPECTRUM via the portable <alp/dsp.h> chain (NOT a hand-rolled FFT).
	 * ------------------------------------------------------------------
	 * A single ALP_DSP_STAGE_FFT (rectangular, no window) transforms the
	 * mean-centred |a| series to magnitude bins.  The backend runs CMSIS-DSP
	 * arm_rfft_fast_f32 on the M55 and a portable-C radix-2 FFT under
	 * native_sim -- the example source is identical either way.
	 *
	 * The chain consumes int16 samples (the accelerometer's native ADC
	 * format).  We scale the float amag_ac[] window to fill the int16 range
	 * before feeding it: the absolute scale is irrelevant here because
	 * dom_freq_hz is derived from an argmax over the output bins, which is
	 * scale-invariant.
	 */
	static int16_t samp_q15[MOT_WINDOW_N];
	float          scale = (peak > 1e-9f) ? (30000.0f / peak) : 0.0f;
	for (int i = 0; i < MOT_WINDOW_N; i++) {
		samp_q15[i] = (int16_t)lrintf(amag_ac[i] * scale);
	}

	static float    mag[MOT_WINDOW_N];
	alp_dsp_stage_t stages[] = {
		{ .kind  = ALP_DSP_STAGE_FFT,
		  .u.fft = { .n_points = MOT_WINDOW_N, .output_format = ALP_DSP_FFT_OUTPUT_MAGNITUDE } },
	};
	alp_dsp_chain_t *chain = alp_dsp_chain_open(stages, 1u);
	size_t           got   = 0;
	memset(mag, 0, sizeof(mag));
	if (chain != NULL) {
		(void)alp_dsp_chain_apply_bins(chain, samp_q15, MOT_WINDOW_N, mag, MOT_WINDOW_N, &got);
		alp_dsp_chain_close(chain);
	}

	/*
	 * DOMINANT FREQUENCY BIN
	 * ----------------------
	 * The search starts at k = 1 to skip bin 0 (DC); even after mean
	 * removal a floating-point residual can linger there, and the relevant
	 * cadence content always starts at k >= 1.  Comparing magnitude
	 * directly (rather than magnitude-squared) is equivalent for an argmax
	 * -- both are monotonic in the true spectral amplitude -- so no squaring
	 * step is needed here.
	 */
	const int half    = MOT_WINDOW_N / 2;
	int       dom_bin = 1;
	float     dom_val = -1.0f;
	for (int k = 1; k < half; k++) {
		if (mag[k] > dom_val) {
			dom_val = mag[k];
			dom_bin = k;
		}
	}
	/* Convert bin index to physical frequency: f = k * sr_hz / N. */
	out->dom_freq_hz = (float)dom_bin * sr_hz / (float)MOT_WINDOW_N;
}

/* ===========================================================================
 * Feature packing  --  mot_feat_pack()
 *
 * Flattens the struct mot_features into a contiguous float array in a fixed,
 * documented order that MUST match the AI model's expected input layout:
 *
 *   indices [0..2]   a_rms[0..2]   per-axis accel AC RMS  (x, y, z)
 *   indices [3..5]   g_rms[0..2]   per-axis gyro  AC RMS  (x, y, z)
 *   index   [6]      amag_rms
 *   index   [7]      gmag_rms
 *   index   [8]      sma
 *   index   [9]      dom_freq_hz
 *   index   [10]     jerk_rms
 *   index   [11]     tilt_deg
 *
 * This explicit packing order is intentional: the model was trained with this
 * exact feature ordering, so even if the struct fields are reordered in the
 * future the model receives the correct feature in each slot.
 *
 * Returns MOT_FEATURE_DIM (= 12) on success, 0 if cap < MOT_FEATURE_DIM.
 * =========================================================================== */
size_t mot_feat_pack(const struct mot_features *f, float *vec, size_t cap)
{
	if (cap < (size_t)MOT_FEATURE_DIM) {
		return 0;
	}
	size_t i = 0;
	for (int k = 0; k < 3; k++) {
		vec[i++] = f->a_rms[k];
	}
	for (int k = 0; k < 3; k++) {
		vec[i++] = f->g_rms[k];
	}
	vec[i++] = f->amag_rms;
	vec[i++] = f->gmag_rms;
	vec[i++] = f->sma;
	vec[i++] = f->dom_freq_hz;
	vec[i++] = f->jerk_rms;
	vec[i++] = f->tilt_deg;
	return i; /* == MOT_FEATURE_DIM */
}

/* ===========================================================================
 * Deterministic activity fallback classifier  --  mot_activity_fallback()
 *
 * Used when no AI model is loaded (battery save, first boot, unsupported HW).
 * Applies hand-tuned thresholds on two highly discriminative features:
 *
 *   amag_rms     -- dynamic motion level (gravity removed by AC RMS)
 *   dom_freq_hz  -- step cadence peak from the FFT
 *
 * Decision logic
 * --------------
 * 1.  amag_rms < 0.05 g  →  IDLE  (confidence 0.80)
 *     The AC component is nearly zero.  The person is sitting, standing still,
 *     sleeping, or the device is lying on a desk.  The 0.05 g threshold is
 *     above typical accelerometer noise floors (~0.01 g RMS) with margin.
 *
 * 2.  dom_freq_hz > 2.5 Hz  AND  amag_rms > 0.6 g  →  RUN  (confidence = amag_rms, capped 1.0)
 *     High cadence AND high vibration amplitude together identify running.
 *     Why both gates?
 *       - amag_rms alone: cycling over a rough road can reach 0.6 g without
 *         the leg-cadence periodicity signature.
 *       - dom_freq_hz alone: a slow metronome tap can hit 3 Hz with low energy.
 *     Together they tightly identify the heel-strike + push-off impact cycle
 *     of running.  Confidence is proportional to amag_rms because a clearer
 *     signal (higher magnitude) means less ambiguity.
 *
 * 3.  Otherwise  →  WALK  (confidence 0.70)
 *     Moving but not meeting the RUN criteria.  This bucket covers:
 *       - Normal walking  (cadence 1.5--2.5 Hz, amag_rms 0.1--0.5 g)
 *       - Brisk walk / slow jog boundary
 *       - STAIRS  (see explanation below)
 *
 * Why STAIRS always maps to WALK in the fallback
 * -----------------------------------------------
 * STAIRS is a distinct class because the trained model learns:
 *   - Subtle step-to-step asymmetry in the |a| waveform (longer push phase
 *     when lifting the body vs. stepping down on descent).
 *   - Cadence variation that differs from flat-surface walking.
 *   - Jerk pattern: stair descent has a harder heel-impact spike.
 *   - Altitude gain/loss -- which the accelerometer cannot resolve without
 *     a barometer.
 *
 * The pure-inertial fallback has none of those cues:
 *   - Stair cadence (≈ 1.2--2.0 Hz) overlaps walking cadence completely.
 *   - amag_rms on stairs overlaps the walking range.
 *
 * Silently mapping STAIRS → WALK is the correct safe default: the activity
 * is detected as "active, not running" which is accurate enough for step
 * counting and calorie estimation (stride length differs ~10%, not a
 * health-critical discrepancy).  The model comment in motion_features.h
 * documents this design choice for integrators.
 * =========================================================================== */
struct mot_verdict mot_activity_fallback(const struct mot_features *f)
{
	struct mot_verdict v = { ACT_IDLE, 0.0f };

	if (f->amag_rms < 0.05f) {
		v.cls        = ACT_IDLE;
		v.confidence = 0.8f;
	} else if (f->dom_freq_hz > 2.5f && f->amag_rms > 0.6f) {
		v.cls        = ACT_RUN;
		v.confidence = fminf(1.0f, f->amag_rms);
	} else {
		/* Moving but not running -> WALK (covers stairs too; the model splits). */
		v.cls        = ACT_WALK;
		v.confidence = 0.7f;
	}
	return v;
}

/* ===========================================================================
 * Activity name lookup  --  mot_activity_name()
 *
 * Returns a stable, NUL-terminated upper-case ASCII string for each activity
 * class.  Used for logging, telemetry records, and on-screen display labels.
 * Returns "UNKNOWN" defensively for any value outside the defined enum range.
 * =========================================================================== */
const char *mot_activity_name(mot_activity_t c)
{
	switch (c) {
	case ACT_IDLE:
		return "IDLE";
	case ACT_WALK:
		return "WALK";
	case ACT_RUN:
		return "RUN";
	case ACT_STAIRS:
		return "STAIRS";
	default:
		return "UNKNOWN";
	}
}
```
