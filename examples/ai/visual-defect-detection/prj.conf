## CMakeLists.txt
```
# SPDX-License-Identifier: Apache-2.0
cmake_minimum_required(VERSION 3.20.0)

# Resolve the alp-sdk root.  In-tree the SDK is the example's
# grandparent directory; out-of-tree customers point ALP_SDK_ROOT
# at their checkout.
if(DEFINED ENV{ALP_SDK_ROOT})
    set(ALP_SDK_ROOT $ENV{ALP_SDK_ROOT})
else()
    get_filename_component(ALP_SDK_ROOT ${CMAKE_CURRENT_SOURCE_DIR}/../../.. ABSOLUTE)
endif()

# PYTHON_EXECUTABLE is only set after find_package(Zephyr);
# we need a Python interpreter at configure time *before*
# that, so resolve one ourselves here.
find_package(Python3 REQUIRED COMPONENTS Interpreter)

execute_process(
    COMMAND ${Python3_EXECUTABLE}
            ${ALP_SDK_ROOT}/scripts/alp_project.py
            --input  ${CMAKE_CURRENT_SOURCE_DIR}/board.yaml
            --output ${CMAKE_CURRENT_BINARY_DIR}/alp.conf
            --emit zephyr-conf --core m55_hp
    RESULT_VARIABLE rc
    OUTPUT_VARIABLE _alp_stdout
    ERROR_VARIABLE  _alp_stderr
)
if(NOT rc EQUAL 0)
    message(FATAL_ERROR
        "alp_project.py failed (rc=${rc}); "
        "check ${CMAKE_CURRENT_SOURCE_DIR}/board.yaml.\n"
        "stderr: ${_alp_stderr}")
endif()
list(APPEND EXTRA_CONF_FILE ${CMAKE_CURRENT_BINARY_DIR}/alp.conf)

find_package(Zephyr REQUIRED HINTS $ENV{ZEPHYR_BASE})
project(visual_defect_detection LANGUAGES C)

target_sources(app PRIVATE
    src/main.c
    src/defect_map.c
)
```

## prj.conf
```kconfig
# SPDX-License-Identifier: Apache-2.0
CONFIG_MAIN_STACK_SIZE=32768

CONFIG_LOG=y
CONFIG_LOG_PRINTK=y
CONFIG_CBPRINTF_FP_SUPPORT=y

# Inference subsystem.
CONFIG_ALP_SDK_INFERENCE_BACKEND_TFLM=y
```

## boards/native_sim_native_64.conf
```kconfig
# SPDX-License-Identifier: Apache-2.0
# native_sim has no CSI camera; main.c detects the open failure and falls back
# to a synthetic frame generator (clean frame + injected-defect frame).
# No display driver is needed (this example has no UI layer), so no
# CONFIG_DUMMY_DISPLAY or overlay is required here.
```

## src/main.c
```c
/*
 * Copyright 2026 Alp Lab AB
 * SPDX-License-Identifier: Apache-2.0
 *
 * visual-defect-detection
 * =======================
 *
 * Camera-fed surface-inspection station.  Pipeline:
 *
 *   CSI camera --RGB565--> defect_downsample_rgb565 --> 64x64 luma grid
 *      |
 *      v
 *   autoencoder (<alp/inference.h>): reconstruct the "normal" surface
 *      |  AI path:  defect_score_recon(input, reconstruction)
 *      |  fallback: defect_score_stat(grid, clean baseline)   [no model]
 *      v
 *   defect_classify -> worst tile (tx,ty), coverage %, severity, PASS/FAIL
 *      --> one DEFECT record per frame.
 *
 * Why unsupervised: an autoencoder trained only on GOOD surface flags any
 * region it cannot reconstruct -- including defect types never seen in
 * training -- so one model needs no defect labels.  See models/README.md.
 *
 * Honest scope: reference inspection logic.  The model is a 1-byte stub, so the
 * deterministic statistical fallback runs here; it scores each tile by how far
 * its {mean,variance,gradient} stray from a clean baseline.  With no camera
 * (native_sim) a synthetic generator yields a clean frame (PASS) and a frame
 * with an injected defect patch (FAIL) so every code path is exercised.
 *
 * Platform targets:
 *   - native_sim/native/64: synthetic frames, CPU inference fallback.
 *   - ensemble_e8_dk/.../rtss_hp: OV5640 CSI camera, on-die NPU.
 *   Flip som.sku in board.yaml to E1M-V2M101 for the V2N accelerator path.
 *
 * ALP_BOARD_E1M_EVK must be defined (testcase.yaml CONFIG_COMPILER_OPT)
 * because <alp/board.h> gates the EVK-specific pin alias table on it.
 */
#include <string.h>
#include <zephyr/kernel.h>
#include <zephyr/logging/log.h>

/* Portable board-alias layer: resolves EVK_I2C_BUS_SENSORS etc. to the
 * active carrier's physical bus.  Must be included before any peripheral
 * open call that references a BOARD_* macro. */
#include "alp/board.h"
/* Camera abstraction: alp_camera_open / capture / release / stop / close.
 * Also pulls in alp/peripheral.h (ALP_PIXFMT_RGB565). */
#include "alp/camera.h"
/* Inference abstraction: alp_inference_open / invoke / get_input / get_output. */
#include "alp/inference.h"

/* defect_map core: downsample, score (recon / stat), classify, name.
 * Arch-neutral (stdint + math only) -- the same object links for both
 * native_sim and M55/A32 targets without any platform-specific changes. */
#include "defect_map.h"

LOG_MODULE_REGISTER(defect, LOG_LEVEL_INF);

/* ── Synthetic-frame geometry (native_sim path) ─────────────────────────────
 * 128x128 RGB565 so the real box-downsample to 64x64 is exercised via the
 * proper 2x-per-axis averaging path in defect_downsample_rgb565, not the
 * trivial 1:1 copy. */
#define SYN_W 128
#define SYN_H 128

/* ── Demo bounds ─────────────────────────────────────────────────────────────
 * Two frames: one clean (PASS expected), one with an injected defect patch
 * (FAIL expected at tile tx=5, ty=3). */
#define N_FRAMES 2

/* ── Statistical-fallback baseline ──────────────────────────────────────────
 * Clean-surface statistics: {mean, variance, gradient-energy} nominal and
 * tolerance.  A tile deviates > tolerance/nominal -> score > 1.0 -> defective.
 * Tune these to the actual production surface under production lighting; the
 * values below are calibrated for the mid-grey synthetic clean frame. */
static const struct defect_baseline BASE = {
	.nominal = { 128.0f, 100.0f, 8.0f },
	.tol     = { 64.0f, 400.0f, 24.0f },
};

/* ── Anomaly threshold ───────────────────────────────────────────────────────
 * A tile is flagged defective when its score is strictly greater than this.
 * With the statistical fallback: score = max(|mean-nom|/tol, ...) per stat,
 * so 1.0 means "one full tolerance band outside nominal".
 * With the AI reconstruction path: score = mean_abs_error / DEFECT_RECON_REF. */
#define DEFECT_THRESHOLD 1.0f

/* ── 1-byte model stub ───────────────────────────────────────────────────────
 * Satisfies alp_inference_open's non-NULL model_data contract while forcing the
 * deterministic statistical fallback (the stub yields no usable tensors).
 * Replace with a compiled autoencoder; see models/README.md.
 * The inspect() guard checks in.size_bytes before trusting the tensor pointer. */
static const uint8_t s_model[] = { 0x00 };

/* ── Inference arena ─────────────────────────────────────────────────────────
 * Kept off the heap and aligned for the NPU/accelerator DMA.  Sized to match
 * default_arena_kib: 256 in board.yaml's inference: block.
 * Must outlive the inference handle (closed in teardown at the end of main). */
static uint8_t s_arena[256 * 1024] __aligned(16);

/* ── Shared working buffers ──────────────────────────────────────────────────
 * s_grid: the 64x64 luma inspection grid (DEFECT_GRID_W * DEFECT_GRID_H bytes).
 * s_syn:  scratch RGB565 frame for the synthetic generator (SYN_W*SYN_H*2 bytes).
 * Both are module-static to avoid stack pressure on the M55's 32 KiB main stack. */
static uint8_t s_grid[DEFECT_GRID_W * DEFECT_GRID_H];
static uint8_t s_syn[SYN_W * SYN_H * 2];

/* ─────────────────────────────────────────────────────────────────────────── */
/* Helper: pack an 8-bit grey value into an RGB565 little-endian pixel pair.   */
/* R[4:0] = v>>3, G[5:0] = v>>2, B[4:0] = v>>3.  Stored little-endian.       */
/* ─────────────────────────────────────────────────────────────────────────── */
static void put_gray(uint8_t *p, uint8_t v)
{
	uint16_t px = (uint16_t)(((v >> 3) << 11) | ((v >> 2) << 5) | (v >> 3));
	p[0]        = (uint8_t)(px & 0xFF);
	p[1]        = (uint8_t)(px >> 8);
}

/*
 * synth_frame -- build a synthetic surface inspection frame into s_syn.
 *
 * frame 0: flat mid-grey (128) -- represents a clean surface.
 *          Expected result: all tile scores below threshold -> PASS.
 *          For a uniform field the gradient statistic is 0; its normalized
 *          deviation |0-8|/24 = ~0.33 is the largest of the three terms and so
 *          becomes the tile's worst score -- still below DEFECT_THRESHOLD = 1.0.
 *
 * frame 1: mid-grey everywhere EXCEPT a 16x16 source patch at columns
 *          80..95, rows 48..63, which is solid bright white (255).
 *          That patch downsamples to grid tile (tx=5, ty=3):
 *            block_w = SYN_W / DEFECT_GRID_W = 128 / 64 = 2 px per grid cell
 *            block_h = SYN_H / DEFECT_GRID_H = 128 / 64 = 2 px per grid cell
 *            grid_x  = src_x / 2 = 80..95 / 2 = 40..47 (gx range)
 *            tile_x  = gx / DEFECT_TILE_W = 40..47 / 8 = 5
 *            grid_y  = src_y / 2 = 48..63 / 2 = 24..31 (gy range)
 *            tile_y  = gy / DEFECT_TILE_H = 24..31 / 8 = 3
 *          After downsampling the 8x8 grid tile (tx=5, ty=3) has luma ≈ 255.
 *          Mean deviation from the clean nominal (128): |255-128|/64 ≈ 1.98,
 *          well above DEFECT_THRESHOLD = 1.0 -> statistical fallback flags FAIL.
 *          Note: a 1-px checkerboard would average to 128 after 2x downsampling
 *          (two 0+255 pairs per block), so a SOLID patch is used here to produce
 *          a clear mean-deviation signal that survives the box average.
 */
static void synth_frame(int frame)
{
	for (int y = 0; y < SYN_H; y++) {
		for (int x = 0; x < SYN_W; x++) {
			uint8_t *p = &s_syn[(y * SYN_W + x) * 2];
			/* Flat mid-grey clean surface everywhere by default. */
			uint8_t v = 128;
			/* Defect frame: a solid bright (255) 16x16 source patch that maps
			 * to exactly one 8x8 grid tile (tx=5, ty=3) after 2x downsampling.
			 * The mean luma shift (255 vs nominal 128) drives score > 1.0 -> FAIL. */
			if (frame == 1 && x >= 80 && x < 96 && y >= 48 && y < 64) {
				v = 255;
			}
			put_gray(p, v);
		}
	}
}

/*
 * inspect -- score one luma grid and fill *res.
 *
 * AI path (a real autoencoder is loaded):
 *   Copy the luma grid into the model's input tensor, invoke the autoencoder,
 *   and call defect_score_recon(input, reconstruction) to get per-tile mean-abs
 *   reconstruction errors.  A tile the model reconstructs poorly = defect.
 *
 * Statistical fallback (stub model, or invoke/get_output fails):
 *   defect_score_stat() computes {mean, variance, gradient-energy} per tile and
 *   compares to BASE.  No model required; works on native_sim with the stub.
 *
 * In both cases defect_classify() thresholds the tile scores and fills *res.
 */
static void inspect(alp_inference_t *inf, const uint8_t *grid, struct defect_result *res)
{
	float tile_scores[DEFECT_TILE_COUNT];
	/* used_ai tracks whether the AI reconstruction path succeeded.
	 * If it fails at any step we fall through to the statistical path. */
	int used_ai = 0;

	if (inf != NULL) {
		/* AI path: fill the input tensor with the luma grid, invoke the
		 * autoencoder, and read the reconstructed grid from the output tensor.
		 * The 1-byte stub has no valid tensor layout, so this guard fails and
		 * the block falls through to the statistical fallback below. */
		alp_inference_tensor_t in  = { 0 };
		alp_inference_tensor_t out = { 0 };
		if (alp_inference_get_input(inf, 0, &in) == ALP_OK && in.data != NULL &&
		    in.size_bytes >= sizeof(s_grid)) {
			memcpy(in.data, grid, sizeof(s_grid));
			if (alp_inference_invoke(inf) == ALP_OK &&
			    alp_inference_get_output(inf, 0, &out) == ALP_OK && out.data != NULL &&
			    out.size_bytes >= sizeof(s_grid)) {
				/* Reconstruction error path: per-tile mean |input - recon|,
				 * normalised by DEFECT_RECON_REF (32 luma levels). */
				defect_score_recon(grid, (const uint8_t *)out.data, tile_scores);
				used_ai = 1;
			}
		}
	}
	if (!used_ai) {
		/* Fallback: classical per-tile statistics vs the clean baseline.
		 * Scores: max normalised deviation across {mean, variance, grad-energy}. */
		defect_score_stat(grid, &BASE, tile_scores);
	}
	/* Threshold tile_scores[], find the worst tile, fill *res. */
	defect_classify(tile_scores, DEFECT_THRESHOLD, res);
}

int main(void)
{
	/* ── Camera open ────────────────────────────────────────────────────────
	 * Request OV5640 at 128x128 RGB565 / 30 fps.  On native_sim there is no
	 * CSI sensor, so alp_camera_open returns NULL; we drive synthetic frames
	 * instead.  The app never calls alp_camera_start / capture on NULL. */
	alp_camera_t *cam = alp_camera_open(&(alp_camera_config_t){
	    .camera_id = 0,
	    .width     = SYN_W,
	    .height    = SYN_H,
	    .fps       = 30,
	    .format    = ALP_PIXFMT_RGB565,
	});
	/* cam_ok gates all subsequent camera operations; NULL is not an error here
	 * (native_sim has no sensor) -- the synthetic path covers that case. */
	int cam_ok = (cam != NULL);
	if (cam_ok) {
		/* Start streaming; tolerate NOSUPPORT (returned on unprobed sensors). */
		(void)alp_camera_start(cam);
	} else {
		LOG_WRN("no camera; inspecting synthetic surface frames");
	}

	/* ── Inference open ─────────────────────────────────────────────────────
	 * ALP_INFERENCE_BACKEND_AUTO routes to the SoM's on-die NPU on real
	 * silicon (AEN / V2N families), or falls
	 * back to TFLM CPU reference kernels on native_sim.  The 1-byte stub
	 * makes this an empty autoencoder -- the statistical path runs instead. */
	alp_inference_t *inf = alp_inference_open(&(alp_inference_config_t){
	    .backend     = ALP_INFERENCE_BACKEND_AUTO,
	    .format      = ALP_INFERENCE_MODEL_TFLITE,
	    .model_data  = s_model,
	    .model_size  = sizeof(s_model),
	    .arena       = s_arena,
	    .arena_bytes = sizeof(s_arena),
	});
	/* NULL inf is tolerated: inspect() will use the statistical fallback. */

	/* ── CSV header ─────────────────────────────────────────────────────────
	 * One fixed header + N_FRAMES data records, each on its own line.
	 * Fields: frame index (1-based), PASS/FAIL, severity [0,1], coverage %,
	 * worst tile column (tx) and row (ty) in [0,7], worst tile score.
	 * The harness regex matches "[defect] done" at the end. */
	printk("# DEFECT,frame,verdict,severity,coverage_pct,worst_tx,worst_ty,worst_score\n");

	for (int f = 0; f < N_FRAMES; f++) {
		/* Obtain a frame: real capture if the camera is present, otherwise
		 * the synthetic generator (frame 0 clean, frame 1 defect patch). */
		const uint8_t     *rgb = NULL;
		uint16_t           w = SYN_W, h = SYN_H;
		alp_camera_frame_t frame = { 0 };
		if (cam_ok && alp_camera_capture(cam, &frame, /*timeout_ms=*/200) == ALP_OK) {
			/* Use the camera-provided frame buffer directly (backend-owned). */
			rgb = (const uint8_t *)frame.data;
			/* Real frames carry their own width/height; keep SYN_W/H defaults
			 * here since the camera was opened at those dimensions. */
		} else {
			/* No camera (native_sim) or capture timed out: use synthetic. */
			synth_frame(f);
			rgb = s_syn;
		}

		/* Downsample the RGB565 frame to the 64x64 luma inspection grid. */
		defect_downsample_rgb565(rgb, w, h, s_grid);

		/* Score + classify the grid, filling the result struct. */
		struct defect_result res;
		inspect(inf, s_grid, &res);

		/* Emit one CSV record per frame to stdout (the twister console harness
		 * waits for "[defect] done" after the last record). */
		printk("DEFECT,%d,%s,%.2f,%.1f,%u,%u,%.2f\n",
		       f + 1,
		       defect_verdict_name(res.verdict),
		       (double)res.severity,
		       (double)res.coverage_pct,
		       (unsigned)res.worst_tx,
		       (unsigned)res.worst_ty,
		       (double)res.worst_score);

		/* Return the camera frame buffer to the backend so it can be reused. */
		if (cam_ok && frame.data != NULL) {
			(void)alp_camera_release(cam, &frame);
		}
	}

	/* ── Lifecycle teardown ─────────────────────────────────────────────────
	 * Close inference handle first (frees tensor arena bookkeeping), then
	 * stop and close the camera (releases DMA descriptors + sensor power).
	 * Reverse of open order: inference opened after camera, closed before it.
	 * NULL handles are safe: alp_inference_close(NULL) is documented no-op. */
	if (inf != NULL) {
		alp_inference_close(inf);
	}
	if (cam_ok) {
		(void)alp_camera_stop(cam);
		alp_camera_close(cam);
	}

	/* Final marker: the twister console harness matches this line.
	 * Keep it as the very last printk so the harness doesn't match early. */
	printk("[defect] done\n");
	return 0;
}
```

## src/defect_map.c
```c
/*
 * Copyright 2026 Alp Lab AB
 * SPDX-License-Identifier: Apache-2.0
 *
 * defect_map implementation -- see defect_map.h.
 *
 * Algorithm overview:
 *   rgb565_to_luma  -- converts one pixel from packed RGB565 to BT.601 luma.
 *   defect_downsample_rgb565 -- box-averages the camera frame onto a 64x64
 *                               luma grid; the grid is the engine's input.
 *   defect_score_recon -- AI path: mean-abs recon error per tile, normalised.
 *   defect_score_stat  -- fallback path: per-tile statistics vs a baseline.
 *   defect_classify    -- maps per-tile scores to a PASS/FAIL verdict.
 */
#include "defect_map.h"

#include <math.h>

/* ---------------------------------------------------------------------------
 * rgb565_to_luma
 *
 * RGB565 little-endian packing (two bytes, [lo][hi]):
 *   bits [15:11] = R5  (5-bit red,   [4:0] of R byte)
 *   bits [10: 5] = G6  (6-bit green, [5:0] of G byte)
 *   bits [ 4: 0] = B5  (5-bit blue,  [4:0] of B byte)
 *
 * Luma (Y) is computed using integer BT.601 weights that sum to 256:
 *   Y = (77*R + 150*G + 29*B) >> 8
 * The channel values are first expanded to the full 0..255 range:
 *   R8 = R5 * 255 / 31,  G8 = G6 * 255 / 63,  B8 = B5 * 255 / 31
 * Pure integer arithmetic; no floating-point needed here.
 * ---------------------------------------------------------------------------
 */
static uint8_t rgb565_to_luma(uint8_t lo, uint8_t hi)
{
	/* Reassemble the 16-bit pixel from the two little-endian bytes. */
	uint16_t px = (uint16_t)lo | ((uint16_t)hi << 8);
	/* Extract each channel at its native width (5/6/5 bits). */
	uint8_t r5 = (uint8_t)((px >> 11) & 0x1F);
	uint8_t g6 = (uint8_t)((px >> 5) & 0x3F);
	uint8_t b5 = (uint8_t)(px & 0x1F);
	/* Expand to 8 bits (x*255/max) -- the *255/31 / *255/63 scalings. */
	uint16_t r8 = (uint16_t)((r5 * 255) / 31);
	uint16_t g8 = (uint16_t)((g6 * 255) / 63);
	uint16_t b8 = (uint16_t)((b5 * 255) / 31);
	/* BT.601 integer luma: sum of weighted channels divided by 256. */
	return (uint8_t)((77 * r8 + 150 * g8 + 29 * b8) >> 8);
}

/* ---------------------------------------------------------------------------
 * defect_downsample_rgb565
 *
 * Maps a camera frame (w x h, RGB565) to DEFECT_GRID_W x DEFECT_GRID_H luma.
 * Each grid cell covers a block of bw x bh source pixels; their lumas are
 * box-averaged (equally weighted mean) to produce one grid byte.
 *
 * Block size calculation:
 *   bw = floor(w / GRID_W),  bh = floor(h / GRID_H)
 *   If w < GRID_W (unusually small source), bw clamps to 1 to avoid zero.
 * Integer-only; a source that is not a multiple of the grid size will have
 * a ragged right/bottom edge that is excluded (clamp inside the loop).
 * ---------------------------------------------------------------------------
 */
void defect_downsample_rgb565(const uint8_t *rgb565, uint16_t w, uint16_t h, uint8_t *grid_luma)
{
	/* Each grid cell averages a w/GRID_W by h/GRID_H block of source pixels.
	 * Integer block sizes; a source smaller than the grid clamps to 1 px. */
	int bw = (w >= DEFECT_GRID_W) ? (w / DEFECT_GRID_W) : 1;
	int bh = (h >= DEFECT_GRID_H) ? (h / DEFECT_GRID_H) : 1;

	/* Outer loops: iterate every cell (gx, gy) of the inspection grid. */
	for (int gy = 0; gy < DEFECT_GRID_H; gy++) {
		for (int gx = 0; gx < DEFECT_GRID_W; gx++) {
			/* Top-left source pixel of this cell's block. */
			int sx0 = gx * bw;
			int sy0 = gy * bh;
			/* Accumulator for the box average.  n counts valid pixels
			 * (some edge blocks may be shorter due to the integer division). */
			uint32_t sum = 0;
			int      n   = 0;
			/* Inner loops: sum luma of every source pixel in the block. */
			for (int dy = 0; dy < bh; dy++) {
				int sy = sy0 + dy;
				if (sy >= h) {
					break; /* clamp: ragged bottom edge */
				}
				for (int dx = 0; dx < bw; dx++) {
					int sx = sx0 + dx;
					if (sx >= w) {
						break; /* clamp: ragged right edge */
					}
					/* 2 bytes per RGB565 pixel, little-endian [lo][hi]. */
					int idx = (sy * w + sx) * 2;
					sum += rgb565_to_luma(rgb565[idx], rgb565[idx + 1]);
					n++;
				}
			}
			/* Write the box average; zero if no pixels fell in bounds. */
			grid_luma[gy * DEFECT_GRID_W + gx] = (uint8_t)(n ? (sum / (uint32_t)n) : 0);
		}
	}
}

/* ---------------------------------------------------------------------------
 * defect_score_recon  (AI path)
 *
 * After the autoencoder reconstructs the inspection grid, this function
 * computes a per-tile anomaly score from the reconstruction error:
 *
 *   score(tile) = mean_abs_error(input, recon) / DEFECT_RECON_REF
 *
 * A score of 1.0 means the average per-pixel error equals DEFECT_RECON_REF
 * luma levels (32 by default).  Perfectly reconstructed tiles score 0.0.
 * The normalisation constant is chosen so that a clearly wrong reconstruction
 * (visible to the human eye) scores well above the typical PASS threshold.
 * ---------------------------------------------------------------------------
 */
void defect_score_recon(const uint8_t *input_grid,
                        const uint8_t *recon_grid,
                        float          tile_scores[DEFECT_TILE_COUNT])
{
	/* For each tile, the anomaly score is the mean absolute luma difference
	 * between the input and the autoencoder's reconstruction, normalised so
	 * that an average error of DEFECT_RECON_REF luma levels reads as 1.0. */
	for (int ty = 0; ty < DEFECT_TILES_Y; ty++) {
		for (int tx = 0; tx < DEFECT_TILES_X; tx++) {
			/* Accumulate absolute pixel-wise luma differences. */
			uint32_t err = 0;
			for (int y = 0; y < DEFECT_TILE_H; y++) {
				for (int x = 0; x < DEFECT_TILE_W; x++) {
					/* Linear index into the flat GRID_W-stride grid. */
					int g = (ty * DEFECT_TILE_H + y) * DEFECT_GRID_W + (tx * DEFECT_TILE_W + x);
					/* Signed difference; absolute value avoids cancellation. */
					int d = (int)input_grid[g] - (int)recon_grid[g];
					err += (uint32_t)(d < 0 ? -d : d);
				}
			}
			/* Mean absolute error, then divide by the reference to normalise. */
			float mean_err = (float)err / (float)(DEFECT_TILE_W * DEFECT_TILE_H);
			tile_scores[ty * DEFECT_TILES_X + tx] = mean_err / DEFECT_RECON_REF;
		}
	}
}

/* ---------------------------------------------------------------------------
 * defect_score_stat  (fallback / classical path)
 *
 * Computes a tile anomaly score without a trained model, using three
 * statistics that differ between a clean and a defective surface:
 *
 *   1. mean luma  -- a scratch or stain shifts the average grey level.
 *   2. variance   -- a defect introduces pixel-to-pixel intensity variation
 *                    that a pristine flat surface does not have.
 *   3. gradient energy (|dx|+|dy|) -- edges / scratches drive high gradients
 *                    even when the mean shift is small.
 *
 * For each statistic s in {mean, variance, grad}:
 *   dev(s) = |s - nominal[s]| / tol[s]
 * The tile score is max(dev) -- one anomalous feature is enough to flag it.
 *
 * Computed in two passes to keep memory use O(1) per tile.
 * ---------------------------------------------------------------------------
 */
void defect_score_stat(const uint8_t                *grid_luma,
                       const struct defect_baseline *base,
                       float                         tile_scores[DEFECT_TILE_COUNT])
{
	/* N: number of pixels per tile, used as the denominator for mean/variance. */
	const int N = DEFECT_TILE_W * DEFECT_TILE_H;
	for (int ty = 0; ty < DEFECT_TILES_Y; ty++) {
		for (int tx = 0; tx < DEFECT_TILES_X; tx++) {
			/* ----------------------------------------------------------------
			 * Pass 1: tile mean.
			 * Sum all luma values, then divide by N.  Integer accumulator
			 * avoids floating-point round-off across the 64-pixel sum.
			 * ---------------------------------------------------------------- */
			uint32_t sum = 0;
			for (int y = 0; y < DEFECT_TILE_H; y++) {
				for (int x = 0; x < DEFECT_TILE_W; x++) {
					int g = (ty * DEFECT_TILE_H + y) * DEFECT_GRID_W + (tx * DEFECT_TILE_W + x);
					sum += grid_luma[g];
				}
			}
			float mean = (float)sum / (float)N;

			/* ----------------------------------------------------------------
			 * Pass 2: variance + gradient energy (|dx| + |dy| of adjacent px).
			 * Gradient catches scratches/edges that a flat surface never has.
			 *
			 * variance: mean squared deviation from the tile mean.
			 * grad_acc: sum of |forward-difference in x| + |forward-difference
			 *           in y| for all pixels where the neighbour is still
			 *           inside the tile (boundary pixels contribute only one
			 *           direction).
			 * ---------------------------------------------------------------- */
			float var_acc  = 0.0f;
			float grad_acc = 0.0f;
			for (int y = 0; y < DEFECT_TILE_H; y++) {
				for (int x = 0; x < DEFECT_TILE_W; x++) {
					int   g = (ty * DEFECT_TILE_H + y) * DEFECT_GRID_W + (tx * DEFECT_TILE_W + x);
					float d = (float)grid_luma[g] - mean;
					var_acc += d * d;
					/* Forward differences inside the tile only. */
					if (x + 1 < DEFECT_TILE_W) {
						grad_acc += fabsf((float)grid_luma[g + 1] - (float)grid_luma[g]);
					}
					if (y + 1 < DEFECT_TILE_H) {
						grad_acc +=
						    fabsf((float)grid_luma[g + DEFECT_GRID_W] - (float)grid_luma[g]);
					}
				}
			}
			/* Normalise: variance by N, gradient by N (per-pixel averages). */
			float variance = var_acc / (float)N;
			float grad     = grad_acc / (float)N;

			/* ----------------------------------------------------------------
			 * Normalised deviation per statistic; the tile score is the worst
			 * (a single anomalous statistic is enough to flag the tile).
			 * Protect against a zero tolerance (degenerate baseline) by
			 * returning zero deviation rather than dividing by near-zero.
			 * ---------------------------------------------------------------- */
			float stat[DEFECT_STAT_DIM] = { mean, variance, grad };
			float worst                 = 0.0f;
			for (int i = 0; i < DEFECT_STAT_DIM; i++) {
				float dev = (base->tol[i] > 1e-6f)
				                ? (fabsf(stat[i] - base->nominal[i]) / base->tol[i])
				                : 0.0f;
				if (dev > worst) {
					worst = dev;
				}
			}
			tile_scores[ty * DEFECT_TILES_X + tx] = worst;
		}
	}
}

/* ---------------------------------------------------------------------------
 * defect_classify
 *
 * Converts per-tile scores into an inspection verdict:
 *
 *   DEFECT_PASS -- every tile scored ≤ threshold (no anomaly).
 *   DEFECT_FAIL -- at least one tile scored > threshold (strict inequality).
 *
 * "At threshold" is NOT a defect: the threshold marks the clean-surface edge
 * of the normal operating range (tolerance) -- exceeding it is the trigger.
 *
 * Severity: linear ramp from 0 (worst score at threshold) to 1 (worst score
 * at 2x threshold), clamped to [0, 1].  This lets a downstream alert system
 * prioritise how urgently to respond to a FAIL.
 *
 * All outputs are written atomically to *out so the caller can read the
 * struct once without worrying about partial updates.
 * ---------------------------------------------------------------------------
 */
void defect_classify(const float           tile_scores[DEFECT_TILE_COUNT],
                     float                 threshold,
                     struct defect_result *out)
{
	int   defect_tiles = 0;
	int   worst_idx    = 0;
	float worst_score  = tile_scores[0];

	/* A tile is defective only when STRICTLY above threshold (at-threshold is
	 * the clean tolerance edge).  Track the single worst tile for localisation. */
	for (int i = 0; i < DEFECT_TILE_COUNT; i++) {
		if (tile_scores[i] > threshold) {
			defect_tiles++;
		}
		/* Keep track of the tile with the highest score regardless of threshold,
		 * so worst_tx/worst_ty always point to the most suspicious region. */
		if (tile_scores[i] > worst_score) {
			worst_score = tile_scores[i];
			worst_idx   = i;
		}
	}

	/* Populate result fields.  worst_idx is a flat index; decode to (tx, ty). */
	out->defect_tiles = (uint8_t)defect_tiles;
	out->coverage_pct = (float)defect_tiles * 100.0f / (float)DEFECT_TILE_COUNT;
	out->worst_tx     = (uint8_t)(worst_idx % DEFECT_TILES_X);
	out->worst_ty     = (uint8_t)(worst_idx / DEFECT_TILES_X);
	out->worst_score  = worst_score;
	out->verdict      = (defect_tiles > 0) ? DEFECT_FAIL : DEFECT_PASS;

	/* Severity maps the worst score above threshold onto [0,1]: at threshold ->
	 * 0, at 2x threshold -> 1.  A PASS frame (worst <= threshold) clamps to 0. */
	float sev = (threshold > 1e-6f) ? ((worst_score - threshold) / threshold) : 0.0f;
	if (sev < 0.0f) {
		sev = 0.0f;
	}
	if (sev > 1.0f) {
		sev = 1.0f;
	}
	out->severity = sev;
}

/* ---------------------------------------------------------------------------
 * defect_verdict_name
 *
 * Returns a stable, null-terminated ASCII string for use in log messages
 * and serial output.  The default branch protects against future enum
 * additions reaching embedded systems before a firmware update.
 * ---------------------------------------------------------------------------
 */
const char *defect_verdict_name(defect_verdict_t v)
{
	switch (v) {
	case DEFECT_PASS:
		return "PASS";
	case DEFECT_FAIL:
		return "FAIL";
	default:
		return "UNKNOWN";
	}
}
```

## src/defect_map.h
```c
/*
 * Copyright 2026 Alp Lab AB
 * SPDX-License-Identifier: Apache-2.0
 *
 * defect_map -- pure-C surface-anomaly inspection.
 *
 * Unsupervised visual defect detection: instead of a classifier that must be
 * trained on every defect type, an autoencoder is trained ONLY on good surface.
 * It reconstructs normal texture well; any region it reconstructs poorly (high
 * error) is "not normal" -- a defect, including types never seen in training.
 *
 * This core does the deterministic work around that model:
 *   1. downsample the camera frame (RGB565) to a small luma inspection grid;
 *   2. score each tile -- EITHER from the autoencoder's reconstruction error
 *      (AI path) OR from a classical per-tile statistic vs a clean baseline
 *      (fallback path, so the example runs with no model);
 *   3. classify: which tiles exceed the anomaly threshold, where the worst one
 *      is, how much of the surface is affected, and an overall PASS/FAIL.
 * Arch-neutral (stdint/math only): builds for native_sim and the M55 alike.
 */
#ifndef DEFECT_MAP_H
#define DEFECT_MAP_H

#include <stddef.h>
#include <stdint.h>

#ifdef __cplusplus
extern "C" {
#endif

/* Inspection grid: the frame is reduced to this fixed luma resolution. */
#define DEFECT_GRID_W 64
#define DEFECT_GRID_H 64
/* Tile grid laid over the inspection grid (each tile is GRID/ TILES px). */
#define DEFECT_TILES_X    8
#define DEFECT_TILES_Y    8
#define DEFECT_TILE_COUNT (DEFECT_TILES_X * DEFECT_TILES_Y) /* 64 tiles */
#define DEFECT_TILE_W     (DEFECT_GRID_W / DEFECT_TILES_X)  /* 8 px */
#define DEFECT_TILE_H     (DEFECT_GRID_H / DEFECT_TILES_Y)  /* 8 px */
/* Per-tile statistics used by the fallback path: {mean, variance, grad-energy}. */
#define DEFECT_STAT_DIM 3
/* Reconstruction error (mean abs luma diff) that maps to a tile score of 1.0. */
#define DEFECT_RECON_REF 32.0f

/** Inspection outcome. */
typedef enum {
	DEFECT_PASS = 0, /**< no tile exceeded the anomaly threshold. */
	DEFECT_FAIL = 1  /**< at least one tile is anomalous. */
} defect_verdict_t;

/** Clean-surface baseline: nominal + tolerance for the 3 per-tile statistics,
 *  in order {mean, variance, gradient-energy}.  One global baseline is applied
 *  to every tile (a clean surface is statistically uniform); per-tile baselines
 *  are the documented extension. */
struct defect_baseline {
	float nominal[DEFECT_STAT_DIM];
	float tol[DEFECT_STAT_DIM];
};

/** Inspection verdict for one frame. */
struct defect_result {
	defect_verdict_t verdict;      /**< PASS / FAIL. */
	float            severity;     /**< worst-tile severity, 0 (clean) .. 1 (severe). */
	float            coverage_pct; /**< % of tiles flagged defective. */
	uint8_t          worst_tx;     /**< worst tile column [0, DEFECT_TILES_X). */
	uint8_t          worst_ty;     /**< worst tile row    [0, DEFECT_TILES_Y). */
	float            worst_score;  /**< the worst tile's anomaly score. */
	uint8_t          defect_tiles; /**< count of tiles over threshold. */
};

/** Downsample an RGB565 little-endian frame to the 8-bit luma inspection grid
 *  (BT.601 luma + box average).  @p grid_luma must hold DEFECT_GRID_W*H bytes. */
void defect_downsample_rgb565(const uint8_t *rgb565, uint16_t w, uint16_t h, uint8_t *grid_luma);

/** AI path: per-tile mean-abs reconstruction error (input vs autoencoder output),
 *  normalised by DEFECT_RECON_REF.  Writes DEFECT_TILE_COUNT scores. */
void defect_score_recon(const uint8_t *input_grid,
                        const uint8_t *recon_grid,
                        float          tile_scores[DEFECT_TILE_COUNT]);

/** Fallback path: per-tile {mean,variance,grad-energy} normalised deviation from
 *  @p base; tile score = the worst of the three.  Writes DEFECT_TILE_COUNT scores. */
void defect_score_stat(const uint8_t                *grid_luma,
                       const struct defect_baseline *base,
                       float                         tile_scores[DEFECT_TILE_COUNT]);

/** Classify per-tile scores into a verdict: a tile is defective when its score
 *  is strictly greater than @p threshold. */
void defect_classify(const float           tile_scores[DEFECT_TILE_COUNT],
                     float                 threshold,
                     struct defect_result *out);

/** Stable verdict name for the record. */
const char *defect_verdict_name(defect_verdict_t v);

#ifdef __cplusplus
}
#endif

#endif /* DEFECT_MAP_H */
```
