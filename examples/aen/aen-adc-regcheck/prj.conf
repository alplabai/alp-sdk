## CMakeLists.txt
```
# SPDX-License-Identifier: Apache-2.0
#
# aen-adc-regcheck -- scopeless on-silicon validation of the Alif ADC driver
# (zephyr/drivers/adc/adc_alif.c, compatible "alif,adc") on the E1M-AEN801
# (Ensemble E8, M55-HE), via the bench RAM-run + RAM-console flow.
#
# Plain prj.conf app (no alp_project.py board.yaml emit): the driver Kconfig
# (CONFIG_ADC_ALIF, default y, depends on DT_HAS_ALIF_ADC_ENABLED) is sourced
# under CONFIG_ALP_SDK, which prj.conf sets.

cmake_minimum_required(VERSION 3.20)

find_package(Zephyr REQUIRED HINTS $ENV{ZEPHYR_BASE})
project(aen_adc_regcheck LANGUAGES C)

target_sources(app PRIVATE src/main.c)
```

## prj.conf
```kconfig
# SPDX-License-Identifier: Apache-2.0
#
# Bench RAM-run config for the E1M-AEN801 (M55-HE). Console is the Alp UART
# console on the E1M edge UART0 (see the console block below).

# Tier-2 driver Kconfigs (incl. CONFIG_ADC_ALIF) are gated under ALP_SDK.
CONFIG_ALP_SDK=y

# ADC subsystem + the Alif "alif,adc" driver. CONFIG_ADC_ALIF is `default y` once
# the adc node is enabled (DT_HAS_ALIF_ADC_ENABLED); it `select`s PINCTRL and
# USE_ALIF_HAL_ANALOG (the hal_alif analog_ctrl VREF library) itself -- so we only
# need to turn on the ADC API here. Do NOT assign select-only / USE_ALIF_HAL_*
# symbols; the driver handles its own selects.
CONFIG_ADC=y

# This bench app drives the RAW Zephyr ADC API (adc_channel_setup / adc_read) to
# exercise the driver directly -- exactly like aen-spi-regcheck. So turn OFF the
# alp <alp/adc.h> dispatcher: CONFIG_ALP_SDK_PERIPH_ADC is `default y if ADC`, and
# its iterable backend section (.alp_backends_adc) needs a registered backend
# (src/backends/adc/alif_e8.c, gated on CONFIG_ALP_SOC_ALIF_ENSEMBLE_E8 -- set by
# the alp_project.py board.yaml path, NOT by a plain prj.conf). With no backend
# the linker has no __start_/__stop_alp_backends_adc symbols and the dispatcher
# fails to link. The portable wrapper is validated via the alp_project.py path,
# not here.
CONFIG_ALP_SDK_PERIPH_ADC=n

# Console: Alp UART console -- E1M edge UART0 (Alif UART5, P3_4/P3_5, 115200
# 8N1, NS16550), the E1M-AEN801 carrier console. The board _defconfig already
# selects it; we set it explicitly here so the example is self-describing.
CONFIG_SERIAL=y
CONFIG_CONSOLE=y
CONFIG_UART_CONSOLE=y
CONFIG_UART_INTERRUPT_DRIVEN=y
# Serial-less bench? Comment the four lines above and uncomment these to read
# 'ram_console_buf' over SWD instead:
# CONFIG_RAM_CONSOLE=y
# CONFIG_RAM_CONSOLE_BUFFER_SIZE=2048
# CONFIG_UART_CONSOLE=n
CONFIG_PRINTK=y

# Keep the image small + deterministic for this bench run.
CONFIG_LOG=n
```

## boards/alp_e1m_aen801_m55_he_ae822fa0e5597ls0_rtss_he.overlay
```dts
/*
 * Copyright (c) 2026 Alp Lab AB
 * SPDX-License-Identifier: Apache-2.0
 *
 * aen-adc-regcheck overlay for the E1M-AEN801 (Ensemble E8, M55-HE) RAM-run.
 *
 * Enables adc12_0 (the first 12-bit SAR ADC @ 0x49020000, driver adc_alif.c,
 * compatible "alif,adc") declared in
 * zephyr/dts/alif/ensemble_e8_peripherals.dtsi.  reg / reg-names / IRQs are
 * carried by the SoC dtsi node (transcribed VERBATIM from the Apache-2.0
 * zephyr_alif fork e1.dtsi); this overlay only flips it okay and binds one
 * channel.
 *
 * ADC inputs are direct analog pads, so NO pinctrl group is needed (the driver
 * applies pinctrl only IF the node carries it).  The actual analog pad routed to
 * each channel is a BENCH UNKNOWN on this batch -- the test reads channel 0 and
 * reports the raw sample; an open / unrouted pad yields a near-VREF or floating
 * value, which is reported, not failed.  The PASS gate is "the driver ran a
 * single-shot conversion through the IP and adc_read() returned 0" (see main.c).
 */

/*
 * RAM-run: the SoC `select` puts code in XIP; retarget ROM to ITCM so the image
 * links + runs from RAM (J-Link loadbin+go, no reset). PATH-REFERENCE form
 * (&itcm) -- the phandle-array form makes FLASH_SIZE=0 and overflows the link.
 */
/ {
	chosen {
		zephyr,flash = &itcm;
		/delete-property/ zephyr,code-partition;
	};
};

&adc12_0 {
	status = "okay";
};
```

## boards/alp_e1m_aen803_m55_he_ae822fa0e5597ls0_rtss_he.overlay
```dts
/*
 * Copyright (c) 2026 Alp Lab AB
 * SPDX-License-Identifier: Apache-2.0
 *
 * aen-adc-regcheck overlay for the E1M-AEN803 (Ensemble E8, M55-HE) RAM-run.
 *
 * Same silicon (AE822FA0E5597LS0) and same adc12_0 node as the E1M-AEN801
 * overlay in this directory -- E1M-AEN803 only differs by its external
 * OSPI0 memory population (both HyperRAM + NOR fitted, see
 * metadata/e1m_modules/E1M-AEN803.yaml), which this ADC bind check does not
 * touch. See the AEN801 overlay in this same directory for the full
 * rationale; not restated per-board here.
 */

/*
 * RAM-run: the SoC `select` puts code in XIP; retarget ROM to ITCM so the image
 * links + runs from RAM (J-Link loadbin+go, no reset). PATH-REFERENCE form
 * (&itcm) -- the phandle-array form makes FLASH_SIZE=0 and overflows the link.
 */
/ {
	chosen {
		zephyr,flash = &itcm;
		/delete-property/ zephyr,code-partition;
	};
};

&adc12_0 {
	status = "okay";
};
```

## boards/alp_e1m_aen803_m55_hp_ae822fa0e5597ls0_rtss_hp.overlay
```dts
/*
 * Copyright (c) 2026 Alp Lab AB
 * SPDX-License-Identifier: Apache-2.0
 *
 * aen-adc-regcheck overlay for the E1M-AEN803 (Ensemble E8, M55-HP) RAM-run.
 *
 * ADC12_0 is a shared SoC peripheral reachable from either M55 cluster on
 * this die; this overlay is otherwise identical to the M55-HE overlay in
 * this same directory (same node, same RAM-run flash retarget) -- see it
 * for the full rationale, not restated per-cluster here.
 */

/*
 * RAM-run: the SoC `select` puts code in XIP; retarget ROM to ITCM so the image
 * links + runs from RAM (J-Link loadbin+go, no reset). PATH-REFERENCE form
 * (&itcm) -- the phandle-array form makes FLASH_SIZE=0 and overflows the link.
 */
/ {
	chosen {
		zephyr,flash = &itcm;
		/delete-property/ zephyr,code-partition;
	};
};

&adc12_0 {
	status = "okay";
};
```

## src/main.c
```c
/*
 * Copyright (c) 2026 Alp Lab AB
 * SPDX-License-Identifier: Apache-2.0
 *
 * aen-adc-regcheck -- scopeless on-silicon validation of the Alif ADC driver
 * (zephyr/drivers/adc/adc_alif.c, compatible "alif,adc", adc12_0 @ 0x49020000)
 * on the E1M-AEN801 (Ensemble E8, M55-HE), via the bench RAM-run + RAM-console
 * flow.
 *
 * We cannot see the analog pin on this bench (no scope, app UART not on USB).
 * So we validate by driving the standard Zephyr ADC API (adc_channel_setup +
 * adc_read, a single-shot conversion) and then doing a REGISTER READBACK of the
 * controller's key registers.
 *
 * Two independent confirmations, exactly like aen-spi-regcheck:
 *   1. This firmware drives the API, prints the raw sample + the registers it
 *      reads back, plus a single RESULT PASS/FAIL line, to the RAM console (read
 *      'ram_console_buf' over J-Link mem8, ASCII-decode).
 *   2. The human re-reads the SAME absolute addresses over J-Link mem32 (see the
 *      readback plan) -- so a driver that only PRINTS the right thing is caught.
 *
 * SINGLE-SHOT path (the bit the strict PASS gate cares about), from
 * adc_alif.c::adc_enable_single_shot_conv():
 *   - ADC_START_SRC  (0x00) bit7 ADC_START_ENABLE        = 0x80
 *   - ADC_CONTROL    (0x30) bit0 ADC_START_SINGLE_SHOT   = 0x01
 *   - result lands in ADC_SAMPLE_REG_0 (0x50) + 4*channel
 * The driver disables those again on completion (adc_context_on_complete ->
 * disable_adc -> adc_disable_single_shot_conv clears both bits), so post-read the
 * START_SRC ENABLE bit and the CONTROL SINGLE_SHOT bit read back 0 (idle).  That
 * idle-after-completion state is the register evidence the conversion ran and
 * tore down cleanly -- analogous to SSIENR=0 after the SPI transfer.
 *
 * The analog pad routed to channel 0 is a BENCH UNKNOWN on this batch, so the raw
 * sample value is REPORTED, not part of the strict PASS gate (an open pad reads a
 * floating / near-VREF value).  The PASS gate is: adc_channel_setup() and
 * adc_read() both returned 0 (the driver programmed the IP + ran a single-shot
 * conversion through the analog block + the DONE1 IRQ delivered a sample), and
 * the controller is idle afterwards.
 */

#include <stdbool.h>
#include <stdint.h>

#include <zephyr/kernel.h>
#include <zephyr/device.h>
#include <zephyr/devicetree.h>
#include <zephyr/drivers/adc.h>
#include <zephyr/sys/printk.h>

#define ADC_NODE DT_NODELABEL(adc12_0)

/* Absolute reg base straight from the dtsi reg[0] = "adc_reg" (0x49020000),
 * pulled from devicetree so this stays correct if the node ever moves. */
#define ADC_BASE ((uint32_t)DT_REG_ADDR_BY_NAME(ADC_NODE, adc_reg))

/* ADC register offsets -- VERBATIM from adc_alif.c. */
/* Timing registers read back beside the result, so the log records the
 * configuration the measurement below belongs to (HWRM 19.1.5.3.4 / .3.7 /
 * .3.8 / .3.11). */
#define OFF_CLK_DIVISOR   0x0CU
#define OFF_SAMPLE_WIDTH  0x18U
#define OFF_AVG_NUM       0x20U
#define OFF_SEQUENCER_CTL 0x34U

/* How many conversions the timing loop runs.  Large enough that the k_cycle
 * resolution and per-call software overhead are small next to the total. */
#define TIMING_ITERATIONS 2000U

#define OFF_START_SRC 0x00U
#define OFF_CONTROL   0x30U
#define OFF_SEL       0x3CU
#define OFF_SAMPLE_0  0x50U

/* ADC_START_SRC bit7 = ADC_START_ENABLE; ADC_CONTROL bit0 = SINGLE_SHOT.
 * Both are cleared by the driver's completion teardown, so post-read = 0. */
#define START_ENABLE_BIT (1U << 7)
#define CTRL_SINGLE_SHOT (1U << 0)

/* Channel under test (single-channel scan, single-shot). */
#define TEST_CHANNEL 0U

/* 12-bit SAR: the resolution the driver advertises for ADC12 instances.  The
 * Alif driver ignores adc_sequence.resolution (it returns -ENOTSUP if non-zero),
 * so we pass 0 in the sequence; this is for buffer sizing / reporting only. */
#define ADC_RESOLUTION 12U

/*
 * ADC full-scale reference (mV) for the REPORTED raw->uV conversion.  The
 * adc_alif driver fixes the ADC reference in hardware to ADC_VREF_CONT=0x10 with
 * the reference divider OFF (ADC_VREF_BUF_RDIV_EN=0x0 -> RDIV=0 = 1.8 V), which
 * matches hal_alif analog_ctrl.h:46/63.  So full-scale = 1.8 V = 1 800 000 uV
 * over the 12-bit code span (2^12 = 4096 quanta).  This is the REGISTER
 * reference; the absolute on-pad mV is a bench/TRM unknown, so the line is
 * REPORTED, not gated.
 */
#define ADC_REFERENCE_UV 1800000U
#define ADC_CODE_SPAN    (1U << ADC_RESOLUTION) /* 4096 */

static inline uint32_t rd(uint32_t base, uint32_t off)
{
	return *(volatile uint32_t *)(base + off);
}

int main(void)
{
	const struct device *adc = DEVICE_DT_GET(ADC_NODE);

	printk("\n=== aen-adc-regcheck ===\n");
	printk("adc node   : %s\n", DT_NODE_FULL_NAME(ADC_NODE));
	printk("adc_base   : 0x%08x\n", ADC_BASE);

	if (!device_is_ready(adc)) {
		printk("RESULT FAIL: adc device not ready (init/clock/VREF failed)\n");
		return 0;
	}

	/* Channel 0, single-ended, default gain / reference (the per-instance VREF
	 * + clock are programmed by adc_init() from the DT node properties). */
	struct adc_channel_cfg ch_cfg = {
		.gain             = ADC_GAIN_1,
		.reference        = ADC_REF_INTERNAL,
		.acquisition_time = ADC_ACQ_TIME_DEFAULT,
		.channel_id       = TEST_CHANNEL,
		.differential     = 0,
	};

	int rc_setup = adc_channel_setup(adc, &ch_cfg);
	printk("adc_channel_setup(ch=%u) rc = %d\n", TEST_CHANNEL, rc_setup);

	/*
	 * Single-shot read of channel 0.  NOTE: adc_alif.c::adc_start_read()
	 * dereferences sequence->options->user_data (it stashes a comparator-status
	 * pointer there), so options MUST be non-NULL with a valid user_data -- pass
	 * a stack byte to satisfy that.  (A bare adc_read with options==NULL would
	 * fault inside the driver; this is a driver quirk we honour, not invent.)
	 */
	/* The driver's check_buffer_size() needs active_channels * sizeof(uint32_t)
	 * (it stores a 32-bit result per channel) -- a uint16_t buffer is too small
	 * and adc_read() returns -ENOMEM.  Use uint32_t. */
	uint32_t sample     = 0;
	uint8_t  cmp_status = 0;

	const struct adc_sequence_options opts = {
		.interval_us     = 0,
		.callback        = NULL,
		.user_data       = &cmp_status,
		.extra_samplings = 0,
	};

	struct adc_sequence seq = {
		.options      = &opts,
		.channels     = BIT(TEST_CHANNEL),
		.buffer       = &sample,
		.buffer_size  = sizeof(sample),
		.resolution   = 0, /* driver rejects non-zero; programmed via DT */
		.oversampling = 0,
		.calibrate    = false,
	};

	int rc_read = adc_read(adc, &seq);
	printk("adc_read rc = %d\n", rc_read);
	printk("raw sample : %d (0x%04x)  [analog pad on ch0 is a bench unknown]\n",
	       (int)sample,
	       (uint16_t)sample);

	/* #2083: seq.buffer points at `sample`, so every further adc_read(adc,
	 * &seq) call -- including the #1823 timing loop below -- overwrites it.
	 * Capture the value from THIS gated single-shot read now, before the
	 * timing loop runs, so the RESULT line reports that reading instead
	 * of whatever the timing loop's last iteration left behind.  The
	 * value itself is still REPORTED only, not part of the PASS gate --
	 * see the note at the PASS-gate block below. */
	uint32_t gated_sample = sample;

	/*
	 * REPORTED (not gated): the raw 12-bit code scaled to microvolts at the
	 * driver-fixed 1.8 V reference (ADC_VREF_CONT=0x10, RDIV=0; analog_ctrl.h:
	 * 46/63).  uV = raw * 1 800 000 / 4096.  The channel-0 pad is unrouted/open
	 * on this batch (floats near VREF), so this is a REGISTER-derived value, not
	 * a calibrated measurement -- absolute on-pad mV is a bench/TRM unknown.
	 */
	uint32_t meas_uv =
	    ((uint32_t)(sample & (ADC_CODE_SPAN - 1U)) * ADC_REFERENCE_UV) / ADC_CODE_SPAN;

	printk("REPORTED  measured = %u uV (raw %u * %u uV / %u; 1.8 V VREF, "
	       "pad open)\n",
	       meas_uv,
	       (unsigned)(sample & (ADC_CODE_SPAN - 1U)),
	       ADC_REFERENCE_UV,
	       ADC_CODE_SPAN);

	/*
	 * Register readback.  After a completed single-shot the driver has cleared
	 * the START_SRC ENABLE bit + the CONTROL SINGLE_SHOT bit (disable_adc), so
	 * both read 0 (idle).  ADC_SEL holds the last-converted channel.  The
	 * per-channel sample register retains the last conversion result.
	 */
	uint32_t start_src = rd(ADC_BASE, OFF_START_SRC);
	uint32_t control   = rd(ADC_BASE, OFF_CONTROL);
	uint32_t sel       = rd(ADC_BASE, OFF_SEL);
	uint32_t samp_reg  = rd(ADC_BASE, OFF_SAMPLE_0 + 4U * TEST_CHANNEL);

	/*
	 * ADC_CLK measurement (#1823).  Time TIMING_ITERATIONS identical
	 * single-shot reads.  Each conversion is avg_sample_num ADC_CLK periods, so
	 * running this image at two clock_div values and differencing cancels the
	 * per-call software overhead:
	 *
	 *     PERIPH_CLK = avg_sample_num * (div_b - div_a) / (t_b - t_a)
	 *
	 * A single run cannot separate hardware time from call overhead, so the
	 * per-conversion number below is reported, never gated.
	 */
	uint32_t t0 = k_cycle_get_32();

	for (uint32_t i = 0; i < TIMING_ITERATIONS; i++) {
		(void)adc_read(adc, &seq);
	}

	uint32_t elapsed_cyc = k_cycle_get_32() - t0;
	uint64_t elapsed_ns  = k_cyc_to_ns_floor64(elapsed_cyc);

	printk("-- timing (#1823) --\n");
	printk("iterations : %u\n", TIMING_ITERATIONS);
	printk("total      : %u ns\n", (unsigned)elapsed_ns);
	printk("per read   : %u ns  (hardware + adc_read() overhead)\n",
	       (unsigned)(elapsed_ns / TIMING_ITERATIONS));

	printk("-- readback --\n");
	printk("CLK_DIVISOR   0x%08x = 0x%08x (HWRM 19.1.5.3.4, 0x2..0x10)\n",
	       ADC_BASE + OFF_CLK_DIVISOR,
	       rd(ADC_BASE, OFF_CLK_DIVISOR));
	printk("SAMPLE_WIDTH  0x%08x = 0x%08x (HWRM 19.1.5.3.7, 2..32 PCLK)\n",
	       ADC_BASE + OFF_SAMPLE_WIDTH,
	       rd(ADC_BASE, OFF_SAMPLE_WIDTH));
	printk("AVG_NUM       0x%08x = 0x%08x (samples per result)\n",
	       ADC_BASE + OFF_AVG_NUM,
	       rd(ADC_BASE, OFF_AVG_NUM));
	printk("SEQUENCER_CTL 0x%08x = 0x%08x (bit16 MODE, bits 8-0 MASKED)\n",
	       ADC_BASE + OFF_SEQUENCER_CTL,
	       rd(ADC_BASE, OFF_SEQUENCER_CTL));
	printk("START_SRC 0x%08x = 0x%08x (bit7 ENABLE exp 0 after completion)\n",
	       ADC_BASE + OFF_START_SRC,
	       start_src);
	printk("CONTROL   0x%08x = 0x%08x (bit0 SINGLE_SHOT exp 0 after completion)\n",
	       ADC_BASE + OFF_CONTROL,
	       control);
	printk("ADC_SEL   0x%08x = 0x%08x (last converted channel)\n", ADC_BASE + OFF_SEL, sel);
	printk("SAMPLE[%u] 0x%08x = 0x%08x (raw conversion result register)\n",
	       TEST_CHANNEL,
	       ADC_BASE + OFF_SAMPLE_0 + 4U * TEST_CHANNEL,
	       samp_reg);

	/*
	 * PASS gate:
	 *   - adc_channel_setup returned 0 (channel programmed, VREF/clock ok),
	 *   - adc_read returned 0 (single-shot conversion ran + DONE1 delivered),
	 *   - the controller is idle afterwards (START_SRC ENABLE + CONTROL
	 *     SINGLE_SHOT both cleared by the driver's completion teardown).
	 * The raw sample value is REPORTED only (the channel-0 analog pad is a bench
	 * unknown -- an open pad floats), so it is NOT part of the gate.
	 */
	bool idle_ok = ((start_src & START_ENABLE_BIT) == 0U) && ((control & CTRL_SINGLE_SHOT) == 0U);

	bool ok = true;

	ok &= (rc_setup == 0);
	ok &= (rc_read == 0);
	ok &= idle_ok;

	if (ok) {
		printk("RESULT PASS: adc12_0 setup+read rc=0, single-shot ran, "
		       "controller idle, raw=%d\n",
		       (int)gated_sample);
	} else {
		printk("RESULT FAIL: setup_rc=%d read_rc=%d idle=%s "
		       "(start_src=0x%08x control=0x%08x)\n",
		       rc_setup,
		       rc_read,
		       idle_ok ? "OK" : "NOT-IDLE",
		       start_src,
		       control);
	}

	return 0;
}
```
