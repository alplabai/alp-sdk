## CMakeLists.txt
```
# Copyright (c) 2026 Alp Lab AB
# SPDX-License-Identifier: Apache-2.0
#
# aen-npu-inference-alp-u55 -- real person_detect on the E1M-AEN801 (Ensemble
# E8) Ethos-U55 (the M55-HE-paired U55, 128-MAC), driven through the portable
# <alp/inference.h> API.  The U55 sibling of aen-npu-inference-alp (which runs
# the U85).  The app source + gen_model.py + overlay/prj.conf differ only in the
# accelerator config; the alp_inference_open() code is identical -- the AEN
# Ethos-U backend supplies the (variant-agnostic) strong overrides.
#
# LICENSING: a bench-matching Vela stream needs Alif's PROPRIETARY
# ensemble_vela.ini (-DAEN_NPU_VELA_CONFIG=..., not redistributed).

cmake_minimum_required(VERSION 3.20.0)

find_package(Zephyr REQUIRED HINTS $ENV{ZEPHYR_BASE})
project(aen_npu_inference_alp_u55 LANGUAGES C CXX)

set(AEN_NPU_VELA   "vela"
    CACHE FILEPATH "Vela compiler (on PATH, or -DAEN_NPU_VELA=<venv>/bin/vela)")
# THE DIFFERENCE vs the U85 sibling: the E8 per-core-local NPU is a U55, and
# its MAC count is core-specific -- the M55-HE-paired U55 is 128-MAC, the
# M55-HP-paired U55 (same shared DT node, different silicon) is 256-MAC (see
# ensemble_e8_peripherals.dtsi).  Pick the Vela accelerator config + Alif
# system-config off BOARD so a single app source builds correctly for
# whichever core's board target is passed to `west build -b`.
if(BOARD MATCHES "_m55_hp$")
	set(_aen_npu_accel_default      "ethos-u55-256")
	set(_aen_npu_sysconfig_default  "RTSS_HP_SRAM_Only")
else()
	set(_aen_npu_accel_default      "ethos-u55-128")
	set(_aen_npu_sysconfig_default  "RTSS_HE_SRAM_Only")
endif()
set(AEN_NPU_ACCEL  "${_aen_npu_accel_default}"
    CACHE STRING   "Vela --accelerator-config (128-MAC on M55-HE, 256-MAC on M55-HP)")
set(AEN_NPU_MODEL  "${ZEPHYR_TFLITE_MICRO_MODULE_DIR}/tensorflow/lite/micro/models/person_detect.tflite"
    CACHE FILEPATH "Input int8 .tflite to Vela-compile")
set(AEN_NPU_MODEL_NAME "person_detect_u55"
    CACHE STRING   "Embedded model identity string")
set(AEN_NPU_VELA_CONFIG ""
    CACHE FILEPATH "Alif Vela config .ini (ALIF PROPRIETARY -- from alp-sdk-internal)")
if(NOT AEN_NPU_VELA_CONFIG)
	message(WARNING
		"aen-npu-inference-alp-u55: AEN_NPU_VELA_CONFIG unset -- Vela will use its "
		"built-in system-config and the command stream will NOT match the bench "
		"runtime.  Pass -DAEN_NPU_VELA_CONFIG=<alif>/ensemble_vela.ini.")
endif()
# Each core's U55 uses that core's SRAM-only memory view (the Alif
# ensemble_vela.ini has no Ethos_U55-specific section; the per-core
# RTSS_HE/RTSS_HP config describes the U55's memory: axi0_port=Sram).
set(AEN_NPU_SYSTEM_CONFIG "${_aen_npu_sysconfig_default}" CACHE STRING "Vela --system-config")
set(AEN_NPU_MEMORY_MODE   "Sram_Only"         CACHE STRING "Vela --memory-mode")

set(AEN_NPU_GEN_DIR "${CMAKE_CURRENT_BINARY_DIR}/model-gen")
set(AEN_NPU_MODEL_H "${AEN_NPU_GEN_DIR}/model.h")

set(_gen_args
	--vela      ${AEN_NPU_VELA}
	--accel     ${AEN_NPU_ACCEL}
	--model     ${AEN_NPU_MODEL}
	--name      ${AEN_NPU_MODEL_NAME}
	--build-dir ${AEN_NPU_GEN_DIR}
	--out       ${AEN_NPU_MODEL_H}
)
if(AEN_NPU_VELA_CONFIG)
	list(APPEND _gen_args --config ${AEN_NPU_VELA_CONFIG}
	     --system-config ${AEN_NPU_SYSTEM_CONFIG} --memory-mode ${AEN_NPU_MEMORY_MODE})
endif()

add_custom_command(
	OUTPUT  ${AEN_NPU_MODEL_H}
	COMMAND ${CMAKE_COMMAND} -E make_directory ${AEN_NPU_GEN_DIR}
	COMMAND ${PYTHON_EXECUTABLE} ${CMAKE_CURRENT_SOURCE_DIR}/gen_model.py ${_gen_args}
	DEPENDS ${AEN_NPU_MODEL} ${CMAKE_CURRENT_SOURCE_DIR}/gen_model.py
	COMMENT "aen-npu-inference-alp-u55: Vela-compiling ${AEN_NPU_MODEL} for ${AEN_NPU_ACCEL}"
	VERBATIM
)
if(NOT EXISTS ${AEN_NPU_MODEL_H})
	execute_process(
		COMMAND ${CMAKE_COMMAND} -E make_directory ${AEN_NPU_GEN_DIR}
		COMMAND ${PYTHON_EXECUTABLE} ${CMAKE_CURRENT_SOURCE_DIR}/gen_model.py ${_gen_args}
		RESULT_VARIABLE _gen_rc)
	if(NOT _gen_rc EQUAL 0)
		message(FATAL_ERROR "aen-npu-inference-alp-u55: model-gen failed (rc=${_gen_rc})")
	endif()
endif()

add_custom_target(aen_npu_alp_u55_model DEPENDS ${AEN_NPU_MODEL_H})
add_dependencies(app aen_npu_alp_u55_model)

zephyr_include_directories(${ZEPHYR_ALIF_MODULE_DIR}/common/include)
target_include_directories(app PRIVATE ${AEN_NPU_GEN_DIR})
target_sources(app PRIVATE src/main.c)
```

## prj.conf
```kconfig
# SPDX-License-Identifier: Apache-2.0
#
# aen-npu-inference-alp-u55 -- real person_detect NPU inference through
# <alp/inference.h> on the E1M-AEN801 (Ensemble E8, M55-HE) Ethos-U55 (the
# M55-HE-paired U55, 128-MAC).  The U55 sibling of aen-npu-inference-alp.
# ~263 KiB Vela model -> MRAM slot0, Flow D boot.

# --- MRAM slot0 link --------------------------------------------------------
# Nothing to set: the board _defconfig sets CONFIG_USE_DT_CODE_PARTITION=y, so
# every image for this board links at the slot0 offset (0x80010000), not the
# MRAM base.

# --- alp-sdk inference backend selection ------------------------------------
CONFIG_ALP_SDK=y
CONFIG_ALP_SDK_INFERENCE_BACKEND_TFLM=y
CONFIG_ALP_SDK_INFERENCE_BACKEND_ETHOS_U_AEN=y
# U55 variant marker (not U85) -- satisfies the ethos_u_aen.cpp drift #error.
CONFIG_ALP_SDK_INFERENCE_ETHOS_U_VARIANT_U55=y

# --- TFLM + Ethos-U driver stack --------------------------------------------
CONFIG_CPP=y
CONFIG_STD_CPP17=y
CONFIG_REQUIRES_FULL_LIBCPP=y
CONFIG_TENSORFLOW_LITE_MICRO=y
CONFIG_ETHOS_U=y
CONFIG_ETHOS_U_DCACHE=y
# THE ACCELERATOR: this app builds for either M55 core's own U55 -- HE-paired
# is 128-MAC, HP-paired is 256-MAC (same shared DT node, different silicon
# per core; see ensemble_e8_peripherals.dtsi).  CONFIG_ETHOS_U55_{128,256} is
# therefore set per-board in boards/<target>.conf (matches CMakeLists.txt's
# BOARD-conditional --accel), not here.

# --- Heap / stack -----------------------------------------------------------
CONFIG_HEAP_MEM_POOL_SIZE=65536
CONFIG_MAIN_STACK_SIZE=16384

# --- DMA coherence ----------------------------------------------------------
CONFIG_DCACHE=n

# --- Console: RAM console (bench observable over SWD) ------------------------
CONFIG_CONSOLE=y
CONFIG_RAM_CONSOLE=y
CONFIG_RAM_CONSOLE_BUFFER_SIZE=2048
CONFIG_UART_CONSOLE=n
CONFIG_PRINTK=y
CONFIG_LOG=n
```

## boards/alp_e1m_aen801_m55_he_ae822fa0e5597ls0_rtss_he.conf
```kconfig
# SPDX-License-Identifier: Apache-2.0
#
# M55-HE-paired Ethos-U55 on this board is 128-MAC (see the SoC peripherals
# dtsi comment on the shared ethosu55@400e1000 node). NPU variant Kconfig is
# per-core (the HP twin sets CONFIG_ETHOS_U55_256), so it lives here rather
# than in prj.conf.
CONFIG_ETHOS_U55_128=y
```

## boards/alp_e1m_aen803_m55_hp_ae822fa0e5597ls0_rtss_hp.conf
```kconfig
# SPDX-License-Identifier: Apache-2.0
#
# M55-HP-paired Ethos-U55 on this board is 256-MAC (see the SoC peripherals
# dtsi comment on the shared ethosu55@400e1000 node -- the HE twin is
# 128-MAC). NPU variant Kconfig is per-core, so it lives here rather than in
# prj.conf.
CONFIG_ETHOS_U55_256=y
```

## boards/alp_e1m_aen801_m55_he_ae822fa0e5597ls0_rtss_he.overlay
```dts
/*
 * Copyright (c) 2026 Alp Lab AB
 * SPDX-License-Identifier: Apache-2.0
 *
 * aen-npu-inference-alp-u55 overlay for the E1M-AEN801 (Ensemble E8, M55-HE).
 * This is the U55 sibling of aen-npu-inference-alp (which runs the U85).  On
 * the E8 the U85 (Alif block name NPU_HG, ethosu85@49042000) is the flagship
 * NPU, but the SoC ALSO carries two Ethos-U55s paired with the M55-HE / M55-HP
 * cores (ethosu55@400e1000, IRQ 55).  This overlay exercises the M55-HE-paired
 * U55.
 *
 * The core Ethos-U driver compiles for exactly ONE accelerator config
 * (CONFIG_ETHOS_U55_256 here; see prj.conf), and binds every status="okay"
 * arm,ethos-u node -- so we ENABLE the U55 node and DISABLE the U85 node, or a
 * U55-configured driver would try to init the U85 hardware (base 0x49042000)
 * and fault.  DMA placement is identical to the U85 path: model + arena live in
 * NPU-reachable global SRAM0 (@0x02000000, the SoC-dtsi sram0 node's linker
 * region); the SDK's strong ethosu_address_remap / ethosu_config_select
 * (src/backends/inference/ethos_u_aen.cpp) are variant-agnostic and route the
 * SRAM0 accesses over the NPU's SRAM AXI port.  CONFIG_DCACHE=n (prj.conf)
 * keeps CPU + NPU coherent with no maintenance calls.
 */

/*
 * global_base for hal_alif soc_memory_map.h local_to_global() -- the itcm/dtcm
 * nodes' upstream bindings carry no global_base, so re-compatible them onto the
 * alp-sdk alif,itcm/alif,dtcm bindings and set the E8 RTSS-HE global views
 * (transcribed from the Apache-2.0 zephyr_alif fork ensemble_rtss_he.dtsi):
 * ITCM global_base = 0x58000000, DTCM global_base = 0x58800000.
 */
&itcm {
	compatible = "alif,itcm";
	global_base = <0x58000000>;
};

&dtcm {
	compatible = "alif,dtcm";
	global_base = <0x58800000>;
};

/* Run the U55 (M55-HE-paired) instead of the U85: enable the ethosu55 node
 * (declared status="disabled" in the SoC peripherals dtsi) and disable the
 * ethosu85 the generated board leaves okay, so the U55-configured Arm driver
 * binds exactly one node -- the U55 at 0x400e1000. */
&ethosu55 {
	status = "okay";
};

&ethosu85 {
	status = "disabled";
};
```

## boards/alp_e1m_aen801_m55_hp_ae822fa0e5597ls0_rtss_hp.overlay
```dts
/*
 * Copyright (c) 2026 Alp Lab AB
 * SPDX-License-Identifier: Apache-2.0
 *
 * aen-npu-inference-alp-u55 overlay for the E1M-AEN801 (Ensemble E8, M55-HP).
 * This is the HP-core twin of the M55-HE overlays: the SoC ALSO carries an
 * Ethos-U55 paired with the M55-HP cluster (same DT node/address as the
 * HE-paired one, ethosu55@400e1000, IRQ 55 -- core-LOCAL, each M55 only sees
 * its own; see ensemble_e8_peripherals.dtsi), but the HP-paired U55 is
 * 256-MAC (the HE-paired one is 128-MAC; see the board's prj.conf/.conf and
 * CMakeLists.txt, which pick CONFIG_ETHOS_U55_256 + --accel ethos-u55-256 for
 * this board target). The U85 (HG subsystem, ethosu85@49042000) is this
 * board's default-enabled NPU; disable it so the U55-configured driver binds
 * exactly one node.
 *
 * The core Ethos-U driver compiles for exactly ONE accelerator config (a
 * single Kconfig `choice`), and binds every status="okay" arm,ethos-u node --
 * so we ENABLE the U55 node and DISABLE the U85 node, or a U55-configured
 * driver would try to init the U85 hardware (base 0x49042000) and fault. DMA
 * placement is identical to the HE path: model + arena live in NPU-reachable
 * global SRAM0 (@0x02000000, the SoC-dtsi sram0 node's linker region); the
 * SDK's strong ethosu_address_remap / ethosu_config_select
 * (src/backends/inference/ethos_u_aen.cpp) are variant-agnostic and route the
 * SRAM0 accesses over the NPU's SRAM AXI port. CONFIG_DCACHE=n (prj.conf)
 * keeps CPU + NPU coherent with no maintenance calls.
 */

/*
 * global_base for hal_alif soc_memory_map.h local_to_global() -- the itcm/dtcm
 * nodes' upstream bindings carry no global_base, so re-compatible them onto the
 * alp-sdk alif,itcm/alif,dtcm bindings and set the E8 RTSS-HP global views
 * (transcribed from the Apache-2.0 zephyr_alif fork ensemble_rtss_hp.dtsi):
 * ITCM global_base = 0x50000000, DTCM global_base = 0x50800000.
 */
&itcm {
	compatible = "alif,itcm";
	global_base = <0x50000000>;
};

&dtcm {
	compatible = "alif,dtcm";
	global_base = <0x50800000>;
};

/* Run the U55 (M55-HP-paired) instead of the U85: enable the ethosu55 node
 * (declared status="disabled" in the SoC peripherals dtsi) and disable the
 * ethosu85 the generated board leaves okay, so the U55-configured Arm driver
 * binds exactly one node -- the U55 at 0x400e1000. */
&ethosu55 {
	status = "okay";
};

&ethosu85 {
	status = "disabled";
};
```

## boards/alp_e1m_aen803_m55_he_ae822fa0e5597ls0_rtss_he.overlay
```dts
/*
 * Copyright (c) 2026 Alp Lab AB
 * SPDX-License-Identifier: Apache-2.0
 *
 * aen-npu-inference-alp-u55 overlay for the E1M-AEN803 (Ensemble E8, M55-HE).
 * This is the U55 sibling of aen-npu-inference-alp (which runs the U85).  On the
 * E8 the U85 (HG subsystem, ethosu85@49042000) is the flagship NPU, but the SoC
 * ALSO carries two Ethos-U55s paired with the M55-HE / M55-HP cores
 * (ethosu55@400e1000, IRQ 55).  This overlay exercises the M55-HE-paired U55.
 *
 * The core Ethos-U driver compiles for exactly ONE accelerator config
 * (CONFIG_ETHOS_U55_256 here; see prj.conf), and binds every status="okay"
 * arm,ethos-u node -- so we ENABLE the U55 node and DISABLE the U85 node, or a
 * U55-configured driver would try to init the U85 hardware (base 0x49042000)
 * and fault.  DMA placement is identical to the U85 path: model + arena live in
 * NPU-reachable global SRAM0 (@0x02000000, the SoC-dtsi sram0 node's linker
 * region); the SDK's strong ethosu_address_remap / ethosu_config_select
 * (src/backends/inference/ethos_u_aen.cpp) are variant-agnostic and route the
 * SRAM0 accesses over the NPU's SRAM AXI port.  CONFIG_DCACHE=n (prj.conf)
 * keeps CPU + NPU coherent with no maintenance calls.
 */

/*
 * global_base for hal_alif soc_memory_map.h local_to_global() -- the itcm/dtcm
 * nodes' upstream bindings carry no global_base, so re-compatible them onto the
 * alp-sdk alif,itcm/alif,dtcm bindings and set the E8 RTSS-HE global views
 * (transcribed from the Apache-2.0 zephyr_alif fork ensemble_rtss_he.dtsi):
 * ITCM global_base = 0x58000000, DTCM global_base = 0x58800000.
 */
&itcm {
	compatible = "alif,itcm";
	global_base = <0x58000000>;
};

&dtcm {
	compatible = "alif,dtcm";
	global_base = <0x58800000>;
};

/* Run the U55 (M55-HE-paired) instead of the U85: enable the ethosu55 node
 * (declared status="disabled" in the SoC peripherals dtsi) and disable the
 * ethosu85 the generated board leaves okay, so the U55-configured Arm driver
 * binds exactly one node -- the U55 at 0x400e1000. */
&ethosu55 {
	status = "okay";
};

&ethosu85 {
	status = "disabled";
};
```

## boards/alp_e1m_aen803_m55_hp_ae822fa0e5597ls0_rtss_hp.overlay
```dts
/*
 * Copyright (c) 2026 Alp Lab AB
 * SPDX-License-Identifier: Apache-2.0
 *
 * aen-npu-inference-alp-u55 overlay for the E1M-AEN803 (Ensemble E8, M55-HP).
 * This is the HP-core twin of the M55-HE overlays: the SoC ALSO carries an
 * Ethos-U55 paired with the M55-HP cluster (same DT node/address as the
 * HE-paired one, ethosu55@400e1000, IRQ 55 -- core-LOCAL, each M55 only sees
 * its own; see ensemble_e8_peripherals.dtsi), but the HP-paired U55 is
 * 256-MAC (the HE-paired one is 128-MAC; see the board's prj.conf/.conf and
 * CMakeLists.txt, which pick CONFIG_ETHOS_U55_256 + --accel ethos-u55-256 for
 * this board target). The U85 (HG subsystem, ethosu85@49042000) is this
 * board's default-enabled NPU; disable it so the U55-configured driver binds
 * exactly one node.
 *
 * The core Ethos-U driver compiles for exactly ONE accelerator config (a
 * single Kconfig `choice`), and binds every status="okay" arm,ethos-u node --
 * so we ENABLE the U55 node and DISABLE the U85 node, or a U55-configured
 * driver would try to init the U85 hardware (base 0x49042000) and fault. DMA
 * placement is identical to the HE path: model + arena live in NPU-reachable
 * global SRAM0 (@0x02000000, the SoC-dtsi sram0 node's linker region); the
 * SDK's strong ethosu_address_remap / ethosu_config_select
 * (src/backends/inference/ethos_u_aen.cpp) are variant-agnostic and route the
 * SRAM0 accesses over the NPU's SRAM AXI port. CONFIG_DCACHE=n (prj.conf)
 * keeps CPU + NPU coherent with no maintenance calls.
 */

/*
 * global_base for hal_alif soc_memory_map.h local_to_global() -- the itcm/dtcm
 * nodes' upstream bindings carry no global_base, so re-compatible them onto the
 * alp-sdk alif,itcm/alif,dtcm bindings and set the E8 RTSS-HP global views
 * (transcribed from the Apache-2.0 zephyr_alif fork ensemble_rtss_hp.dtsi):
 * ITCM global_base = 0x50000000, DTCM global_base = 0x50800000.
 */
&itcm {
	compatible = "alif,itcm";
	global_base = <0x50000000>;
};

&dtcm {
	compatible = "alif,dtcm";
	global_base = <0x50800000>;
};

/* Run the U55 (M55-HP-paired) instead of the U85: enable the ethosu55 node
 * (declared status="disabled" in the SoC peripherals dtsi) and disable the
 * ethosu85 the generated board leaves okay, so the U55-configured Arm driver
 * binds exactly one node -- the U55 at 0x400e1000. */
&ethosu55 {
	status = "okay";
};

&ethosu85 {
	status = "disabled";
};
```

## src/main.c
```c
/*
 * Copyright 2026 Alp Lab AB
 * SPDX-License-Identifier: Apache-2.0
 *
 * aen-npu-inference-alp -- the REAL person_detect MobileNet running on the
 * E1M-AEN801 (Ensemble E8) Ethos-U55 NPU *through the portable
 * <alp/inference.h> API* -- the SDK-backed sibling of
 * aen-npu-inference-person-mram (which drives the NPU via the raw Arm
 * InferenceProcess wrapper).
 *
 * The whole point: a customer writes only alp_inference_open() / invoke() /
 * get_output().  The AEN Ethos-U backend (src/backends/inference/ethos_u_aen.cpp)
 * supplies the NPU AXI address-remap + SRAM-port config-select strong overrides;
 * the app does NOT hand-write them (contrast the raw sibling, which does).
 *
 * DMA placement (the #1 silicon rule): the Ethos-U is a DMA master that reads
 * the model + arena and writes the output over its own AXI master.  Those
 * buffers MUST live in NPU-reachable global SRAM0 (@0x02000000), NOT the
 * M55-local ITCM/DTCM.  So the model is memcpy'd from rodata into an SRAM0
 * buffer, and the tensor arena is placed in the "SRAM0" linker region; the
 * input/output tensors live inside that arena, so they are SRAM0-resident too.
 *
 * Model: person_detect_u85, Vela-compiled for ethos-u55-128 with the Alif
 * RTSS_HE_SRAM_Only system-config (see CMakeLists.txt / gen_model.py).  ~263
 * KiB -> overflows ITCM, so this image links into MRAM slot0 and boots via
 * Flow D.  RESULT PASS = alp_inference_invoke succeeded AND the NPU actually
 * wrote a non-zero output tensor.
 */

#include <stdbool.h>
#include <stdint.h>
#include <string.h>

#include <zephyr/kernel.h>
#include <zephyr/sys/printk.h>

#include "alp/inference.h"
#include "alp/peripheral.h" /* alp_status_name / alp_last_error */

/* gen_model.py output: networkModelData[], NETWORK_MODEL_LEN,
 * NETWORK_MODEL_NAME, TENSOR_ARENA_SIZE, NPU_ALIGN, TENSOR_ARENA_ATTR
 * (= __aligned(16) section("SRAM0")). */
#include "model.h"

/* Model staged into DMA-reachable SRAM0.  networkModelData[] is const rodata
 * (in MRAM/flash); the NPU reads the fused command stream + weights via its own
 * AXI master, so the executed bytes MUST be in NPU-reachable SRAM0.  An
 * *initialised* array in a custom section is NOT init-copied by Zephyr -> keep
 * the source in rodata and memcpy into this uninitialised SRAM0 buffer. */
static uint8_t model_sram[NETWORK_MODEL_LEN] __aligned(NPU_ALIGN) __attribute__((section("SRAM0")));

/* Tensor arena in SRAM0 (TENSOR_ARENA_ATTR = __aligned(16) section("SRAM0")).
 * The MicroInterpreter lays the input + output tensors inside this arena, so
 * they are NPU-reachable too. */
TENSOR_ARENA_ATTR static uint8_t tensor_arena[TENSOR_ARENA_SIZE];

/* Evidence latched for a SWD symbol read, independent of the console decode. */
volatile int      g_invoke_status = -99;
volatile uint32_t g_out_bytes     = 0;
volatile uint8_t  g_out_first[16] = { 0 };
volatile int      g_argmax        = -1;

int main(void)
{
	printk("\n=== aen-npu-inference-alp (alp_inference_open -> Ethos-U55) ===\n");
	printk("model      : %s (%u bytes)\n", NETWORK_MODEL_NAME, (unsigned)NETWORK_MODEL_LEN);
	printk(
	    "arena      : %u bytes @ SRAM0 (%p)\n", (unsigned)TENSOR_ARENA_SIZE, (void *)tensor_arena);

	/* Stage the Vela model into DMA-reachable SRAM0. */
	memcpy(model_sram, networkModelData, NETWORK_MODEL_LEN);

	/* Open the model through the portable API.  On E8 the AEN Ethos-U backend
	 * (priority 100, silicon_ref alif:ensemble:e8) wins over the portable CPU
	 * TFLM path and dispatches onto the NPU. */
	alp_inference_config_t cfg = {
		.model_data  = model_sram,
		.model_size  = NETWORK_MODEL_LEN,
		.format      = ALP_INFERENCE_MODEL_VELA,
		.backend     = ALP_INFERENCE_BACKEND_AUTO,
		.arena_bytes = TENSOR_ARENA_SIZE,
		.arena       = tensor_arena,
	};
	alp_inference_t *inf = alp_inference_open(&cfg);
	if (inf == NULL) {
		printk("RESULT FAIL: alp_inference_open -> NULL (%s)\n", alp_status_name(alp_last_error()));
		return 0;
	}

	/* Fill the input tensor (zero-filled; a real deployment memcpys a captured
	 * frame here).  The tensor's data lives in the SRAM0 arena. */
	alp_inference_tensor_t in = { 0 };
	alp_status_t           s  = alp_inference_get_input(inf, 0, &in);
	if (s == ALP_OK && in.data != NULL) {
		memset(in.data, 0, in.size_bytes);
	}
	printk(
	    "input      : %u bytes @ %p (%s)\n", (unsigned)in.size_bytes, in.data, alp_status_name(s));

	/* Run inference -- the fused Ethos-U custom op dispatches onto the NPU. */
	s               = alp_inference_invoke(inf);
	g_invoke_status = (int)s;
	if (s != ALP_OK) {
		printk("RESULT FAIL: alp_inference_invoke -> %s\n", alp_status_name(s));
		alp_inference_close(inf);
		return 0;
	}

	alp_inference_tensor_t out = { 0 };
	s                          = alp_inference_get_output(inf, 0, &out);
	if (s != ALP_OK || out.data == NULL) {
		printk("RESULT FAIL: alp_inference_get_output -> %s\n", alp_status_name(s));
		alp_inference_close(inf);
		return 0;
	}
	g_out_bytes = (uint32_t)out.size_bytes;

	/* Scan the output: PASS requires a non-zero tensor (an all-zero output
	 * despite invoke OK would mean the NPU never actually wrote it). */
	const uint8_t *ob          = (const uint8_t *)out.data;
	uint32_t       n           = out.size_bytes < 16u ? (uint32_t)out.size_bytes : 16u;
	bool           any_nonzero = false;
	int            best_i      = -1;
	int            best_v      = -128; /* int8 floor */
	for (uint32_t i = 0; i < out.size_bytes; i++) {
		int8_t v = (int8_t)ob[i];
		if (i < n) {
			g_out_first[i] = (uint8_t)v;
		}
		if (v != 0) {
			any_nonzero = true;
		}
		if (v > best_v) {
			best_v = v;
			best_i = (int)i;
		}
	}
	g_argmax = best_i;

	printk("output     : %u bytes, argmax=%d (val=%d), first=",
	       (unsigned)out.size_bytes,
	       best_i,
	       best_v);
	for (uint32_t i = 0; i < n; i++) {
		printk("%02x ", g_out_first[i]);
	}
	printk("\n");

	if ((out.size_bytes > 0) && any_nonzero) {
		printk("RESULT PASS: NPU inference via alp_inference_open -- model=%s "
		       "out_bytes=%u argmax=%d\n",
		       NETWORK_MODEL_NAME,
		       (unsigned)out.size_bytes,
		       best_i);
	} else {
		printk("RESULT FAIL: output not populated (out_bytes=%u nonzero=%d)\n",
		       (unsigned)out.size_bytes,
		       (int)any_nonzero);
	}

	alp_inference_close(inf);
	return 0;
}
```
