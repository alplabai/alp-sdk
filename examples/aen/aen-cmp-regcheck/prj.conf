## CMakeLists.txt
```
# SPDX-License-Identifier: Apache-2.0
#
# On-silicon HSCMP (analog comparator) validation for the E1M-AEN801 (Alif
# Ensemble E8), driving cmp0@49023000 against the on-chip DAC6 INTERNAL reference
# through the portable Zephyr comparator_* class API over the alp-sdk Tier-2
# comparator_alif driver.  A RAM console carries the PASS/FAIL line; the human
# ALSO reads cmp0 CMP_STATUS / CMP_COMP_REG1 over J-Link to confirm the
# comparator is live independently of any printk.
#
# Internal-reference SMOKE: no external wiring needed (the minus terminal is the
# DAC6 reference).  Comparing against an external pad/threshold is bench config
# and is TBD (see README).
#
# Standalone Zephyr app (no alp_project.py board.yaml flow): build with
#   ZEPHYR_BASE=<zephyr-base> west build \
#     -b alp_e1m_aen801_m55_he/ae822fa0e5597ls0/rtss_he <this-dir> -- \
#     "-DEXTRA_ZEPHYR_MODULES=<alp-sdk>;<hal_alif>"
# Zephyr applies boards/<fully-qualified-board>.overlay by itself.

cmake_minimum_required(VERSION 3.20)

find_package(Zephyr REQUIRED HINTS $ENV{ZEPHYR_BASE})
project(aen_cmp_regcheck LANGUAGES C)

target_sources(app PRIVATE src/main.c)
```

## prj.conf
```kconfig
# SPDX-License-Identifier: Apache-2.0
#
# Bench config for the comparator regcheck on the E1M-AEN801 (M55-HE). The
# console is the E1M edge UART0 (Alif UART5, P3_4/P3_5, 115200 8N1); serial-less
# benches can fall back to the RAM console (see the console block below).

# Tier-2 driver Kconfigs (incl. CONFIG_CMP_ALIF) are gated under ALP_SDK.
CONFIG_ALP_SDK=y

# Comparator subsystem + the Alif "alif,cmp" driver. CONFIG_CMP_ALIF is
# `default y` once the cmp node is enabled (DT_HAS_ALIF_CMP_ENABLED); it
# `select`s PINCTRL and USE_ALIF_HAL_ANALOG (the hal_alif analog_ctrl VREF/clock
# library, shared with ADC_ALIF/DAC_ALIF) itself -- so we only need to turn on
# the comparator API here. Do NOT assign select-only / USE_ALIF_HAL_* symbols;
# the driver handles its own selects.
CONFIG_COMPARATOR=y

# Console: Alp UART console -- E1M edge UART0 (Alif UART5, P3_4/P3_5, 115200
# 8N1, NS16550), the E1M-AEN801 carrier console. The board _defconfig already
# selects it; we set it explicitly here so the example is self-describing.
CONFIG_SERIAL=y
CONFIG_CONSOLE=y
CONFIG_UART_CONSOLE=y
CONFIG_UART_INTERRUPT_DRIVEN=y
# Serial-less bench? Comment the four lines above and uncomment these to read
# 'ram_console_buf' over SWD instead:
# CONFIG_RAM_CONSOLE=y
# CONFIG_RAM_CONSOLE_BUFFER_SIZE=2048
# CONFIG_UART_CONSOLE=n
CONFIG_PRINTK=y

# Keep the image small + deterministic for a RAM-run.
CONFIG_LOG=n
```

## boards/alp_e1m_aen801_m55_he.overlay
```dts
/*
 * Copyright (c) 2026 Alp Lab AB
 * SPDX-License-Identifier: Apache-2.0
 *
 * On-silicon HSCMP validation overlay for the E1M-AEN801 (Alif Ensemble E8,
 * M55-HE), bench RAM-run via J-Link.
 *
 * Validates the alp-sdk Tier-2 comparator_alif driver on cmp0@49023000
 * (compatible "alif,cmp").  The driver binds it as an upstream-Zephyr-v4.4
 * comparator-class device: the SoC dtsi node already sets negative_input =
 * "CMP_NEG_IN3" -> the on-chip DAC6 programmable reference (COMP_HS_IN_M_SEL =
 * 0x3 = DAC6), so the minus terminal has a known INTERNAL reference and the
 * smoke needs NO external wiring.
 *
 * Registers the human reads over J-Link to confirm the comparator is live
 * (ground truth, independent of any printk).  Offsets from the driver register
 * model (zephyr/drivers/comparator/comparator_alif.c), base 0x49023000 from the
 * SoC dtsi node:
 *     CMP_COMP_REG1 = base + 0x00 = 0x49023000  -- bit 28 (COMP_HS_EN) = 1 after init
 *     CMP_STATUS    = base + 0x18 = 0x49023018  -- bit 0  (CMP_VALUE)  = live output
 * mem32 0x49023000 / mem32 0x49023018.
 *
 * BENCH CONFIG (TBD): comparing against an EXTERNAL voltage instead of DAC6 needs
 * the CMP0_IN0..IN3 input pad muxed (a &pinctrl_cmp0 group, not defined in this
 * tree) AND the bench source/threshold wired -- both are bench unknowns on this
 * batch.  Do NOT invent a pinctrl group or a pad mapping.  This overlay keeps the
 * self-contained internal DAC6 reference.
 */

/*
 * MANDATORY bench RAM-run retarget: run from ITCM so J-Link can loadbin+run
 * without programming MRAM, and drop the MCUboot code-partition fixup.
 */
/ {
	chosen {
		/* PATH-REFERENCE form (&itcm), NOT the <&itcm> phandle-array form:
		 * the phandle-array form yields CONFIG_FLASH_SIZE=0 and the image
		 * overflows the (empty) FLASH region at link time. */
		zephyr,flash = &itcm;
		/delete-property/ zephyr,code-partition;
	};
};

/* Enable cmp0 so the comparator_alif driver instantiates a device.  All config
 * (DAC6 negative reference, IRQ 167, hysteresis, filter) is carried by the SoC
 * dtsi node; this overlay only flips it okay. */
&cmp0 {
	status = "okay";
};
```

## boards/alp_e1m_aen803_m55_he_ae822fa0e5597ls0_rtss_he.overlay
```dts
/*
 * Copyright (c) 2026 Alp Lab AB
 * SPDX-License-Identifier: Apache-2.0
 *
 * On-silicon HSCMP validation overlay for the E1M-AEN803 (Alif Ensemble E8,
 * M55-HE), bench RAM-run via J-Link.
 *
 * Validates the alp-sdk Tier-2 comparator_alif driver on cmp0@49023000
 * (compatible "alif,cmp").  The driver binds it as an upstream-Zephyr-v4.4
 * comparator-class device: the SoC dtsi node already sets negative_input =
 * "CMP_NEG_IN3" -> the on-chip DAC6 programmable reference (COMP_HS_IN_M_SEL =
 * 0x3 = DAC6), so the minus terminal has a known INTERNAL reference and the
 * smoke needs NO external wiring.
 *
 * Registers the human reads over J-Link to confirm the comparator is live
 * (ground truth, independent of any printk).  Offsets from the driver register
 * model (zephyr/drivers/comparator/comparator_alif.c), base 0x49023000 from the
 * SoC dtsi node:
 *     CMP_COMP_REG1 = base + 0x00 = 0x49023000  -- bit 28 (COMP_HS_EN) = 1 after init
 *     CMP_STATUS    = base + 0x18 = 0x49023018  -- bit 0  (CMP_VALUE)  = live output
 * mem32 0x49023000 / mem32 0x49023018.
 *
 * BENCH CONFIG (TBD): comparing against an EXTERNAL voltage instead of DAC6 needs
 * the CMP0_IN0..IN3 input pad muxed (a &pinctrl_cmp0 group, not defined in this
 * tree) AND the bench source/threshold wired -- both are bench unknowns on this
 * batch.  Do NOT invent a pinctrl group or a pad mapping.  This overlay keeps the
 * self-contained internal DAC6 reference.
 */

/*
 * MANDATORY bench RAM-run retarget: run from ITCM so J-Link can loadbin+run
 * without programming MRAM, and drop the MCUboot code-partition fixup.
 */
/ {
	chosen {
		/* PATH-REFERENCE form (&itcm), NOT the <&itcm> phandle-array form:
		 * the phandle-array form yields CONFIG_FLASH_SIZE=0 and the image
		 * overflows the (empty) FLASH region at link time. */
		zephyr,flash = &itcm;
		/delete-property/ zephyr,code-partition;
	};
};

/* Enable cmp0 so the comparator_alif driver instantiates a device.  All config
 * (DAC6 negative reference, IRQ 167, hysteresis, filter) is carried by the SoC
 * dtsi node; this overlay only flips it okay. */
&cmp0 {
	status = "okay";
};
```

## src/main.c
```c
/*
 * Copyright (c) 2026 Alp Lab AB
 * SPDX-License-Identifier: Apache-2.0
 *
 * On-silicon analog-comparator (HSCMP) validation for the E1M-AEN801 (Alif
 * Ensemble E8, M55-HE), over the alp-sdk Tier-2 comparator_alif driver (ADR 0017
 * Tier-2, "alif,cmp" -- a clean-room driver implementing the PORTABLE Zephyr
 * comparator class API for cmp0@49023000).
 *
 * What it proves -- INTERNAL-reference smoke (NO external wiring)
 * -------------------------------------------------------------
 * The comparator's negative input is set, in the DT node, to the on-chip DAC6
 * programmable reference (negative_input = "CMP_NEG_IN3" -> COMP_HS_IN_M_SEL =
 * 0x3 = DAC6).  The driver turns DAC6 on through the hal_alif analog_ctrl helper,
 * so the comparator has a known INTERNAL reference on its minus terminal with NO
 * bench wiring.  This app then exercises the comparator over the portable class
 * API and confirms the path is alive on silicon:
 *
 *   1. device readiness   -- the cmp0 node instantiated a comparator device.
 *   2. comparator_get_output() returns a clean 0/1 (NOT an -errno) -- i.e. the
 *      driver read CMP_STATUS.CMP_VALUE through the IP without faulting.
 *   3. comparator_set_trigger(BOTH_EDGES) + a callback are accepted (the IRQ is
 *      wired and the mask register is writable).
 *   4. comparator_set_trigger(NONE) re-masks cleanly.
 *
 * The ABSOLUTE output LEVEL is NOT asserted: the positive input is the CMP0_IN0
 * analog pad, which is UNROUTED on this bench (no external source), so its
 * voltage vs the ~0.9 V DAC6 reference is indeterminate -- whatever bit comes
 * back is REPORTED, not failed.  The PASS gate is "the driver drove the HSCMP IP
 * through the portable comparator_* API and every call returned a valid,
 * non-error result", exactly the bar the ADC regcheck uses for an unrouted pad.
 *
 *   --- over J-Link (ground truth, independent of any printk) ---
 *   mem32 0x49023018 = cmp0 CMP_STATUS; bit 0 (CMP_VALUE) is the live comparator
 *   output.  mem32 0x49023000 = CMP_COMP_REG1; bit 28 (COMP_HS_EN) must read 1
 *   after init (the comparator is enabled).
 *
 * BENCH CONFIG -- the EXTERNAL input pin + threshold (driving CMP0_IN0 from a
 * known voltage and asserting the crossing) is bench wiring that is NOT set here;
 * it is a TBD (see the README).  This smoke deliberately stays self-contained on
 * the internal DAC6 reference.
 *
 * Console is the RAM buffer 'ram_console_buf' (see prj.conf); the bench UART is
 * not wired to USB.  BENCH-VALIDATION app -- not a customer teaching example.
 */

#include <errno.h>
#include <zephyr/kernel.h>
#include <zephyr/device.h>
#include <zephyr/drivers/comparator.h>
#include <zephyr/sys/sys_io.h>

/* The comparator device is the "alif,cmp" node cmp0@49023000; the
 * comparator_alif driver binds it as a Zephyr comparator-class device. */
#define CMP_NODE DT_NODELABEL(cmp0)

/*
 * Raw HSCMP interrupt registers, read directly so the log carries the ONE
 * witness the portable API cannot show.  Both bits of CMP_INTERRUPT_MASK are
 * active-HIGH with reset 0x1 (HWRM 19.3.5.3.9: "By default, interrupt mask is
 * set.  Mask must be cleared to allow interrupt to be driven out."), so an
 * armed trigger must read 0x0 and COMPARATOR_TRIGGER_NONE must read 0x3.
 *
 * The driver used to write 0x01 at both sites, which SET the rising-edge mask
 * and CLEARED the falling-edge one -- arming the interrupt it claimed to be
 * disabling, and leaving a latched FILTER_EVENT1 to re-enter a level-sensitive
 * ISR forever (#1821).  A run of this example on the broken driver prints
 * mask=0x00000001 where it now prints 0x00000000 / 0x00000003.
 */
#define CMP0_BASE             0x49023000U
#define CMP0_INTERRUPT_STATUS (CMP0_BASE + 0x20U)
#define CMP0_INTERRUPT_MASK   (CMP0_BASE + 0x24U)

static void print_int_regs(const char *when)
{
	printk("  %s: CMP_INTERRUPT_MASK=0x%08x  CMP_INTERRUPT_STATUS=0x%08x\n",
	       when,
	       sys_read32(CMP0_INTERRUPT_MASK),
	       sys_read32(CMP0_INTERRUPT_STATUS));
}

static const struct device *const cmp = DEVICE_DT_GET(CMP_NODE);

/* Set by the trigger callback so we can confirm the callback path is wired.
 * volatile: written from ISR context, read from the main loop. */
static volatile uint32_t cb_count;

static void cmp_trigger_cb(const struct device *dev, void *user_data)
{
	ARG_UNUSED(dev);
	ARG_UNUSED(user_data);
	cb_count++;
}

int main(void)
{
	int out0, out1, rc;

	printk("\n=== AEN801 CMP (HSCMP) internal-reference bench "
	       "(comparator_alif / cmp0@49023000) ===\n");

	/* 1. device readiness.  If the cmp0 node did not instantiate a device the
	 *    build would have failed at link (undefined __device_dts_ord_*), so
	 *    reaching here means the device object exists -- check it is ready. */
	if (!device_is_ready(cmp)) {
		printk("RESULT FAIL: cmp device not ready\n");
		return 0;
	}
	printk("cmp device ready (neg input = DAC6 internal reference)\n");
	print_int_regs("after init      ");

	/* 2. read the comparator output through the portable class API.  A valid
	 *    return is exactly 0 or 1; anything negative is an -errno from the
	 *    driver and is a failure.  (The LEVEL itself is not asserted -- the
	 *    plus pad is unrouted on this bench.) */
	out0 = comparator_get_output(cmp);
	printk("comparator_get_output() #1 = %d\n", out0);
	if (out0 < 0) {
		printk("RESULT FAIL: get_output returned -errno %d\n", out0);
		return 0;
	}

	/* --- J-Link readback: mem32 0x49023018 (cmp0 CMP_STATUS, bit0=CMP_VALUE),
	 *     mem32 0x49023000 (CMP_COMP_REG1, bit28=COMP_HS_EN must be 1) --- */

	/* 3. arm an edge trigger + callback: proves the IRQ is wired and the mask
	 *    register is writable.  BOTH_EDGES so any movement on the (unrouted)
	 *    input that does cross the reference would be caught. */
	rc = comparator_set_trigger_callback(cmp, cmp_trigger_cb, NULL);
	printk("comparator_set_trigger_callback() rc=%d\n", rc);
	if (rc != 0) {
		printk("RESULT FAIL: set_trigger_callback rc=%d\n", rc);
		return 0;
	}

	rc = comparator_set_trigger(cmp, COMPARATOR_TRIGGER_BOTH_EDGES);
	printk("comparator_set_trigger(BOTH_EDGES) rc=%d\n", rc);
	print_int_regs("armed BOTH_EDGES");
	if (rc != 0) {
		printk("RESULT FAIL: set_trigger rc=%d\n", rc);
		return 0;
	}

	/* Give the comparator a moment; with an unrouted plus pad we do NOT expect
	 * a guaranteed edge, so cb_count is reported, not asserted. */
	k_msleep(50);

	/* 4. read again, then re-mask cleanly. */
	out1 = comparator_get_output(cmp);
	printk("comparator_get_output() #2 = %d  (callbacks seen=%u)\n", out1, cb_count);
	if (out1 < 0) {
		printk("RESULT FAIL: get_output #2 returned -errno %d\n", out1);
		return 0;
	}

	rc = comparator_set_trigger(cmp, COMPARATOR_TRIGGER_NONE);
	printk("comparator_set_trigger(NONE) rc=%d\n", rc);
	print_int_regs("trigger NONE    ");
	if (rc != 0) {
		printk("RESULT FAIL: set_trigger(NONE) rc=%d\n", rc);
		return 0;
	}

	/* 5. verdict: the HSCMP IP was driven through the full portable
	 *    comparator_* API and every call returned a valid, non-error result.
	 *    The output bit (out0/out1) is informational -- the plus pad is
	 *    unrouted, so the level vs the DAC6 reference is indeterminate. */
	printk("RESULT PASS: comparator_alif drove HSCMP cmp0 via the portable "
	       "comparator_* API (out=%d/%d, internal DAC6 reference, "
	       "external pin/threshold = bench TBD)\n",
	       out0,
	       out1);

	return 0;
}
```
