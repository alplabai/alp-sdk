## CMakeLists.txt
```
# SPDX-License-Identifier: Apache-2.0
#
# On-silicon HWSEM (hardware-semaphore) validation for the E1M-AEN801 (Alif
# Ensemble E8).  Drives the alp-sdk in-tree "alif,hwsem" driver
# (zephyr/drivers/misc/alif_hwsem/hwsem_alif.c) through its take/give API to
# prove a HWSEM latch acquires and releases on silicon.  A RAM console carries
# the PASS/FAIL line; the human ALSO reads the HWSEM REL register over J-Link to
# confirm the count tracks take (->1) and give (->0).
#
# This is a SINGLE-CORE take/give smoke (a valid acquire/release proof on one
# core); the fuller test is DUAL-CORE arbitration (HE takes, HP must see -EBUSY,
# then acquires after HE gives) -- noted in the README, not driven here.
#
# Standalone Zephyr app (no alp_project.py board.yaml flow): build with
#   ZEPHYR_BASE=<zephyr-base> west build \
#     -b alp_e1m_aen801_m55_he/ae822fa0e5597ls0/rtss_he <this-dir> -- \
#     "-DEXTRA_ZEPHYR_MODULES=<alp-sdk>;<hal_alif>"
# The board overlay (boards/alp_e1m_aen801_m55_he_ae822fa0e5597ls0_rtss_he.overlay) auto-applies by the
# fully-qualified board name -- no DTC_OVERLAY_FILE needed.

cmake_minimum_required(VERSION 3.20)

find_package(Zephyr REQUIRED HINTS $ENV{ZEPHYR_BASE})
project(aen_hwsem_regcheck LANGUAGES C)

target_sources(app PRIVATE src/main.c)
```

## prj.conf
```kconfig
# SPDX-License-Identifier: Apache-2.0
#
# Bench config for the HWSEM take/give RAM-run on the E1M-AEN801 (Alif Ensemble
# E8).
#
# Console is the E1M edge UART0.

# --- Console -----------------------------------------------------------------
# Console: Alp UART console -- E1M edge UART0 (Alif UART5, P3_4/P3_5, 115200
# 8N1, NS16550), the E1M-AEN801 carrier console. The board _defconfig already
# selects it; we set it explicitly here so the example is self-describing.
CONFIG_SERIAL=y
CONFIG_CONSOLE=y
CONFIG_UART_CONSOLE=y
CONFIG_UART_INTERRUPT_DRIVEN=y
# Serial-less bench? Comment the four lines above and uncomment these to read
# 'ram_console_buf' over SWD instead:
# CONFIG_RAM_CONSOLE=y
# CONFIG_RAM_CONSOLE_BUFFER_SIZE=2048
# CONFIG_UART_CONSOLE=n
CONFIG_PRINTK=y

# --- HWSEM driver ------------------------------------------------------------
# CONFIG_HWSEM_ALIF (the in-tree alif,hwsem driver) is `default y` once the
# okay'd "alif,hwsem" node (hwsem@4902e000) exists, so ALP_SDK MUST be on to
# surface it (the driver is wired in via zephyr/CMakeLists.txt under ALP_SDK).
CONFIG_ALP_SDK=y

# Keep the image small + deterministic for a RAM-run.
CONFIG_LOG=n
```

## boards/alp_e1m_aen801_m55_he.overlay
```dts
/*
 * Copyright (c) 2026 Alp Lab AB
 * SPDX-License-Identifier: Apache-2.0
 *
 * On-silicon HWSEM validation overlay for the E1M-AEN801 (Alif Ensemble E8,
 * M55-HE), bench RAM-run via J-Link.
 *
 * Validates the alp-sdk in-tree "alif,hwsem" driver
 * (zephyr/drivers/misc/alif_hwsem/hwsem_alif.c) on HWSEM instance 0
 * (hwsem@4902e000).  The driver binds it as a bare register window (no Zephyr
 * device class -- HWSEM has none) and exposes a take/give API (hwsem_alif.h):
 * an atomic request/release latch keyed by a per-core MASTER ID.
 *
 * HWSEM register the human reads over J-Link to confirm the take/give tracks
 * (ground truth, independent of any printk).  Offsets from the driver header
 * zephyr/drivers/misc/alif_hwsem/hwsem_alif.c (transcribed from the Alif DFP
 * struct HWSEM_Type):
 *     REL (release/count) = base + HWSEM_REL_REG(0x04) = 0x4902E004
 * mem32 0x4902E004 should read 0 (free) -> 1 (after take) -> 0 (after give).
 */

/*
 * MANDATORY bench RAM-run retarget: run from ITCM so J-Link can loadbin+run
 * without programming MRAM, and drop the MCUboot code-partition fixup.
 */
/ {
	chosen {
		/* PATH-REFERENCE form (&itcm), NOT the <&itcm> phandle-array form:
		 * the phandle-array form yields CONFIG_FLASH_SIZE=0 and the image
		 * overflows the (empty) FLASH region at link time. */
		zephyr,flash = &itcm;
		/delete-property/ zephyr,code-partition;
	};
};

/* Enable HWSEM instance 0 so the alif,hwsem driver instantiates a device.
 * reg = <0x4902e000 0x10> comes from the dtsi node (transcribed from the Alif
 * DFP HWSEM0_BASE 0x4902E000); the bench reads HWSEM REL at 0x4902E004. */
&hwsem0 {
	status = "okay";
};
```

## boards/alp_e1m_aen803_m55_he_ae822fa0e5597ls0_rtss_he.overlay
```dts
/*
 * Copyright (c) 2026 Alp Lab AB
 * SPDX-License-Identifier: Apache-2.0
 *
 * On-silicon HWSEM validation overlay for the E1M-AEN803 (Alif Ensemble E8,
 * M55-HE), bench RAM-run via J-Link.
 *
 * Validates the alp-sdk in-tree "alif,hwsem" driver
 * (zephyr/drivers/misc/alif_hwsem/hwsem_alif.c) on HWSEM instance 0
 * (hwsem@4902e000).  The driver binds it as a bare register window (no Zephyr
 * device class -- HWSEM has none) and exposes a take/give API (hwsem_alif.h):
 * an atomic request/release latch keyed by a per-core MASTER ID.
 *
 * HWSEM register the human reads over J-Link to confirm the take/give tracks
 * (ground truth, independent of any printk).  Offsets from the driver header
 * zephyr/drivers/misc/alif_hwsem/hwsem_alif.c (transcribed from the Alif DFP
 * struct HWSEM_Type):
 *     REL (release/count) = base + HWSEM_REL_REG(0x04) = 0x4902E004
 * mem32 0x4902E004 should read 0 (free) -> 1 (after take) -> 0 (after give).
 */

/*
 * MANDATORY bench RAM-run retarget: run from ITCM so J-Link can loadbin+run
 * without programming MRAM, and drop the MCUboot code-partition fixup.
 */
/ {
	chosen {
		/* PATH-REFERENCE form (&itcm), NOT the <&itcm> phandle-array form:
		 * the phandle-array form yields CONFIG_FLASH_SIZE=0 and the image
		 * overflows the (empty) FLASH region at link time. */
		zephyr,flash = &itcm;
		/delete-property/ zephyr,code-partition;
	};
};

/* Enable HWSEM instance 0 so the alif,hwsem driver instantiates a device.
 * reg = <0x4902e000 0x10> comes from the dtsi node (transcribed from the Alif
 * DFP HWSEM0_BASE 0x4902E000); the bench reads HWSEM REL at 0x4902E004. */
&hwsem0 {
	status = "okay";
};
```

## src/main.c
```c
/*
 * Copyright (c) 2026 Alp Lab AB
 * SPDX-License-Identifier: Apache-2.0
 *
 * On-silicon HWSEM (hardware-semaphore) validation for the E1M-AEN801 (Alif
 * Ensemble E8) over the alp-sdk in-tree "alif,hwsem" driver (ADR 0017
 * vendor-native custom -- the Alif HWSEM IP has no upstream Zephyr class and no
 * hal_alif library, so the driver is authored clean-room from the Alif DFP
 * HWSEM register header).  HWSEM is the AMP mutual-exclusion primitive the two
 * RTSS cores (M55-HE <-> M55-HP) use to lock a shared resource.
 *
 * What it proves
 * --------------
 * Take then give HWSEM instance 0 through the driver's take/give API and confirm
 * the latch's REL count tracks the operations on silicon, two independent ways:
 *
 *   1. in-firmware:  this app reads the baseline count (free latch -> 0), takes
 *      the latch once (count -> nonzero), gives it back (count -> 0), and prints
 *      every API return code + a single
 *      'RESULT PASS:' / 'RESULT FAIL:' line.
 *   2. over J-Link:  the human reads the HWSEM REL register with mem32
 *      (0x4902E004 = base 0x4902E000 + REL 0x04, see the overlay) across the
 *      same window -- the ground truth on silicon, independent of any printk.
 *
 * SINGLE-CORE smoke, by design.  Acquire/release on ONE core is a valid HWSEM
 * proof: the request register grants ownership, the count increments, and the
 * release frees it.  It does NOT exercise cross-core ARBITRATION (HE owns ->
 * HP's take returns -EBUSY -> HP acquires only after HE gives), which needs a
 * real second-core sender and a dual-core SES boot -- see the README.  The
 * MASTER ID below is the M55-HE CPUID; a dual-core test would run a peer with
 * the M55-HP CPUID against the SAME latch.
 *
 * Console is the RAM buffer 'ram_console_buf' (see prj.conf); the bench UART is
 * not wired to USB.  BENCH-VALIDATION app -- not a customer teaching example.
 */

#include <errno.h>
#include <zephyr/kernel.h>
#include <zephyr/device.h>

/* The in-tree alif,hwsem driver's take/give API (no standard Zephyr class). The
 * header dir is put on the include path by zephyr/CMakeLists.txt when
 * CONFIG_HWSEM_ALIF is set. */
#include "hwsem_alif.h"

/* The HWSEM device is the "alif,hwsem" node (hwsem@4902e000); the alif,hwsem
 * driver binds it directly. */
#define HWSEM_NODE DT_NODELABEL(hwsem0)

/*
 * MASTER ID for THIS core.  The HWSEM latch is keyed by the caller's CPUID, and
 * a release only frees the latch for its owner -- so HE and HP MUST use
 * distinct ids.  This value is the M55-HE CPUID, transcribed CLEAN-ROOM from
 * the Alif DFP Device/soc/AE822FA0E5597/include/rtss_he/core_defines.h:
 *   #define HWSEM_MASTERID (0x410FD222)
 * (the M55-HP peer uses 0x410FD221, from .../rtss_hp/core_defines.h -- a
 * dual-core arbitration test would run the peer with that id; see the README).
 */
#define HWSEM_MASTER_ID_HE 0x410FD222U /* DFP rtss_he/core_defines.h HWSEM_MASTERID */

/* Bounded spin budget for the take retry (a peer-owned latch frees on the
 * peer's give; the bound keeps an absent peer from hanging us). */
#define HWSEM_TAKE_SPINS 100000U

static const struct device *const hwsem = DEVICE_DT_GET(HWSEM_NODE);

int main(void)
{
	int      rc;
	uint32_t count_free, count_taken, count_given;

	printk("\n=== AEN801 HWSEM take/give bench "
	       "(alif,hwsem / hwsem@4902e000) ===\n");

	/* 1. device readiness.  If the HWSEM node did not instantiate a device the
	 *    build would have failed at link (undefined __device_dts_ord_*), so
	 *    reaching here means the device object exists -- check it is ready. */
	if (!device_is_ready(hwsem)) {
		printk("RESULT FAIL: hwsem device not ready\n");
		return 0;
	}
	printk("hwsem device ready (master_id=0x%08x)\n", HWSEM_MASTER_ID_HE);

	/* 2. baseline count.  A free latch reads REL count == 0.  If it is nonzero
	 *    here a previous owner left it held -- reset to a known-free state so the
	 *    smoke starts clean (reset is the recovery path, not normal flow). */
	rc = hwsem_alif_get_count(hwsem, &count_free);
	printk("hwsem_alif_get_count() #1 rc=%d  count=%u\n", rc, count_free);
	if (rc != 0) {
		printk("RESULT FAIL: get_count #1 rc=%d\n", rc);
		return 0;
	}
	if (count_free != 0U) {
		printk("note: latch not free at start (count=%u); resetting\n", count_free);
		(void)hwsem_alif_reset(hwsem);
		(void)hwsem_alif_get_count(hwsem, &count_free);
		printk("hwsem_alif_get_count() after reset count=%u\n", count_free);
	}

	/* --- J-Link readback window #1: mem32 0x4902E004 (HWSEM REL) -> 0 --- */

	/* 3. TAKE the latch.  On a free latch the request register grants ownership
	 *    immediately, so the bounded spin returns 0 on the first attempt. */
	rc = hwsem_alif_take_busy(hwsem, HWSEM_MASTER_ID_HE, HWSEM_TAKE_SPINS);
	printk("hwsem_alif_take_busy() rc=%d\n", rc);
	if (rc != 0) {
		printk("RESULT FAIL: take rc=%d (latch peer-owned or device error)\n", rc);
		return 0;
	}

	/* 4. count after take.  An owned latch reads REL count != 0. */
	rc = hwsem_alif_get_count(hwsem, &count_taken);
	printk("hwsem_alif_get_count() #2 rc=%d  count=%u (expect nonzero)\n", rc, count_taken);
	if (rc != 0) {
		printk("RESULT FAIL: get_count #2 rc=%d\n", rc);
		return 0;
	}

	/* --- J-Link readback window #2: mem32 0x4902E004 (HWSEM REL) -> nonzero --- */

	/* 5. GIVE the latch back.  A release by the owner decrements the count; one
	 *    take + one give returns it to free (count 0). */
	rc = hwsem_alif_give(hwsem, HWSEM_MASTER_ID_HE);
	printk("hwsem_alif_give() rc=%d\n", rc);
	if (rc != 0) {
		printk("RESULT FAIL: give rc=%d\n", rc);
		return 0;
	}

	/* 6. count after give.  A freed latch reads REL count == 0 again. */
	rc = hwsem_alif_get_count(hwsem, &count_given);
	printk("hwsem_alif_get_count() #3 rc=%d  count=%u (expect 0)\n", rc, count_given);
	if (rc != 0) {
		printk("RESULT FAIL: get_count #3 rc=%d\n", rc);
		return 0;
	}

	/* --- J-Link readback window #3: mem32 0x4902E004 (HWSEM REL) -> 0 --- */

	/* 7. verdict: a working HWSEM latch must read free(0) at start, owned
	 *    (nonzero) after take, and free(0) again after give. */
	if (count_taken != 0U && count_given == 0U) {
		printk("RESULT PASS: hwsem take/give works "
		       "(free=%u taken=%u given=%u)\n",
		       count_free,
		       count_taken,
		       count_given);
	} else {
		printk("RESULT FAIL: hwsem count did not track take/give "
		       "(free=%u taken=%u given=%u) -- expected taken!=0 && given==0; "
		       "check the REL register (0x4902E004) over J-Link\n",
		       count_free,
		       count_taken,
		       count_given);
	}

	return 0;
}
```
