## CMakeLists.txt
```
# SPDX-License-Identifier: Apache-2.0
#
# aen-evk-demo -- phased full-board demo for the E1M-AEN801 (Alif Ensemble
# E8, M55-HE) on the E1M EVK carrier, bench RAM-run via J-Link.
#
# Standalone Zephyr app (no alp_project.py board.yaml flow): every bus this
# app touches (BRD_I2C / SoC I2C0, the carrier's SoC I2C2) is already
# enabled by the BOARD layer (metadata/e1m_modules/aen/on-module-links.yaml,
# metadata/pinmux/aen.yaml) -- see the sibling aen-rtc-control2-probe /
# aen-sensor-int-probe / aen-brd-i2c-scan apps for the same argument made in
# full. Only the RGB LED's three PWM channels need this app's OWN overlay,
# because nothing in the board tree enables PWM today (the pwm_alif_utimer.c
# driver is INTERIM / BENCH-UNVERIFIED -- see its file header). Build with
#   ZEPHYR_BASE=<zephyr-base> west build \
#     -b alp_e1m_aen801_m55_he/ae822fa0e5597ls0/rtss_he <this-dir> -- \
#     "-DEXTRA_ZEPHYR_MODULES=<alp-sdk>;<hal_alif>"

cmake_minimum_required(VERSION 3.20)

# Bench-only discriminator for the TAS2563 fault-pin arming (#2182): seeds
# INT_MASK0, calls tas2563_arm_fault_irq(), and reads the register back to
# tell a real read-modify-write apart from a blind write that happens to
# land on the same byte -- then drives a real TDM-clock-fault stimulus
# through the pin. OFF by default; mirrors
# examples/connectivity/firmware-update-log's
# ALP_AEN_UPDATE_LOG_FIREWALL_PROBE CACHE BOOL gate.
set(ALP_AEN_EVK_DEMO_PROBE_FAULT_PIN OFF CACHE BOOL
    "Build the TAS2563 fault-pin seeded-RMW probe + TDM-clock-fault stimulus (#2182)")

find_package(Zephyr REQUIRED HINTS $ENV{ZEPHYR_BASE})
project(aen_evk_demo LANGUAGES C)

if(ALP_AEN_EVK_DEMO_PROBE_FAULT_PIN)
  message(STATUS "aen-evk-demo TAS2563 fault-pin probe enabled")
  target_compile_definitions(app PRIVATE ALP_AEN_EVK_DEMO_PROBE_FAULT_PIN=1)
endif()

target_sources(app PRIVATE src/main.c)
# Phase 8's CC3501E bring-up. cc3501e_bridge.{c,h} is the SoM bring-up TEMPLATE
# every AEN application copies verbatim (see its header): it opens the
# inter-chip SPI bridge + the WIFI_EN / nRESET control pins, enables the LP-pad
# output drivers pinctrl does not reach, binds the READY line, and runs the
# power + reset sequence. Byte-identical to the copies in
# examples/aen/aen-cc3501e-bringup, -gpio, -companion-tour, -ble-gatt and
# -gatt-register -- copied rather than reached across into, because an example
# that reads its sources out of a sibling example is not a copyable template.
target_sources(app PRIVATE src/cc3501e_bridge.c)
# Phase 9's one proxied pad: the E1M IO20 -> raw CC3501E GPIO_26 route the SDIO
# mux ENABLE rides. Strong override of the WEAK cc3501e_gpio_routes[] in
# src/backends/gpio/cc3501e_proxy_routes_weak.c. Built unconditionally; only
# consulted when CONFIG_ALP_SDK_GPIO_CC3501E_PROXY is set (prj.conf). Unlike
# the sibling CC3501E examples this file is hand-written rather than emitted by
# scripts/gen_cc3501e_gpio_routes.py -- that generator keys off a board.yaml
# this standalone app does not have; see the file's own header for how it is
# pinned to metadata instead.
target_sources(app PRIVATE src/cc3501e_gpio_routes.c)
```

## prj.conf
```kconfig
# SPDX-License-Identifier: Apache-2.0
#
# Bench config for aen-evk-demo on the E1M-AEN801 (Alif Ensemble E8, M55-HE).

# --- Console -----------------------------------------------------------------
# Console: Alp UART console -- E1M edge UART0 (Alif UART5, P3_4/P3_5, 115200
# 8N1, NS16550), the E1M-AEN801 carrier console. The board _defconfig already
# selects it; we set it explicitly here so the example is self-describing.
# THIS BENCH PLACE HAS NO SE-UART AND ITS APP UART EMITS NOTHING
# under the Flow C RAM-run this app targets -- comment the four lines below
# and uncomment the RAM_CONSOLE pair to read 'ram_console_buf' over SWD
# instead, the same toggle every sibling AEN bench app documents.
CONFIG_SERIAL=y
CONFIG_CONSOLE=y
CONFIG_UART_CONSOLE=y
CONFIG_UART_INTERRUPT_DRIVEN=y
# CONFIG_RAM_CONSOLE=y
# CONFIG_RAM_CONSOLE_BUFFER_SIZE=4096
# CONFIG_UART_CONSOLE=n
CONFIG_PRINTK=y

# --- I2C + chip drivers -------------------------------------------------------
# CONFIG_ALP_SDK turns on the alp-sdk Zephyr backend (alp_i2c_open /
# alp_i2c_write_read etc, src/backends/i2c/zephyr_drv.c) every chip driver
# below calls into. Each chip driver is opt-in (zephyr/kconfigs/chips.kconfig)
# and carries no Kconfig default, so every one this app calls must be set
# explicitly:
#   CHIP_RV3028C7      -- BRD_I2C RTC                    (phase 1)
#   CHIP_TMP112        -- BRD_I2C temperature sensor      (phase 1)
#   CHIP_ICM42670      -- carrier-bus IMU                 (phase 2)
#   CHIP_BMI323        -- carrier-bus IMU                 (phase 2)
#   CHIP_BMP581        -- carrier-bus barometer            (phase 2)
#   CHIP_INA236        -- six carrier-bus rail monitors     (phase 3)
#   CHIP_TCAL9538      -- carrier-bus I/O expander          (phase 4)
#   CHIP_EEPROM_24C128 -- carrier-bus manifest EEPROM       (phase 5)
CONFIG_ALP_SDK=y
CONFIG_ALP_SDK_CHIP_RV3028C7=y
CONFIG_ALP_SDK_CHIP_TMP112=y
CONFIG_ALP_SDK_CHIP_ICM42670=y
CONFIG_ALP_SDK_CHIP_BMI323=y
CONFIG_ALP_SDK_CHIP_BMP581=y
CONFIG_ALP_SDK_CHIP_INA236=y
CONFIG_ALP_SDK_CHIP_TCAL9538=y
CONFIG_ALP_SDK_CHIP_EEPROM_24C128=y
CONFIG_I2C=y
CONFIG_PINCTRL=y

# --- SoM identity manifest (issue #2144) --------------------------------------
# This app has no board.yaml, so scripts/alp_orchestrate.py never emits
# CONFIG_ALP_SDK_HW_INFO_EEPROM_I2C_BUS_ID / CONFIG_ALP_SDK_SOM_HW_REV --
# both default to "disabled" / "" (see zephyr/kconfigs/hw-info.kconfig,
# zephyr/kconfigs/core.kconfig). Set explicitly here so
# src/backends/gpio/cc3501e_proxy.c's per-pin revision-dependent guard (phase
# 9's IO20 is revision-independent and unaffected either way; phase 11's IO8
# IS revision-dependent -- see cc3501e_gpio_routes.c) can confirm this
# module's hw_rev instead of failing closed on every open of IO8:
#
#   HW_INFO_EEPROM_I2C_BUS_ID=0 -- bus_id 0 is EVK_I2C_BUS_SENSORS /
#     ALP_E1M_I2C0 (SoC I2C2 bridge/DNP-selected onto the E1M portable I2C0
#     pads), the SAME physical bus phase 5 (phase_eeprom_identity) already
#     reads the raw manifest from via ctx->carrier_bus -- see
#     metadata/e1m_modules/E1M-AEN801.yaml's `e1m_i2c0` block. ADDR_7BIT and
#     OFFSET stay at their Kconfig defaults (0x50, 0) -- also what phase 5
#     hardcodes.
#   SOM_HW_REV -- the hw_rev src/cc3501e_gpio_routes.c's cc3501e_gpio_routes[]
#     table was hand-written for (see that file's header): the AEN family's
#     composed EEPROM hw_rev field is "<board_datecode>-<rev key>"
#     (metadata/e1m_modules/aen/hw-revisions.yaml's board_datecode comment;
#     scripts/program_eeprom.py composes it identically), so this must be
#     "2626-r2", not the bare "r2" -- alp_hw_info_assert_matches_build()
#     compares against the manifest's own field verbatim.
#
# PRECONDITION, stated plainly: this only lets IO8 route if the module
# actually carries a CRC-valid manifest reporting hw_rev "2626-r2". A
# factory-fresh or unprovisioned module still fails closed (ALP_ERR_NOSUPPORT
# on IO8) -- correctly, since there would be nothing to confirm it's r2 at
# all. Before relying on this for the silicon check (IO8 + IO20 both route on
# this bench place), confirm on the bench that phase 5 reports magic=OK
# family=OK hw_rev="2626-r2" -- see the bench recipe this issue's report
# cites.
CONFIG_ALP_SDK_HW_INFO_EEPROM_I2C_BUS_ID=0
# The Kconfig default (zephyr/kconfigs/hw-info.kconfig) is 100000 (standard-mode).
# ctx.carrier_bus -- the SAME physical bus/controller as this manifest read,
# per the comment above -- is opened at 100000 Hz (see main()'s
# alp_i2c_open(carrier bus) call), and src/backends/i2c/zephyr_drv.c's
# z_open() reconfigures the shared controller's live bitrate on every
# alp_i2c_open() call (.close = NULL never restores it -- no teardown to
# restore TO). The default already equals that rate, so this line is a pin,
# not a change: it keeps phase 5/8's manifest read (via alp_hw_info_read() ->
# its own alp_i2c_open()) at 100 kHz even if the Kconfig default is raised
# later, rather than leaving I2C2 at a faster rate for the rest of the app's
# lifetime, including phase 11's TAS2563 init over the same carrier_bus --
# only 100 kHz is bench-validated on this bus. Match it explicitly.
CONFIG_ALP_SDK_HW_INFO_EEPROM_I2C_BITRATE_HZ=100000
CONFIG_ALP_SDK_SOM_HW_REV="2626-r2"

# --- Rotary encoder (phase 7) --------------------------------------------------
# CONFIG_QDEC_ALIF (the vendored UTIMER quadrature decoder, arms channel 12 /
# QEC0 at init -- see the overlay's utimer12/qdec node) is `default y` once
# that node is enabled, and needs only the sensor subsystem turned on here.
CONFIG_SENSOR=y

# --- PWM (RGB LED, phase 6) ---------------------------------------------------
# alp_pwm_open() dispatches to src/backends/pwm/zephyr_drv.c, which needs the
# Zephyr PWM driver class on. The pwm-leds consumer nodes the app overlay adds
# (evk_rgb_red/blue/green) bind Zephyr's upstream led_pwm driver so their
# `pwms` phandle is instantiated for PWM_DT_SPEC_GET to resolve.
CONFIG_PWM=y
CONFIG_LED=y
CONFIG_LED_PWM=y

# --- CC3501E Wi-Fi/BLE coprocessor (phase 8) ----------------------------------
# The host-side bridge driver (chips/cc3501e/*.c) plus the two peripheral
# classes it rides on: SPI for the inter-chip link (bus 1 -> the alp-spi1 alias
# this app's overlay adds) and GPIO for WIFI_EN / nRESET / READY. Kconfig
# already enforces `depends on SPI && GPIO`; both are set explicitly here
# because this app has no board.yaml `peripherals:` block to generate them --
# it is a standalone Zephyr app (see scripts/gen_example_alp_conf.py).
CONFIG_SPI=y
CONFIG_GPIO=y
CONFIG_ALP_SDK_CHIP_CC3501E=y

# CONFIG_ALP_SDK_GPIO_CC3501E_PROXY IS ENABLED, AND IT IS PHASE 9 THAT NEEDS IT.
# This block used to say the proxy was deliberately off because "phase 8 makes
# no proxied-GPIO call and the proxy needs a route table this app does not
# carry". The first half is still true -- phase 8 drives WIFI_EN / nRESET,
# which are Alif pads, not proxied ones. The second half stopped being true
# when phase 9 landed: the SD card's 74LVC157 mux ENABLE is E1M IO20, which
# reaches CC3501E GPIO_26 and is therefore only drivable over the bridge, so
# this app now carries src/cc3501e_gpio_routes.c. With the proxy off, an
# alp_gpio_open(ALP_E1M_GPIO_IO20) would silently DELEGATE to the Alif's own
# GPIO driver and drive a pad that is not connected to the mux -- no error,
# and a card that never enumerates.
CONFIG_ALP_SDK_GPIO_CC3501E_PROXY=y

# NOT enabled, deliberately:
#   CONFIG_SPI_DW_ALIF_USE_DMA -- see the overlay's phase-8 block: every frame
#     this phase sends is far below the DMA threshold.
#
# ENABLED WITHOUT A LINE HERE, and worth knowing about: setting
# ALP_SDK_CHIP_CC3501E above also turns ON CONFIG_ALP_SDK_WIFI_CC3501E and
# CONFIG_ALP_SDK_BLE_CC3501E -- both are `default y if ALP_SDK_CHIP_CC3501E`
# (zephyr/kconfigs/iot-audio-inference.kconfig,
# zephyr/kconfigs/ble-security.kconfig), so they are in this image and
# cc3501e_bridge.c's alp_wifi_cc3501e_attach() / alp_ble_cc3501e_attach()
# calls really do run. They register the coprocessor as the portable
# <alp/iot.h> / <alp/ble.h> backend, which phase 8 itself does not use (it
# calls the chip driver directly -- this IS the SoM's own coprocessor
# bring-up, not portable application code). Left at their default rather than
# forced off: that default is what every other AEN application ships, and
# diverging from it here would make this example teach the wrong shape.

# The CC3501E reset sequence sleeps out a ~900 ms boot budget and the driver
# keeps its scratch buffers inside the (static) cc3501e_t rather than on the
# stack, so this is headroom for the phase's own locals, not a tuned minimum.
# It is NOT the 32768 aen-cc3501e-bringup sets: that app puts its cc3501e_t --
# ~32 KB -- on main()'s stack and would blow PSPLIM without it. Phase 8's
# handle is static for exactly that reason, so the stack stays small.
CONFIG_MAIN_STACK_SIZE=4096

# --- SD card (phase 9) --------------------------------------------------------
# ALP-SDK DELTA (#2051), not upstream: no Kconfig here any more. sdhc0 stays
# DISABLED on this board (the maintainer's decision to keep SD off entirely
# on the E1M-EVK 2626-R2 -- see the overlay and phase_sdcard()'s SAFETY
# comment in src/main.c), so CONFIG_SDHC_DWC (`depends on
# DT_HAS_SNPS_DWC_SDHC_ENABLED`) never builds regardless of what is set
# here, and the phase never reaches disk_access_init()/fs_mount(). Removing
# CONFIG_FILE_SYSTEM/CONFIG_FAT_FILESYSTEM_ELM also drops this app's
# dependency on the `fatfs` west module entirely.

# --- Ethernet (phase 10) ------------------------------------------------------
# CONFIG_ETH_DWMAC_ALIF selects the upstream eth_dwmac core and builds the
# alp-sdk Tier-1.5 `alif,ethernet` glue against the ethernet@48100000 node this
# app's overlay enables. IPv4 only -- the phase's proof is a DHCPv4 lease and
# IPv6 would only cost image for nothing here.
CONFIG_NETWORKING=y
CONFIG_NET_L2_ETHERNET=y
CONFIG_ETH_DWMAC_ALIF=y
CONFIG_NET_IPV4=y
CONFIG_NET_IPV6=n
CONFIG_NET_UDP=y

# AUTO_INIT OFF ON PURPOSE. Zephyr's net-config would try to bring the
# interface up and start DHCP during boot -- i.e. before phase 10 runs, with
# nothing on the wire yet on a bench where the cable may not be plugged in, and
# with its result landing nowhere the phase framework can see. Phase 10 drives
# net_if_up() and net_dhcpv4_start() itself so the verdict is its own.
CONFIG_NET_CONFIG_AUTO_INIT=n

# The end-to-end link proof: a real DHCPv4 lease. NET_MGMT + its event layer are
# what the DHCP client is built on.
CONFIG_NET_DHCPV4=y
CONFIG_NET_MGMT=y
CONFIG_NET_MGMT_EVENT=y

# PINNED, NOT LEFT AT THE DEFAULT. Per RFC 2131 4.4.1 the client waits a random
# interval before its first DISCOVER, and Zephyr's default cap is 10 s -- which
# would spend most of the phase's ~15 s DHCP window doing nothing and turn a
# perfectly good bench segment into a spurious "no DHCP server" SKIPPED. 2 is
# the Kconfig minimum (range 2..10), leaving the bulk of the window for the
# actual DISCOVER/OFFER/REQUEST/ACK exchange. Spec-conformant either way; this
# only narrows the jitter.
CONFIG_NET_DHCPV4_INITIAL_DELAY_MAX=2

# DHCP needs sys_rand_get() for its transaction IDs and no HW RNG is wired on
# this target, so take the timer PRNG. TEST_RANDOM_GENERATOR is the Kconfig
# choice that enables the non-cryptographic entropy source; that is fine for a
# DHCP xid on a bench link test and would NOT be for anything security-bearing.
CONFIG_TEST_RANDOM_GENERATOR=y

# Packet/buffer pool. These net_bufs are what the GMAC DMA writes into,
# which now shares phase 13's 64 KiB SRAM0 linker window (see the overlay's
# SYSTEM-RAM PLACEMENT block) rather than the whole-RAM move
# aen-ethernet-link's first cut used.
#
# CONFIG_NET_BUF_RX_COUNT/TX_COUNT are trimmed to 6 here, NOT 16 like
# aen-ethernet-link: with CONFIG_NET_BUF_DATA_SIZE=1536 (below this app
# also gets ETH_DWMAC_ALIF's default -- see
# zephyr/kconfigs/vendor-alif-peripherals.kconfig), 16+16 buffers of 1536 B
# each (49152 B) plus phase 13's JPEG buffers (14336 B) plus the descriptor
# rings (512 B) plus the fixed net_buf/net_pkt-slab bookkeeping overflowed
# the 64 KiB SRAM0 window by 320 B (measured: `region 'SRAM0' overflowed by
# 320 bytes`, a hard link error, not a silent failure). Phase 10's proof is
# a DHCPv4 lease, not sustained payload throughput -- aen-ethernet-link
# (silicon-verified with a 1536 B fragment size and 16+16 buffers on
# E1M-AEN803, bench run 202) is the app that stresses that path -- so 6+6
# buffers is ample for a handful of DHCP exchange packets and fits this
# app's window with margin.
CONFIG_NET_PKT_RX_COUNT=8
CONFIG_NET_PKT_TX_COUNT=8
CONFIG_NET_BUF_RX_COUNT=6
CONFIG_NET_BUF_TX_COUNT=6

# Per-interface RX byte counters. The phase prints them because they are how a
# reader tells a segment that is merely quiet apart from an RX path that is
# dead -- rx_bytes stuck at 0 with the wire link up is the exact signature of
# the DMA-buffers-in-DTCM bug the overlay's placement block exists to prevent.
CONFIG_NET_STATISTICS=y
CONFIG_NET_STATISTICS_PER_INTERFACE=y

# --- TAS2563 amps (phase 11) ---------------------------------------------------
# TAS2563 x2 over I2C is always exercised. I2S3 (over the 74LVC157 mux) and
# the HP PDM (2 of the EVK's 4 MP34DT05 mics) via <alp/audio.h> are compiled
# in but only OPENED when AEN_EVKDEMO_SOUND_PLAYBACK is set to 1 in
# src/main.c -- off by default on this board revision; see phase 11's row in
# README.md for why. CONFIG_ALP_SDK_AUDIO_IN is `default y if AUDIO_DMIC` and
# CONFIG_ALP_SDK_AUDIO_OUT is `default y if I2S`
# (zephyr/kconfigs/iot-audio-inference.kconfig) -- both come on for free from
# the two lines below, no separate line needed.
CONFIG_I2S=y
CONFIG_AUDIO=y
CONFIG_AUDIO_DMIC=y
CONFIG_ALP_SDK_CHIP_TAS2563=y

# The I2S TX slab (alp_i2s_open(), src/backends/i2s/zephyr_drv.c) is
# k_malloc'd -- a 2-block ping-pong slab at 256 stereo S16 frames/block is
# 2048 B total (256 frames x 2 channels x 2 bytes x 2 blocks). The
# PDM/audio_in slab is a static BSS array (CONFIG_ALP_SDK_AUDIO_BLOCK_BYTES *
# _IN_SLAB_BLOCKS, no heap), so this only has to cover the I2S side plus
# headroom. This k_malloc only happens with AEN_EVKDEMO_SOUND_PLAYBACK=1 --
# with it at the default 0, alp_i2s_open() is never called and this pool
# stays unused by phase 11.
CONFIG_HEAP_MEM_POOL_SIZE=4096

# Phase 11's r1/r2 hw_rev gate (hw_rev_verdict.h, issue #2138) calls the SDK's
# own alp_hw_info_read() rather than a second hand-rolled EEPROM read, so it
# gets magic/schema_version/CRC32 validation for free. That surface is a
# no-op (returns ALP_ERR_NOSUPPORT, refuses everything) unless its EEPROM bus
# is configured -- CONFIG_ALP_SDK_HW_INFO_EEPROM_I2C_BUS_ID defaults to -1
# (disabled). 0 is EVK_I2C_BUS_SENSORS / ALP_E1M_I2C0, the SAME portable bus
# id phase 5's ctx->carrier_bus already opens to read this identical EEPROM
# manifest at 0x50 (CONFIG_ALP_SDK_HW_INFO_EEPROM_ADDR_7BIT's default) --
# confirmed against metadata/e1m_modules/E1M-AEN801.yaml's `e1m_i2c0:` block.
# Bitrate pinned to 100 kHz, matching ctx->carrier_bus's own alp_i2c_open()
# call in main(), rather than left to this Kconfig's default (100 kHz today): both
# opens reconfigure the SAME physical Alif I2C2 controller on open()
# (src/backends/i2c/zephyr_drv.c z_open() calls i2c_configure() every time,
# globally, not per-handle), so leaving them mismatched would silently
# reclock every OTHER phase's carrier-bus traffic to whichever bitrate ran
# most recently.
#
# NOT SCOPED TO PHASE 11 -- setting this bus id turns the EEPROM path on
# for the WHOLE image, not just hwrev_verdict.h's read, because it is a
# single global Kconfig with no phase-level switch of its own:
#   - the boot banner (CONFIG_ALP_SDK_BANNER, on by default) reads this
#     SAME EEPROM at boot from a SYS_INIT hook (alp_sdk_banner(),
#     src/zephyr/alp_banner.c) to print the live SKU/hw_rev, and calls
#     alp_check_hw_rev_match() against CONFIG_ALP_SDK_SOM_HW_REV;
#   - alp_gpio_cc3501e_attach() (src/backends/gpio/cc3501e_proxy.c,
#     called from phase 8's cc3501e_bridge_bringup()) ALSO reads it and
#     sets g_hw_rev_mismatch for the CC3501E GPIO proxy's own hw_rev
#     guard (issue #1859).
# Both are safe here, but not by accident. CONFIG_ALP_SDK_SOM_HW_REV is set
# to "2626-r2" above, which is what lets src/backends/gpio/cc3501e_proxy.c
# confirm this module -- and that is only safe because issue #2144 replaced
# the proxy's old all-or-nothing, fail-OPEN hw_rev guard with a PER-PIN,
# fail-CLOSED one: a mismatch now refuses exactly the revision-dependent
# pads listed in src/backends/gpio/cc3501e_rev_dependent_pins.c (IO8 here)
# and leaves phase 9's IO20 SD mux ENABLE -- revision-independent, safe on
# both revisions -- working.
# Under the OLD guard this symbol had to stay at its default "" (unset),
# because alp_hw_info_build_hw_rev_mismatch() returns false unconditionally
# for an empty built_hw_rev (src/zephyr/hw_info_zephyr.c), and a real
# mismatch would otherwise have made alp_gpio_cc3501e_attach() refuse EVERY
# proxied pad, IO20 included, with CONFIG_ALP_SDK_HW_REV_MISMATCH_FATAL
# halting boot outright. That is why this app left it unset until #2144
# landed -- the constraint is gone, not forgotten.
# Phase 11's own guard (hw_rev_verdict.h, issue #2138) still runs for IO8 as
# well: the app-level and proxy-level checks are independent layers, and
# neither replaces the other.
CONFIG_ALP_SDK_HW_INFO_EEPROM_I2C_BUS_ID=0
CONFIG_ALP_SDK_HW_INFO_EEPROM_I2C_BITRATE_HZ=100000

# --- JPEG encode (phase 13) ---------------------------------------------------
# WITHOUT THE SoC SELECT BELOW THIS PHASE PROVES NOTHING. The backend
# selector (src/backend.c) matches on ALP_SOC_REF_STR: unset, the build
# resolves CONFIG_ALP_SOC_NONE=1 ("unknown"), alif_hantro
# (silicon_ref="alif:ensemble:e8", priority 100) is filtered out, and the
# portable software fallback (src/backends/jpeg/sw_baseline.c, "*", priority
# 50) silently wins -- the app still encodes a valid JPEG and the silicon is
# never touched. That is the exact defect a real AEN801 bench run caught on
# aen-jpeg-regcheck; see that app's file header.
CONFIG_ALP_SOC_ALIF_ENSEMBLE_E8=y

# The ported Hantro VC9000E driver TU (zephyr/drivers/video/
# jpeg_hantro_vc9000e.c) against the jpeg0 node this app's overlay enables,
# plus the hal_alif libjpeg_hantro_sw_gcc.a helper lib it links for the
# quantization-table / header pieces. Unlike aen-jpeg-regcheck these live in
# prj.conf rather than a board-scoped .conf: this app only ever builds for
# the AEN801 board (testcase.yaml platform_allow), so there is no native_sim
# scenario that would see CONFIG_USE_ALIF_JPEG_SW_LIB as an undefined symbol.
CONFIG_VIDEO=y
CONFIG_VIDEO_JPEG_HANTRO_VC9000E=y
CONFIG_USE_ALIF_JPEG_SW_LIB=y
CONFIG_ALP_SDK_JPEG_ALIF_HANTRO=y

# CONFIG_ALP_SDK_CAMERA_ZEPHYR_VIDEO is `default y if VIDEO`, and turning
# VIDEO on above would drag in the portable camera backend this app neither
# needs nor exercises -- no camera is attached to this bench.
CONFIG_ALP_SDK_CAMERA_ZEPHYR_VIDEO=n

# E8 D-cache maintenance loop hangs on this silicon; keep it off (shared bench
# rule -- scripts/bench/aen/aen-bench-shared.conf carries the same line, as do
# seven sibling bench apps).  Note what this is NOT: it is not a JPEG coherency
# workaround.  The ported driver DOES issue its own maintenance around the
# encode -- sys_cache_data_flush_and_invd_range() on the source and on the
# output buffer, sys_cache_data_invd_range() after -- and its own comment says
# that "matters for real DCACHE-on callers"
# (zephyr/drivers/video/jpeg_hantro_vc9000e.c:450, :488, :601).  So the Hantro
# AXI master would be coherent with the M55 either way; the constraint is
# silicon-wide, not this block's.  The cost of getting that backwards is real:
# a reader who checks the driver, finds the coherency claim false and "narrows"
# this back to CONFIG_DCACHE=y lands on the configuration that hangs.
# One consequence worth naming: with the D-cache off, those three maintenance
# calls are no-ops, so this app never exercises the DCACHE=y coherency path.
#
# SINCE PHASE 10 THIS LINE IS ALSO LOAD-BEARING FOR ETHERNET -- but it is no
# longer solely this comment's job to protect it. The GMAC descriptor rings
# and the net_buf pool it DMAs into must be coherent with the CPU, and
# eth_dwmac_alif's BUILD_ASSERT now enforces that UNCONDITIONALLY:
#
#   BUILD_ASSERT(!IS_ENABLED(CONFIG_DCACHE))
#
# zephyr/kconfigs/vendor-alif-peripherals.kconfig no longer `select
# NOCACHE_MEMORY` from ETH_DWMAC_ALIF (that section landed in the M55 DTCM,
# which the GMAC DMA cannot see, so it bought nothing real) and the driver no
# longer has a __nocache descriptor-ring arm to fall back on -- coherency now
# comes ONLY from the cache being off, everywhere, with no escape hatch. So
# setting CONFIG_DCACHE=y here now fails the BUILD at compile time with the
# driver's own BUILD_ASSERT message, rather than compiling clean and hanging
# on the bench (the old failure mode this comment used to warn about). This
# line is still the right place to keep the rule documented and explicit, but
# it is a belt to the driver's braces now, not the only thing standing
# between this app and a silicon hang.
CONFIG_DCACHE=n

# Logging ON, deliberately -- several phases (I2C reads, the PWM driver) report
# their decisive fault via LOG_ERR, and this app is a bench diagnostic, not a
# shipping image. LOG_MODE_MINIMAL keeps it deferred-free.
CONFIG_LOG=y
CONFIG_LOG_MODE_MINIMAL=y
```

## i2s3-enable-post-u46-rework.overlay
```dts
/*
 * Copyright (c) 2026 Alp Lab AB
 * SPDX-License-Identifier: Apache-2.0
 *
 * The devicetree half of phase 11's two-switch playback re-enable -- see
 * the SAFETY note in
 * boards/alp_e1m_aen801_m55_he_ae822fa0e5597ls0_rtss_he.overlay for why
 * i2s3 ships "disabled" by default on EVK rev 2626-R2 (U46 has no Hi-Z
 * state, and I2S0_SDO/SCLK/WS on P9_3/4/5 run through it backwards).
 *
 * Apply this ONLY once U46 is BOTH a 3257-type switch AND its VCC is
 * on +3V3 (a stock 74LVC157, even on +3V3, is still one-way and
 * reproduces the contention above; VCC alone is not the gate), OR a
 * switch rated for 1.8 V VCC (untested) -- on E1M-AEN803 serial
 * 2026W36-0002, 2026-09-15, a fitted 3257-type part's VCC was moved to +3V3 between
 * a silent run and an audible run; not established as the only
 * difference between the two -- see
 * include/alp/boards/alp_e1m_evk.h's I2S mux block, including the
 * untested /E-or-S-HIGH caveat at +3V3 and the open TDM-latch/#2146
 * findings -- together with setting AEN_EVKDEMO_SOUND_PLAYBACK to 1
 * in src/main.c -- both switches, not either alone:
 *
 *   west build -b alp_e1m_aen801_m55_he/ae822fa0e5597ls0/rtss_he \
 *       examples/aen/aen-evk-demo -- \
 *       -DEXTRA_DTC_OVERLAY_FILE=i2s3-enable-post-u46-rework.overlay
 */

&i2s3 {
	status = "okay";
};
```

## src/amp_fault_verdict.h
```c
/*
 * Copyright 2026 Alp Lab AB
 * SPDX-License-Identifier: Apache-2.0
 *
 * #2097: examples/aen/aen-evk-demo's Phase 11 (TAS2563 amps) raw
 * AMP_FAULT (IRQ_N, P5_0) pin mapping, pulled out of main.c for the same
 * reason as ioexp_verdict.h -- one ternary, but it was inverted for a
 * whole release and a test is cheaper than a second silent flip.
 *
 * `raw` is exactly what gpio_pin_get() returns on AMP_FAULT_PIN: that
 * pin is configured plain GPIO_INPUT, no GPIO_ACTIVE_LOW, so the return
 * value is the raw electrical level, not IRQ_N's logical sense. IRQ_N
 * is open-drain, active-low (SLASET3D Sec7.3.12), and R124 (10k to
 * +VIO, fitted) pulls the net high when neither amp is pulling it down
 * -- so raw 1 is idle and raw 0 is the fault. gpio_pin_get() itself can
 * also return a negative errno on a real read failure; that is neither
 * 0 nor 1 and must not be read as either verdict.
 */
#ifndef ALP_EVK_DEMO_AMP_FAULT_VERDICT_H
#define ALP_EVK_DEMO_AMP_FAULT_VERDICT_H

#include <stdbool.h>

/* Returns true iff `raw` is a valid gpio_pin_get() level (0 or 1);
 * `*asserted_out` is only meaningful when this returns true. Mirrors
 * chips/tas2563/tas2563.c's tas2563_fault_asserted() `!level` sense --
 * this pin just is not reachable through that call on this board (see
 * changelog.d/2097-evk-demo-fault-pin-polarity.md for why). */
static inline bool amp_fault_pin_verdict(int raw, bool *asserted_out)
{
	if (raw != 0 && raw != 1) return false;
	*asserted_out = (raw == 0);
	return true;
}

#endif /* ALP_EVK_DEMO_AMP_FAULT_VERDICT_H */
```

## src/bmp581_verdict.h
```c
/*
 * Copyright 2026 Alp Lab AB
 * SPDX-License-Identifier: Apache-2.0
 *
 * #2035: the BMP581 health criterion this demo's Sensors phase judges on,
 * pulled out of main.c into its own header so it is unit-testable without a
 * board -- main.c only builds against the real E1M-AEN801 target, but this
 * function takes plain register bytes, no I2C.
 *
 * A bench session once reported a BMP581 BROKEN off STATUS (0x28) reading
 * 0x02. That is DEEP STANDBY, the part's documented power-on/soft-reset
 * resting state (BST-BMP581-DS004-13 Rev 1.13 §4.3 p.16, §4.3.2 p.16), and
 * 0x02 is that register's own documented reset value (§7.22 p.58) -- not a
 * fault. Bosch's own bmp5_init() (BMP5_SensorAPI) and upstream Zephyr's
 * bmp581 driver both call the part ready on exactly two bits: nvm_rdy set
 * and nvm_err clear. This header matches that, and only that -- see
 * chips/bmp581/bmp581.c's "do not gate on core_rdy" note for why bit0
 * (core_rdy) plays no part here: it is defined once in the whole datasheet
 * and no Bosch or Zephyr procedure ever waits on it.
 */
#ifndef ALP_EVK_DEMO_BMP581_VERDICT_H
#define ALP_EVK_DEMO_BMP581_VERDICT_H

#include <stdbool.h>
#include <stdint.h>

#define BMP581_DIAG_REG_STATUS      0x28u
#define BMP581_DIAG_STATUS_CORE_RDY 0x01u /* bit0 -- NOT a readiness signal, see above. */
#define BMP581_DIAG_STATUS_NVM_RDY  0x02u /* bit1 */
#define BMP581_DIAG_STATUS_NVM_ERR  0x04u /* bit2 */

/* True iff STATUS's two documented health bits say the part is fit:
 * nvm_rdy set (NVM/trim data loaded) and nvm_err clear (no NVM fault).
 * Does NOT look at core_rdy, and does NOT know anything about a live
 * reading -- a caller still needs its own bus-op return codes and a
 * sanity check on the reading itself (this demo's bmp581_raw_invalid())
 * to catch a real bus failure or a bad conversion. */
static inline bool bmp581_status_is_healthy(uint8_t bstatus)
{
	return (bstatus & BMP581_DIAG_STATUS_NVM_RDY) != 0 &&
	       (bstatus & BMP581_DIAG_STATUS_NVM_ERR) == 0;
}

#endif /* ALP_EVK_DEMO_BMP581_VERDICT_H */
```

## src/cc3501e_bridge.h
```c
/*
 * SPDX-License-Identifier: Apache-2.0
 * Copyright 2026 Alp Lab AB
 *
 * One-call bring-up of the E1M-AEN SoM's CC3501E Wi-Fi 6 / BLE coprocessor over the
 * inter-chip SPI bridge -- the SoM bring-up TEMPLATE for applications.
 *
 * The CC3501E is part of the SoM (module U4 = BDE-BW35N): the application does NOT
 * touch the raw SPI bus or the WIFI_EN / nRESET control pins.  It calls
 * cc3501e_bridge_bringup() once, gets a ready @ref cc3501e_t, and from there uses the
 * portable surfaces:
 *   - cc3501e_* (chips/cc3501e)            -- MAC / Wi-Fi / BLE / GPIO-proxy / OTA
 *   - alp_gpio_open(ALP_E1M_GPIO_IOxx)         -- proxied E1M IOs (when the proxy is built)
 *
 * To reuse in your own AEN application: copy this pair (cc3501e_bridge.{c,h}) into your
 * app, or call cc3501e_bridge_bringup() directly.  The bus / pins / clock are the
 * E1M-AEN SoM defaults below; a board variant overrides only those macros -- the SoM
 * stays swappable without touching application code.
 */

#ifndef CC3501E_BRIDGE_H
#define CC3501E_BRIDGE_H

#include <alp/peripheral.h>    /* alp_status_t */
#include <alp/chips/cc3501e.h> /* cc3501e_t */

/* ---- E1M-AEN SoM bridge defaults (override per board variant) ---------------- */

/* Inter-chip SPI: Alif = master, CC3501E = slave.  P14_7 is muxed as the
 * dwc-ssi hardware SS0 chip-select; ALP_SPI_NO_CS means "no software GPIO CS"
 * here, so the controller frames each protocol phase.  Mode 0 matches the
 * CC3501E vendor image frameFormat. */
#ifndef CC3501E_BRIDGE_SPI_BUS_ID
#define CC3501E_BRIDGE_SPI_BUS_ID 1u
#endif
#ifndef CC3501E_BRIDGE_SPI_FREQ_HZ
/* 25 MHz = 200 MHz SSI functional clock / 8.
 *
 * The CC3501E peripheral-mode maximum is 30 MHz, NOT the 15 MHz this comment
 * claimed for most of the bring-up: datasheet SWRS343A section 6.14.2.3.3,
 * `fsclk SPI clock frequency, Peripheral Mode, MAX 30 MHz` (Controller Mode is
 * 40 MHz).  Every earlier ceiling argument here was built on the wrong number.
 *
 * 25 MHz is the fastest LEGAL step available: the DW SSI BAUDR divisor must be
 * EVEN, so from 200 MHz the neighbours are /8 = 25 MHz and /6 = 33.3 MHz, and
 * 33.3 is 11% over the part's maximum.  Reaching exactly 30 MHz would require
 * retargeting the SSI functional clock itself (AE822 HWRM section 8.3.5) --
 * ALIF_SPI_CLK is a frequency-only dummy in the dtsi with no divider control,
 * so there is no software knob for it here.
 *
 * REQUIRES rx-delay = <2> on the SPI node (see the board overlay).  At a 40 ns
 * bit period the MISO capture needs the delay; with rx-delay 0 the link fails
 * outright, and 4 is too much.
 *
 * It does not raise throughput -- silicon-measured
 * 2026-08-24: 682 kB/s at 25 MHz vs 678 kB/s at 14.29 MHz on PIO, 704 vs 701 on
 * DMA, because wire time is only ~554 us of a ~2459 us transaction and the rest
 * is per-frame protocol cost on both ends.  It is worth taking anyway: each
 * transfer occupies the bus for ~44% less time, which is CPU and bus budget
 * handed back to everything else on the SoM.
 *
 * The 14.29 MHz predecessor was scope-confirmed at 14.20-14.26 MHz, which is
 * what validates the 200 MHz functional-clock figure the divider assumes.  A
 * board with longer traces should re-check MISO capture before adopting 25 MHz.
 *
 * SEPARATE, PRE-EXISTING DEFECT (do not blame this clock for it): a bulk read
 * intermittently desyncs partway through -- roughly 1 run in 2-3, at anywhere
 * from 61 kB to 212 kB in -- and then never recovers for the caller's whole
 * retry budget.  It reproduces at 14.29 MHz TOO, so it is not a clock artifact.
 * Signature (host-side, request-header phase of CMD_SOCK_RECV 0x23): the
 * slave's in-band idle marker reads [02 00 00 00] once and then [00 00 00 00]
 * forever instead of A5 A5 A5 A5 -- i.e. the slave is stuck mid-reply on a
 * transfer it armed earlier and never completed.  With
 * SPI_TRANSFER_RETURN_PARTIAL deliberately off, a CS deassert does not complete
 * it, and NEITHER slave self-heal fires (g_resync_count does not move -- the
 * slave is not misframing; g_arm_fail_count does not move -- the arm succeeded).
 * Clocking a full idle frame from the host to satisfy the outstanding count was
 * tried and did NOT recover it.  The fix likely belongs on the slave: a
 * stall watchdog that calls bridge_transport_spi_hw_reinit() when an armed
 * transfer has not completed for N ms. */
#define CC3501E_BRIDGE_SPI_FREQ_HZ 25000000u
#endif

/* CC3501E control pins on the Alif LP-GPIO island (NOT E1M edge pads):
 * WIFI_EN = supply gate (P15_5), nRESET = reset (P15_1_FLEX). */
#ifndef CC3501E_BRIDGE_PIN_WIFI_EN
#define CC3501E_BRIDGE_PIN_WIFI_EN 0u
#endif
#ifndef CC3501E_BRIDGE_PIN_NRST
#define CC3501E_BRIDGE_PIN_NRST 1u
#endif
/* OPTIONAL host-IRQ/READY input (CC35 GPIO17 -> Alif P2_6, alp_pins[2]).  When
 * the board wires it, cc3501e_request() gates reply phases on it (HIGH = slave
 * armed) instead of a fixed delay.  Absent -> ready_pin NULL -> legacy gap. */
#ifndef CC3501E_BRIDGE_PIN_READY
#define CC3501E_BRIDGE_PIN_READY 2u
#endif

/* DW SSI SPI1 base (0x48104000) + RX_SAMPLE_DLY to run the bridge SCLK above
 * 1 MHz.  spi_dw never writes RX_SAMPLE_DLY (0xf0) so it defaults to 0 -> the
 * master samples MISO at the SCLK edge, before the on-SoM trace + crossed-data
 * round-trip returns the CC35's bit, so >1 MHz mis-samples.  Setting it delays
 * the capture by N ssi_clk (200 MHz) cycles.  6 is silicon-tuned for ~14.3 MHz on
 * e1m-aen-evk-01 with a WIDE window (4..8 all clean cold+warm).  0 disables it
 * (falls back to 1 MHz).  Re-sweep if the SoM trace lengths change. */
#ifndef CC3501E_BRIDGE_SPI1_BASE
#define CC3501E_BRIDGE_SPI1_BASE 0x48104000u
#endif
#ifndef CC3501E_BRIDGE_RX_SAMPLE_DLY
#define CC3501E_BRIDGE_RX_SAMPLE_DLY 6u
#endif

/**
 * @brief Bring up the SoM's CC3501E coprocessor over the inter-chip bridge.
 *
 * Opens the hardware-SS0 bridge SPI + the WIFI_EN / nRESET control pins, binds
 * them to @p fw, attaches the GPIO proxy (when CONFIG_ALP_SDK_GPIO_CC3501E_PROXY is
 * built), and runs the power + reset sequence (TI SWRU626 + the Puya cold-boot
 * hard-reset workaround).  Blocks ~900 ms for the boot budget; leaves WIFI_EN HIGH.
 *
 * @param fw  Caller-owned handle, populated on success.  Use it with cc3501e_*.
 * @return ALP_OK with @p fw ready; ALP_ERR_NOT_PRESENT_ON_THIS_SOC if the SPI bus /
 *         control pins are absent (check the board overlay); otherwise the reset
 *         sequence status.  On any failure @p fw is left un-bound (do not use it).
 */
alp_status_t cc3501e_bridge_bringup(cc3501e_t *fw);

#endif /* CC3501E_BRIDGE_H */
```

## src/cc3501e_gpio_routes.c
```c
/*
 * SPDX-License-Identifier: Apache-2.0
 * Copyright 2026 Alp Lab AB
 *
 * CC3501E GPIO-proxy route table for aen-evk-demo -- the THREE proxied pads
 * this app drives, and no more.
 *
 * WHAT THIS IS. A strong override of the WEAK cc3501e_gpio_routes[] /
 * cc3501e_gpio_route_count in src/backends/gpio/cc3501e_proxy_routes_weak.c.
 * It maps a PORTABLE E1M GPIO pin id -- what alp_gpio_open() takes -- to the
 * RAW CC3501E GPIO index the inter-chip bridge drives, so an alp_gpio_* call
 * on a proxied pad is routed over the bridge while every Alif-side pin still
 * delegates to the platform driver. Compiled unconditionally; only consulted
 * when CONFIG_ALP_SDK_GPIO_CC3501E_PROXY is set (it is -- see prj.conf).
 *
 * WHY THIS ONE IS HAND-WRITTEN WHEN THE OTHERS ARE GENERATED, and how it is
 * kept from drifting anyway. scripts/gen_cc3501e_gpio_routes.py generates this
 * file for aen-cc3501e-bringup, aen-cc3501e-companion-tour and
 * aen-cc3501e-gpio; it discovers its targets by looking for a board.yaml
 * beside a prj.conf that enables the proxy. aen-evk-demo has NO board.yaml --
 * it is a standalone Zephyr app by design (see CMakeLists.txt), so there is no
 * composed route table for the generator to resolve against and it correctly
 * skips this app.
 *
 * Hand-maintaining a full nine-pad table here is exactly the triplication
 * issue #1859 removed, so this file does not carry one: it declares only the
 * pads phases 9 and 11 actually drive. Every entry is still pinned to
 * metadata rather than trusted -- tests/scripts/test_aen_cc3501e_routes.py
 * checks all of them against metadata/e1m_modules/aen/from-cc3501e.tsv, the
 * same source the generator resolves through, and asserts the table stays a
 * SUBSET of the full map. Add a pad here only alongside that test.
 *
 * REVISION SCOPE. IO20 -> GPIO_26 holds on BOTH AEN module revisions (it is
 * not one of the pads hw-revisions.yaml moves), so its entry below needs no
 * per-revision variant. IO21 -- the SD mux SELECT -- is deliberately ABSENT:
 * on r2 it is physically open and on r1 driving it would contend with the P18
 * header jumper. See phase 9's header in src/main.c.
 *
 * IO8 AND IO13 -- the I2S mux ENABLE and SELECT phase 11 drives -- are BOTH
 * CC3501E-owned ONLY ON r2, per metadata/e1m_modules/E1M-AEN801.yaml's base
 * pad_routes (IO8 -> dispatch_pin 30, IO13 -> dispatch_pin 13), confirmed
 * against from-cc3501e.tsv (AG33 IO8 GPIO30; E3 IO13 GPIO13). On r1,
 * metadata/e1m_modules/aen/hw-revisions.yaml `pad_route_overrides` moves IO8
 * BACK to a direct Alif GPIO (P7.1) and re-routes IO21, not IO8, onto
 * CC3501E GPIO_30 -- so this file's IO8 entry is revision-scoped, unlike
 * IO20's. That also contradicts
 * examples/aen/aen-i2s-amp-alif/README.md's "EN = IO8 -> Alif P7.1" claim and
 * metadata/boards/e1m-evk.yaml's matching EVK_PIN_I2S_MUX_EN doc string --
 * both are stale prose left over from before the SoM's pad_routes were
 * finalised; the pad_routes table (what the generator and this app's GPIO
 * dispatch actually resolve through) is the one both phases 9 and 11 trust.
 *
 * TWO guards stand between this r2-only table and an r1 module, at different
 * layers, and both are live:
 *   - app level (issue #2138): this app has no board.yaml, so it gets none of
 *     scripts/gen_cc3501e_gpio_routes.py's per-revision generation; instead
 *     phase 11 confirms the live module is r2 over a fresh EEPROM read (the
 *     same manifest phase 5 decodes) before it ever opens IO8, and refuses --
 *     FAILS the phase, never drives GPIO_30 -- on anything else. See that
 *     check's comment in src/main.c, immediately before phase 11's step 1.
 *   - proxy level (issue #2144): src/backends/gpio/cc3501e_proxy.c's px_open()
 *     refuses alp_gpio_open(ALP_E1M_GPIO_IO8) with ALP_ERR_NOSUPPORT on any
 *     module whose identity-EEPROM manifest does not confirm r2 -- per pin and
 *     fail-closed, so an app that forgets the check above still cannot
 *     silently proxy IO8 to CC3501E GPIO_30 on an r1 module, where GPIO_30 is
 *     IO21, the SDIO mux SELECT, tied to +3V3 through R198 and a fitted P18
 *     jumper. That guard reads cc3501e_gpio_rev_dependent[] from the SDK-owned
 *     generated file src/backends/gpio/cc3501e_rev_dependent_pins.c -- the
 *     SAME set on every AEN board, so it is not this app's table to carry
 *     (issue #2144 design review; the list previously lived here too,
 *     per-app). CONFIG_ALP_SDK_SOM_HW_REV="2626-r2" in prj.conf is what lets
 *     that guard confirm this module; phase 9's IO20 is revision-independent
 *     and unaffected either way.
 */

#include <stdint.h>
#include <stddef.h>

#include <alp/chips/cc3501e.h>
#include <alp/e1m_pinout.h>

const cc3501e_gpio_route_t cc3501e_gpio_routes[] = {
	{ ALP_E1M_GPIO_IO20, 26u }, /* SDIO 74LVC157 /E; drive low to enable mux. */
	{ ALP_E1M_GPIO_IO8, 30u },  /* I2S0 74LVC157 /E; drive low to enable mux. */
	{ ALP_E1M_GPIO_IO13, 13u }, /* I2S0 74LVC157 S; 0 = TAS2563 amps, 1 = M.2 E-key I2S. */
};

const size_t cc3501e_gpio_route_count =
    sizeof(cc3501e_gpio_routes) / sizeof(cc3501e_gpio_routes[0]);
```

## src/cc3501e_link_verdict.h
```c
/*
 * Copyright 2026 Alp Lab AB
 * SPDX-License-Identifier: Apache-2.0
 *
 * #2035: this demo's CC3501E GET_VERSION verdict, pulled out of main.c into
 * its own header so it is unit-testable without a board -- same pattern as
 * bmp581_verdict.h in this directory.
 *
 * A bench session on a board running 3.1 firmware reported "MAJOR MISMATCH"
 * and an overall phase FAIL while every functional sub-check (ping, MAC,
 * caps, scan, BLE) passed. The host driver is deliberately BILINGUAL during
 * the v3->v4 migration window: it accepts ALP_CC3501E_PROTOCOL_MAJOR (4,
 * this host's own wire) AND ALP_CC3501E_PROTOCOL_MAJOR_LEGACY (3, the
 * pre-4.0 predecessor -- see the paragraph above ALP_CC3501E_PROTOCOL_MAJOR
 * in <alp/protocol/cc3501e.h>). A legacy-major peer is the migration
 * WORKING, not a mismatch, so this demo's old two-way ver_ok boolean was
 * wrong to fail it.
 *
 * This expresses the identical acceptance rule as
 * cc3501e_fw_major_is_acceptable() (chips/cc3501e/cc3501e_core.c) again,
 * against the same two public constants -- that function is declared in
 * chips/cc3501e/cc3501e_internal.h, `chips/`-internal and not part of this
 * demo's reach, so it is re-expressed here rather than widening that
 * internal header's surface just for a demo.
 */
#ifndef ALP_EVK_DEMO_CC3501E_LINK_VERDICT_H
#define ALP_EVK_DEMO_CC3501E_LINK_VERDICT_H

#include <stdbool.h>

#include "alp/peripheral.h"       /* alp_status_t, ALP_OK */
#include "alp/protocol/cc3501e.h" /* ALP_CC3501E_PROTOCOL_MAJOR[_LEGACY], _MINOR */

/* Four, and only four, outcomes GET_VERSION can settle into -- see this
 * header's file comment for why the third is not a failure. */
typedef enum {
	CC3501E_LINK_VERDICT_MATCH,       /* MAJOR and MINOR both equal this host's build. */
	CC3501E_LINK_VERDICT_MINOR_AHEAD, /* MAJOR matches; MINOR differs -- additive (ADR 0033). */
	CC3501E_LINK_VERDICT_LEGACY,      /* fw on ALP_CC3501E_PROTOCOL_MAJOR_LEGACY, host bilingual
	                                   * -- the v3->v4 migration working, not a mismatch. */
	CC3501E_LINK_VERDICT_MISMATCH,    /* ver_rc failed, or fw_major is neither accepted value. */
} cc3501e_link_verdict_t;

/* Classify a GET_VERSION reply. Mirrors cc3501e_fw_major_is_acceptable()'s
 * two-constant rule (see file comment) but distinguishes MATCH from
 * MINOR_AHEAD from LEGACY, which that boolean-returning function does not
 * need to. */
static inline cc3501e_link_verdict_t
cc3501e_classify_link(alp_status_t ver_rc, unsigned fw_major, unsigned fw_minor)
{
	if (ver_rc != ALP_OK) {
		return CC3501E_LINK_VERDICT_MISMATCH;
	}
	if (fw_major == (unsigned)ALP_CC3501E_PROTOCOL_MAJOR_LEGACY) {
		return CC3501E_LINK_VERDICT_LEGACY;
	}
	if (fw_major != (unsigned)ALP_CC3501E_PROTOCOL_MAJOR) {
		return CC3501E_LINK_VERDICT_MISMATCH;
	}
	return (fw_minor == (unsigned)ALP_CC3501E_PROTOCOL_MINOR) ? CC3501E_LINK_VERDICT_MATCH
	                                                          : CC3501E_LINK_VERDICT_MINOR_AHEAD;
}

/* True for every outcome the phase's overall PASS/FAIL gates on as "the
 * link is usable" -- everything except a genuine MISMATCH. */
static inline bool cc3501e_link_verdict_ok(cc3501e_link_verdict_t v)
{
	return v != CC3501E_LINK_VERDICT_MISMATCH;
}

#endif /* ALP_EVK_DEMO_CC3501E_LINK_VERDICT_H */
```

## src/hw_rev_verdict.h
```c
/*
 * Copyright 2026 Alp Lab AB
 * SPDX-License-Identifier: Apache-2.0
 *
 * #2138: Phase 11's "is E1M IO8 -> CC3501E GPIO_30 safe to drive" gate,
 * pulled out of main.c so it is unit-testable without a board -- same
 * pattern as amp_fault_verdict.h / sound_verdict.h / cc3501e_link_verdict.h
 * in this directory.
 *
 * WHY THIS EXISTS. cc3501e_gpio_routes.c's E1M IO8 -> CC3501E GPIO_30 entry
 * (the I2S mux ENABLE phase 11 drives) is correct ONLY on hw_rev 2626-r2.
 * On 2626-r1, metadata/e1m_modules/aen/hw-revisions.yaml `pad_route_
 * overrides` moves IO8 to a direct Alif GPIO and re-routes IO21, not IO8,
 * onto CC3501E GPIO_30 -- which on an E1M-EVK 2626-R2 carrier is the SDIO
 * mux SELECT, tied to +3V3 by a fitted P18 jumper. Driving GPIO_30 low as
 * I2S_EN on an r1 module shorts a CC3501E output against +3V3. This gate is
 * the single place that "is it safe" decision is made, so it can be proven
 * with a unit test (tests/zephyr/chips/src/test_hw_rev_verdict.c) instead
 * of trusted by inspection -- a prior version of this gate was checked only
 * by grepping main.c for a token, which passed both a stub TODO in place of
 * the check and the check's own condition inverted (round-2 review of this
 * issue).
 *
 * TAKES alp_hw_info_read()'s OWN OUTPUT, not a second hand-rolled EEPROM
 * read. alp_hw_info_classify_manifest() (src/zephyr/hw_info_zephyr.c) --
 * the function alp_hw_info_read() itself calls -- already validates magic +
 * schema_version + CRC32 before it ever populates `som_hw_rev`, and that
 * validation is already exercised end-to-end (valid / blank-erased /
 * zeroed / bad-schema / bad-CRC manifests) by tests/zephyr/hw_info/src/
 * main.c. classify_manifest() itself is SDK-internal BY CONTRACT, not by
 * reach -- zephyr/CMakeLists.txt's zephyr_include_directories(src/common)
 * puts its header on every consuming app's include path app-wide, same as
 * tests/zephyr/hw_info/src/main.c uses it, so nothing stops app code from
 * calling it directly -- but only alp_hw_info_read()/alp_hw_info_t is the
 * PUBLIC <alp/hw_info.h> surface apps are meant to consume, and calling
 * classify_manifest() directly here would still require this app to
 * hand-roll its own raw EEPROM read first (classify_manifest() takes an
 * already-read manifest buffer, not a bus/address), reintroducing exactly
 * the second, app-owned read this file exists to avoid. So this gate calls
 * the public entry point instead, and only has to decide whether an
 * ALREADY-VALIDATED read names r2.
 */
#ifndef ALP_EVK_DEMO_HW_REV_VERDICT_H
#define ALP_EVK_DEMO_HW_REV_VERDICT_H

#include <stdbool.h>
#include <string.h>

#include "alp/hw_info.h"    /* ALP_HW_INFO_HW_REV_LEN */
#include "alp/peripheral.h" /* alp_status_t, ALP_OK */

/* The one hw_rev string cc3501e_gpio_routes.c's hand-written E1M IO8 ->
 * CC3501E GPIO_30 entry is correct for. */
#define AEN_EVKDEMO_HW_REV_IO8_SAFE "2626-r2"

/*
 * True iff `read_rc` is ALP_OK -- alp_hw_info_read() succeeded, which
 * itself required a magic + schema_version + CRC32-valid manifest -- AND
 * `som_hw_rev` names exactly AEN_EVKDEMO_HW_REV_IO8_SAFE. Anything else --
 * a read failure, an unprovisioned/corrupt manifest, r1, a same-prefix
 * string like "2626-r2X", or a future r3+ -- returns false, and the caller
 * must not open E1M IO8 (or drive CC3501E GPIO_30) when it does.
 */
static inline bool
aen_evkdemo_hw_rev_confirms_io8_safe(alp_status_t read_rc,
                                     const char   som_hw_rev[ALP_HW_INFO_HW_REV_LEN])
{
	if (read_rc != ALP_OK) return false;
	/* strncmp bounded by the field's own size, not strcmp: alp_hw_info_
	 * classify_manifest()'s copy_field() (src/zephyr/hw_info_zephyr.c)
	 * always NUL-terminates som_hw_rev on the ALP_OK path this function
	 * relies on -- so THAT specific caller could safely use strcmp() --
	 * but this function's own signature accepts a bare
	 * char[ALP_HW_INFO_HW_REV_LEN] with no documented terminator
	 * guarantee, and defending the bound here rather than trusting every
	 * possible caller costs nothing. An 8-byte field compared 8 bytes
	 * deep against an 8-byte literal (7 chars + NUL) still requires an
	 * exact match including the terminator, so a hypothetical
	 * full-width, unterminated buffer like "2626-r2X" correctly
	 * disagrees on that last byte instead of appearing to match a
	 * truncated prefix -- see
	 * test_hw_rev_verdict_refuses_unterminated_field's own comment for
	 * why that case has to call this function directly rather than
	 * through alp_hw_info_classify_manifest(), which would silently fix
	 * such an input before it ever reached here. */
	return strncmp(som_hw_rev, AEN_EVKDEMO_HW_REV_IO8_SAFE, ALP_HW_INFO_HW_REV_LEN) == 0;
}

#endif /* ALP_EVK_DEMO_HW_REV_VERDICT_H */
```
