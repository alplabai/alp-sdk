## CMakeLists.txt
```
# SPDX-License-Identifier: Apache-2.0
#
# aen-temp-sensor -- read the E1M-AEN801's on-module TMP112 temperature sensor
# through the UPSTREAM Zephyr sensor API (CONFIG_SENSOR + CONFIG_TMP112,
# drivers/sensor/ti/tmp112/), bound to the "ti,tmp112" node the BOARD layer
# declares on BRD_I2C.
#
# Plain Zephyr app -- no alp_project.py board.yaml flow and no alp-sdk module
# needed: every API this example touches is upstream Zephyr (ADR 0017 Tier-1,
# upstream-native), so pulling <alp/*> in would add footprint without adding a
# surface the app uses.  Build with:
#
#   ZEPHYR_BASE=<zephyr-base> west build \
#     -b alp_e1m_aen801_m55_he/ae822fa0e5597ls0/rtss_he <this-dir> -- \
#     "-DEXTRA_ZEPHYR_MODULES=<alp-sdk>;<hal_alif>"
#
# or, on the bench:
#
#   scripts/bench/aen/build.sh <alp-sdk>/examples/aen/aen-temp-sensor
#
# The overlay under boards/ is named for the FULLY-QUALIFIED board id, so
# Zephyr auto-applies it -- no -DEXTRA_DTC_OVERLAY_FILE needed.

cmake_minimum_required(VERSION 3.20)

find_package(Zephyr REQUIRED HINTS $ENV{ZEPHYR_BASE})
project(aen_temp_sensor LANGUAGES C)

target_sources(app PRIVATE src/main.c)
```

## prj.conf
```kconfig
# SPDX-License-Identifier: Apache-2.0
#
# aen-temp-sensor -- on-module TMP112 read over the upstream Zephyr sensor API
# on the E1M-AEN801 (Alif Ensemble E8, M55-HE).

# --- Console -----------------------------------------------------------------
# Console: Alp UART console -- E1M edge UART0 (Alif UART5, P3_4/P3_5, 115200
# 8N1, NS16550), the E1M-AEN801 carrier console. The board _defconfig already
# selects it; we set it explicitly here so the example is self-describing.
CONFIG_SERIAL=y
CONFIG_CONSOLE=y
CONFIG_UART_CONSOLE=y
CONFIG_UART_INTERRUPT_DRIVEN=y
# Serial-less bench? Comment the four lines above and uncomment these to read
# 'ram_console_buf' over SWD instead:
# CONFIG_RAM_CONSOLE=y
# CONFIG_RAM_CONSOLE_BUFFER_SIZE=2048
# CONFIG_UART_CONSOLE=n
CONFIG_PRINTK=y

# --- Sensor ------------------------------------------------------------------
# CONFIG_SENSOR turns on the sensor subsystem (sensor_sample_fetch_chan() /
# sensor_channel_get() / SENSOR_CHAN_AMBIENT_TEMP).
#
# CONFIG_TMP112=y IS SET HERE, EXPLICITLY, AS OF #2043.  Upstream's Kconfig
# still declares `default y depends on DT_HAS_TI_TMP112_ENABLED`, but this
# board's own Kconfig.defconfig now ALSO defaults TMP112 to n board-wide --
# alp-sdk's chips/tmp112/tmp112.c and upstream's
# zephyr/drivers/sensor/ti/tmp112/tmp112.c both define `tmp112_init`, and an
# app that links both collides at LINK time, so the board no longer turns the
# upstream driver on for free (see zephyr/boards/alp/e1m_aen801_m55_he/
# Kconfig.defconfig).  This app is the one AEN801 app that genuinely wants
# the upstream driver instead of alp-sdk's chip driver, so it asks for it by
# name.  The board default only supplies the value nothing else assigns, so
# this explicit `y` still wins over it and still pulls CONFIG_I2C in with it
# (`select I2C`) -- writing `CONFIG_TMP112=y` would still fail on any target
# with no `ti,tmp112` node, an unmet-dependency Kconfig warning, exactly as
# before.
CONFIG_SENSOR=y
CONFIG_TMP112=y
# The i2c_dw controller under the sensor needs PINCTRL for its pad config; the
# board's pinctrl-0 pulls it in, set here for clarity.
CONFIG_PINCTRL=y

# --- Logging -----------------------------------------------------------------
# ON, deliberately.  Upstream tmp112_init() reports its failures through
# LOG_ERR ("Failed to set configuration (%d)"), and that line is the first
# concrete evidence when the sensor does not ACK.  With CONFIG_LOG=n it is
# compiled out and the app can only report "not ready" without the errno
# behind it.  LOG_MODE_MINIMAL keeps logging deferred-free, so nothing is
# lost if the app returns from main() before a log thread would have flushed.
CONFIG_LOG=y
CONFIG_LOG_MODE_MINIMAL=y

# --- Link address ------------------------------------------------------------
# Link the app at the HE MRAM app partition (0x80010000) so its vector table
# matches the ATOC load address (app-zephyr-he.json mramAddress=0x80010000).
# FLASH_BASE is the full MRAM (0x80000000); without this 0x10000 offset the
# image links at 0x80000000 and the SES boots it 64 KB low -> fault/no-boot.
# This is a flashed Flow A / slot0 target, not an ITCM RAM-run -- for Flow C,
# add scripts/bench/aen/aen-flowc-itcm.{conf,overlay} on the build command
# line rather than editing this file.
CONFIG_FLASH_LOAD_OFFSET=0x10000
```

## boards/alp_e1m_aen801_m55_he_ae822fa0e5597ls0_rtss_he.overlay
```dts
/*
 * Copyright (c) 2026 Alp Lab AB
 * SPDX-License-Identifier: Apache-2.0
 *
 * aen-temp-sensor -- app overlay for the E1M-AEN801 (Alif Ensemble E8, M55-HE).
 *
 * THIS OVERLAY DELIBERATELY ADDS NOTHING, AND THAT IS THE POINT.
 *
 * The on-module TMP112 is a property of the SoM, not of this app: every
 * E1M-AEN801 has one, so every AEN801 application should get it for free from
 * the BOARD layer.  The board files declare both halves --
 *
 *   - BRD_I2C, the on-module housekeeping bus.  It is SoC I2C0
 *     (i2c@49010000, "snps,designware-i2c") on pads P7_0 (I2C0_SDA_C) and
 *     P7_1 (I2C0_SCL_C), per the E1M-AEN-2626-R2 netlist rows
 *     "BRD_I2C_SDA",U6,B8,"P7_0/SCP0_A" and "BRD_I2C_SCL",U6,B3,"P7_1/SCP1_A"
 *     and the AE822 DFP pin table's alt-function [4] entries.
 *   - the "ti,tmp112" child node on it, at the design address 0x40: the
 *     netlist ties U20 pin 3 (ADD0) to 0V, and U20 (TMP112DIDPWR) is the
 *     X2SON-5 "Address Variant Only" package -- per TI SBOS473L p.44 no
 *     SOT563-6 orderable carries that MPN -- whose SBOS473L Table 7-4 strap
 *     row maps ADD0 -> GND to 0x40.
 *
 * -- so an app overlay that re-declared them would be duplicating a SoM fact
 * one layer too high.  That duplication is exactly the smell that
 * examples/aen/aen-secure-element-sign and examples/aen/aen-brd-i2c-scan carry
 * today: each hand-rolls its own &pinctrl group and &i2c0 enable, and every
 * copy is a place the pad config can drift out of step with the netlist.
 *
 * The file exists at all because Zephyr auto-applies a board overlay only when
 * its stem matches the FULLY-QUALIFIED board id -- so the name here is the
 * contract, even when the contents are empty.  If you need an app-scoped
 * devicetree tweak (a different `conversion-rate`, say, or the ITCM retarget
 * for a Flow C RAM-run), this is where it goes.
 */
```

## boards/alp_e1m_aen803_m55_he_ae822fa0e5597ls0_rtss_he.overlay
```dts
/*
 * Copyright (c) 2026 Alp Lab AB
 * SPDX-License-Identifier: Apache-2.0
 *
 * aen-temp-sensor -- app overlay for the E1M-AEN803 (Alif Ensemble E8, M55-HE).
 *
 * THIS OVERLAY DELIBERATELY ADDS NOTHING, AND THAT IS THE POINT.
 *
 * The on-module TMP112 is a property of the SoM, not of this app: every
 * E1M-AEN803 has one, so every AEN803 application should get it for free from
 * the BOARD layer.  The board files declare both halves --
 *
 *   - BRD_I2C, the on-module housekeeping bus.  It is SoC I2C0
 *     (i2c@49010000, "snps,designware-i2c") on pads P7_0 (I2C0_SDA_C) and
 *     P7_1 (I2C0_SCL_C), per the E1M-AEN-2626-R2 netlist rows
 *     "BRD_I2C_SDA",U6,B8,"P7_0/SCP0_A" and "BRD_I2C_SCL",U6,B3,"P7_1/SCP1_A"
 *     and the AE822 DFP pin table's alt-function [4] entries.
 *   - the "ti,tmp112" child node on it, at the design address 0x40: the
 *     netlist ties U20 pin 3 (ADD0) to 0V, and U20 (TMP112DIDPWR) is the
 *     X2SON-5 "Address Variant Only" package -- per TI SBOS473L p.44 no
 *     SOT563-6 orderable carries that MPN -- whose SBOS473L Table 7-4 strap
 *     row maps ADD0 -> GND to 0x40.
 *
 * -- so an app overlay that re-declared them would be duplicating a SoM fact
 * one layer too high.  That duplication is exactly the smell that
 * examples/aen/aen-secure-element-sign and examples/aen/aen-brd-i2c-scan carry
 * today: each hand-rolls its own &pinctrl group and &i2c0 enable, and every
 * copy is a place the pad config can drift out of step with the netlist.
 *
 * The file exists at all because Zephyr auto-applies a board overlay only when
 * its stem matches the FULLY-QUALIFIED board id -- so the name here is the
 * contract, even when the contents are empty.  If you need an app-scoped
 * devicetree tweak (a different `conversion-rate`, say, or the ITCM retarget
 * for a Flow C RAM-run), this is where it goes.
 */
```

## src/main.c
```c
/*
 * Copyright (c) 2026 Alp Lab AB
 * SPDX-License-Identifier: Apache-2.0
 *
 * aen-temp-sensor -- read the E1M-AEN801's on-module TMP112 temperature
 * sensor through the UPSTREAM Zephyr sensor API.
 *
 * Layering (ADR 0017, as amended 2026-08-30 -- alp-sdk rides OVER the vendor
 * SDK and never re-implements a driver upstream already ships):
 *
 *   devicetree  the BOARD layer declares the bus (BRD_I2C == SoC I2C0,
 *               "snps,designware-i2c") and the "ti,tmp112" child node on it.
 *               Nothing in this example's own overlay touches either -- see
 *               boards/alp_e1m_aen801_m55_he_ae822fa0e5597ls0_rtss_he.overlay.
 *   driver      upstream drivers/sensor/ti/tmp112/ binds that node.
 *               CONFIG_TMP112 self-selects `default y` off the enabled node.
 *   app         this file: sensor_sample_fetch() + sensor_channel_get() on
 *               SENSOR_CHAN_AMBIENT_TEMP.  No I2C register pokes, no chip
 *               driver, no vendor header.
 *
 * The whole app is bus-agnostic on purpose: swap the DT node onto another
 * I2C controller and not a line here changes.
 *
 * What it does, in order
 * ----------------------
 *   1. Resolve the DT-bound TMP112 and check it initialised.  A TMP112 that
 *      does not ACK fails here -- upstream tmp112_init() writes CONFIG, T_LOW
 *      and T_HIGH, so a no-ACK part never reaches device_is_ready().
 *   2. Take TMP112_SAMPLES readings TMP112_PERIOD_MS apart, so a reader sees
 *      the poll shape rather than a single lucky fetch.
 *   3. Sanity-BAND each reading against an indoor range.  This is a
 *      PLAUSIBILITY check, not a correctness claim -- see the band comment.
 *   4. Print one machine-greppable RESULT PASS / PARTIAL / FAIL line.
 */

#include <zephyr/kernel.h>
#include <zephyr/device.h>
#include <zephyr/drivers/sensor.h>

/*
 * Bind by COMPATIBLE, not by node label.  The board layer owns the node and
 * may name its label whatever it likes; "ti,tmp112" is the stable contract
 * between the binding, the driver and this app.  When no such node is enabled
 * in the build (e.g. a native_sim compile check), the whole block collapses to
 * a NULL device and main() reports that as a build-configuration fault rather
 * than failing to compile.
 */
#if DT_HAS_COMPAT_STATUS_OKAY(ti_tmp112)
#define TMP112_NODE DT_COMPAT_GET_ANY_STATUS_OKAY(ti_tmp112)
/* The devicetree's OWN address, printed rather than assumed: U20 is
 * TMP112DIDPWR, whose exact orderable MPN is X2SON (DPW), 5 pins (TI
 * SBOS473L p.44) -- the X2SON-5 "Address Variant Only" row of SBOS473L
 * Table 7-4 straps ADD0->GND to 0x40. */
#define TMP112_DT_ADDR ((unsigned int)DT_REG_ADDR(TMP112_NODE))
static const struct device *const tmp112 = DEVICE_DT_GET(TMP112_NODE);
#else
#define TMP112_DT_ADDR 0u
static const struct device *const tmp112 = NULL;
#endif

/* Poll shape: 8 samples 500 ms apart is ~4 s of console output -- long enough
 * to show a customer the loop and to catch an intermittent bus, short enough
 * that a bench operator does not sit waiting.  The TMP112's default
 * conversion-rate is 4 Hz (250 ms per conversion, ti,tmp112.yaml), so every
 * 500 ms fetch returns a genuinely fresh conversion rather than re-reading a
 * stale register. */
#define TMP112_SAMPLES   8
#define TMP112_PERIOD_MS 500

/*
 * PLAUSIBILITY band, in milli-degrees C.  A powered lab bench sits somewhere
 * around 15..35 degC, and the module self-heats a little on top of ambient.
 *
 * READ THIS BEFORE TRUSTING IT: a reading inside the band is NOT proof the
 * sensor is accurate, and a reading outside it is NOT proof the sensor is
 * broken.  The band only separates "this looks like a temperature" from
 * "this looks like a bus fault or a mis-decoded register" -- the failure this
 * check exists to catch is a plausible-looking number coming from the wrong
 * place.  A cold-chamber, outdoor or oven test legitimately lands outside it;
 * widen or delete the band for those, do not treat it as a spec limit.  The
 * TMP112's own operating range is -40..125 degC.
 */
#define TMP112_PLAUSIBLE_LO_MILLI_C 15000
#define TMP112_PLAUSIBLE_HI_MILLI_C 35000

/*
 * Fetch one ambient-temperature reading as integer milli-degrees C.
 *
 * NO FLOAT PRINTF, deliberately -- the same rule the sibling AEN examples
 * follow.  A hard-float printf on the M55 costs code size and, with the
 * minimal libc some bench configs use, silently prints nothing at all for
 * %f, which reads on the console as a dead sensor.  Zephyr's sensor_value is
 * already an exact integer pair (val1 whole units + val2 micro-units), and
 * sensor_value_to_milli() collapses it without ever touching an FPU.
 *
 * Returns 0 and fills *milli_c on success, or the negative errno from the
 * sensor API.
 */
static int read_ambient_milli_c(int32_t *milli_c)
{
	struct sensor_value val;
	int                 rc;

	/* fetch = trigger a bus transaction and latch the result in the driver;
	 * channel_get = convert that latched sample.  They are separate calls so
	 * one fetch can feed several channels -- the TMP112 only has the one. */
	rc = sensor_sample_fetch_chan(tmp112, SENSOR_CHAN_AMBIENT_TEMP);
	if (rc != 0) {
		return rc;
	}

	rc = sensor_channel_get(tmp112, SENSOR_CHAN_AMBIENT_TEMP, &val);
	if (rc != 0) {
		return rc;
	}

	*milli_c = (int32_t)sensor_value_to_milli(&val);
	return 0;
}

int main(void)
{
	unsigned int n_ok      = 0U; /* fetches that returned a value.       */
	unsigned int n_in_band = 0U; /* of those, how many looked plausible. */

	printk("\n=== aen-temp-sensor: on-module TMP112 via the Zephyr sensor API ===\n");

	/* 1a. Is the sensor in this build's devicetree at all?  If not, the fault
	 * is the board/overlay layer, not the wiring -- say exactly that instead
	 * of sending a reader chasing a soldering iron over a missing DT node. */
	if (tmp112 == NULL) {
		printk("no enabled \"ti,tmp112\" node in this build's devicetree.\n"
		       "  The E1M-AEN801 board files are what declare the on-module\n"
		       "  TMP112 on BRD_I2C; this example's own overlay deliberately\n"
		       "  adds nothing.  If you are building for a board that has no\n"
		       "  such node (native_sim, say), this is expected and the app\n"
		       "  has nothing to measure.\n");
		printk("RESULT FAIL: no ti,tmp112 node bound -- nothing to read\n");
		return 0;
	}

	/* 1b. The node exists, so the driver ran tmp112_init() -- which WRITES the
	 * CONFIG, T_LOW and T_HIGH registers.  A part that does not ACK therefore
	 * fails init and leaves the device un-ready. */
	if (!device_is_ready(tmp112)) {
		printk("TMP112 \"%s\" @0x%02x failed to initialise "
		       "(upstream tmp112_init() writes CONFIG/T_LOW/T_HIGH; no ACK).\n",
		       tmp112->name,
		       TMP112_DT_ADDR);
		printk("RESULT FAIL: TMP112 @0x%02x not ready -- check the bus wiring; "
		       "examples/aen/aen-brd-i2c-scan scans every 7-bit address and "
		       "fingerprints whatever answers\n",
		       TMP112_DT_ADDR);
		return 0;
	}

	printk("TMP112 \"%s\" ready at devicetree address 0x%02x (U20's X2SON-5 "
	       "package, ADD0 tied to 0V -- SBOS473L Table 7-4)\n",
	       tmp112->name,
	       TMP112_DT_ADDR);
	printk("taking %d samples %d ms apart ...\n", TMP112_SAMPLES, TMP112_PERIOD_MS);

	/* 2 + 3. Poll, print, band-check.  Every sample is reported individually
	 * so an intermittent bus shows up as a gap in the run rather than being
	 * averaged away into a single summary number. */
	for (int i = 0; i < TMP112_SAMPLES; i++) {
		int32_t milli_c = 0;
		int     rc      = read_ambient_milli_c(&milli_c);

		if (rc != 0) {
			/* rc is the raw errno from the sensor/I2C stack: -5 (-EIO) is a
			 * NACK -- the bus works, the part did not answer; -116
			 * (-ETIMEDOUT) is the line never being released, an electrical
			 * signature.  Printing the value keeps those distinguishable. */
			printk("  sample %d/%d: fetch failed, rc=%d\n", i + 1, TMP112_SAMPLES, rc);
		} else {
			bool plausible =
			    (milli_c >= TMP112_PLAUSIBLE_LO_MILLI_C && milli_c <= TMP112_PLAUSIBLE_HI_MILLI_C);

			n_ok++;
			n_in_band += plausible ? 1U : 0U;

			/* Integer milli-degrees C, printed as-is.  Divide by 1000 for
			 * whole degrees if you want them -- but keep the raw integer in
			 * any log you intend to parse later. */
			printk("  sample %d/%d: %d milli-degC%s\n",
			       i + 1,
			       TMP112_SAMPLES,
			       milli_c,
			       plausible ? ""
			                 : "  <-- outside the plausible indoor band "
			                   "(15000..35000); PLAUSIBILITY only, not a "
			                   "correctness verdict");
		}

		/* Not slept after the last sample: nothing follows it. */
		if (i + 1 < TMP112_SAMPLES) {
			k_msleep(TMP112_PERIOD_MS);
		}
	}

	/* 4. One machine-greppable verdict line.
	 *
	 * PASS requires every sample to have been read AND to have looked like a
	 * temperature.  A run where the reads all worked but the values sit
	 * outside the band is PARTIAL, not FAIL: the firmware and the bus are
	 * demonstrably fine, and the band is a plausibility heuristic that a
	 * legitimate cold/hot environment breaks. */
	if (n_ok == (unsigned int)TMP112_SAMPLES && n_in_band == n_ok) {
		printk("RESULT PASS: %u/%u TMP112 samples read at 0x%02x, all within the "
		       "plausible indoor band (plausibility check, not an accuracy claim)\n",
		       n_ok,
		       (unsigned int)TMP112_SAMPLES,
		       TMP112_DT_ADDR);
	} else if (n_ok > 0U) {
		printk("RESULT PARTIAL: %u/%u TMP112 samples read at 0x%02x, %u of those "
		       "within the plausible indoor band -- the sensor answers, so check "
		       "the per-sample lines above for dropped fetches or an environment "
		       "genuinely outside 15..35 degC\n",
		       n_ok,
		       (unsigned int)TMP112_SAMPLES,
		       TMP112_DT_ADDR,
		       n_in_band);
	} else {
		printk("TMP112 @0x%02x initialised but every fetch failed.\n", TMP112_DT_ADDR);
		printk("RESULT FAIL: 0/%u TMP112 samples read at 0x%02x\n",
		       (unsigned int)TMP112_SAMPLES,
		       TMP112_DT_ADDR);
	}

	return 0;
}
```
