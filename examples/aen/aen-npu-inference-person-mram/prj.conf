## CMakeLists.txt
```
# Copyright (c) 2026 Alp Lab AB
# SPDX-License-Identifier: Apache-2.0
#
# aen-npu-inference-person-mram -- a REAL-MODEL, MRAM-RESIDENT NPU inference app
# for the E1M-AEN801 (Ensemble E8, M55-HE).  Runs the person_detect MobileNet
# (int8) through the Arm Apache-2.0 InferenceProcess wrapper (ethosu_utils, the
# same runtime Alif's tflm_ethosu / executorch samples use) -> TFLM
# MicroInterpreter with AddEthosU() -> ethosu_invoke onto the Ethos-U85 (256-MAC).
#
# DIFFERENCE vs the sibling aen-npu-inference-alif (the hermetic tiny_int8
# fixture, an ITCM RAM-run image): person_detect Vela'd for the U85 is ~263 KiB
# and OVERFLOWS the 256 KiB ITCM RAM-run region, so this variant DROPS the &itcm
# overlay retarget and links into the MRAM slot0 boot partition (@0x80010000) --
# flashed + booted via Flow D (J-Link direct MRAM).  The matched-runtime fix is
# identical (strong in-app ethosu_address_remap + ethosu_config_select; see
# src/main.cpp), and the model rodata still lives in flash (now MRAM) and is
# memcpy'd into NPU-reachable SRAM0 at boot.
#
# Modules required at build time (pass via -DEXTRA_ZEPHYR_MODULES):
#   the alp-sdk checkout    (the SDK + ARM_ETHOS_U glue)
#   hal_alif                (the Alif HAL module -- ethosu_callback.c)
#   hal/ethos_u             (the Arm Ethos-U core driver lib)
#   lib/tflite-micro        (TFLM + the Ethos-U custom op)
#
# LICENSING (alp-sdk doctrine):
#   - lib/ethosu_utils/{inference_process.cpp,.hpp} + include/ethosu/InferenceRunner.h
#     are Apache-2.0 (Arm) -> VENDORED into this example (Tier-2, provenance hdr).
#   - The Alif Vela config (ensemble_vela.ini) + the subsys/modules/ethosu glue
#     are ALIF PROPRIETARY -> NOT vendored and NOT redistributed by alp-sdk.
#     Obtain ensemble_vela.ini from alp-sdk-internal and pass it explicitly:
#       -DAEN_NPU_VELA_CONFIG=<alp-sdk-internal>/.../ensemble_vela.ini
#     Without it Vela falls back to its built-in system-config and the emitted
#     command stream will NOT match the bench-validated E8 RTSS-HE runtime.

cmake_minimum_required(VERSION 3.20.0)

find_package(Zephyr REQUIRED HINTS $ENV{ZEPHYR_BASE})
project(aen_npu_inference_person_mram LANGUAGES C CXX)

# --------------------------------------------------------------------------
# Model-gen: Vela-compile person_detect for the U85 with the Alif system-config.
# --------------------------------------------------------------------------
set(AEN_NPU_VELA   "vela"
    CACHE FILEPATH "Vela compiler executable (on PATH, or override: -DAEN_NPU_VELA=<venv>/bin/vela)")
set(AEN_NPU_ACCEL  "ethos-u85-256"
    CACHE STRING   "Vela --accelerator-config (the AEN801 U85 is 256-MAC)")
# Default: the person_detect int8 MobileNet from the tflite-micro module (resolved
# via the Zephyr module dir, no local path).  Override with -DAEN_NPU_MODEL=<.tflite>.
set(AEN_NPU_MODEL  "${ZEPHYR_TFLITE_MICRO_MODULE_DIR}/tensorflow/lite/micro/models/person_detect.tflite"
    CACHE FILEPATH "Input int8 .tflite to Vela-compile")
set(AEN_NPU_MODEL_NAME "person_detect_u85"
    CACHE STRING   "Embedded model identity string")

# Input-tensor byte count the InferenceProcess job advertises -- MUST equal the
# model's input-tensor size or runJob aborts with "Input tensor size mismatch".
# person_detect [1,96,96,1] int8 = 9216; keyword_scrambled_8bit [1,96] int16 =
# 192.  Override with -DAEN_NPU_INPUT_BYTES=<n> when swapping a model.
set(AEN_NPU_INPUT_BYTES "9216"
    CACHE STRING   "Model input-tensor size in bytes (per-model)")

# ALIF PROPRIETARY Vela config -- NOT redistributed by alp-sdk.  Obtain it from
# alp-sdk-internal and pass it via -DAEN_NPU_VELA_CONFIG=<path>/ensemble_vela.ini.
# When unset, Vela uses its built-in system-config (does NOT match the bench).
set(AEN_NPU_VELA_CONFIG ""
    CACHE FILEPATH "Path to the Alif Vela config .ini (ALIF PROPRIETARY -- from alp-sdk-internal)")
if(NOT AEN_NPU_VELA_CONFIG)
	message(WARNING
		"aen-npu-inference-person-mram: AEN_NPU_VELA_CONFIG unset -- Vela will use its "
		"built-in system-config and the emitted command stream will NOT match the "
		"bench-validated E8 runtime.  Pass -DAEN_NPU_VELA_CONFIG=<alp-sdk-internal>/ensemble_vela.ini.")
endif()
set(AEN_NPU_SYSTEM_CONFIG "Ethos_U85_SRAM_Only"
    CACHE STRING   "Vela --system-config (HE core, single SRAM region)")
set(AEN_NPU_MEMORY_MODE   "Sram_Only"
    CACHE STRING   "Vela --memory-mode (single region -> SRAM0)")

set(AEN_NPU_GEN_DIR "${CMAKE_CURRENT_BINARY_DIR}/model-gen")
set(AEN_NPU_MODEL_H "${AEN_NPU_GEN_DIR}/model.h")

set(_gen_args
	--vela          ${AEN_NPU_VELA}
	--accel         ${AEN_NPU_ACCEL}
	--model         ${AEN_NPU_MODEL}
	--name          ${AEN_NPU_MODEL_NAME}
	--build-dir     ${AEN_NPU_GEN_DIR}
	--out           ${AEN_NPU_MODEL_H}
)
# --system-config/--memory-mode name sections that live ONLY in the Alif
# proprietary ensemble_vela.ini -- pass them ONLY when that config is supplied,
# else Vela errors "Section Ethos_U85_SRAM_Only not found" against its built-in
# vela.ini.  Without the Alif config Vela uses its default system-config.
if(AEN_NPU_VELA_CONFIG)
	list(APPEND _gen_args --config ${AEN_NPU_VELA_CONFIG}
	     --system-config ${AEN_NPU_SYSTEM_CONFIG} --memory-mode ${AEN_NPU_MEMORY_MODE})
endif()

add_custom_command(
	OUTPUT  ${AEN_NPU_MODEL_H}
	COMMAND ${CMAKE_COMMAND} -E make_directory ${AEN_NPU_GEN_DIR}
	COMMAND ${PYTHON_EXECUTABLE} ${CMAKE_CURRENT_SOURCE_DIR}/gen_model.py ${_gen_args}
	DEPENDS ${AEN_NPU_MODEL} ${CMAKE_CURRENT_SOURCE_DIR}/gen_model.py
	COMMENT "aen-npu-inference-alif: Vela-compiling ${AEN_NPU_MODEL} for ${AEN_NPU_ACCEL} (${AEN_NPU_SYSTEM_CONFIG})"
	VERBATIM
)

# Configure-time generation (so the include path resolves on the first build).
if(NOT EXISTS ${AEN_NPU_MODEL_H})
	execute_process(
		COMMAND ${CMAKE_COMMAND} -E make_directory ${AEN_NPU_GEN_DIR}
		COMMAND ${PYTHON_EXECUTABLE} ${CMAKE_CURRENT_SOURCE_DIR}/gen_model.py ${_gen_args}
		RESULT_VARIABLE _gen_rc
	)
	if(NOT _gen_rc EQUAL 0)
		message(FATAL_ERROR "aen-npu-inference-alif: model-gen failed (rc=${_gen_rc})")
	endif()
endif()

add_custom_target(aen_npu_model DEPENDS ${AEN_NPU_MODEL_H})
add_dependencies(app aen_npu_model)

# --------------------------------------------------------------------------
# Publish hal_alif's common/include on the GLOBAL Zephyr include path so the
# hal_alif Ethos-U callback library (modules/hal/alif/drivers/ethos_u/src/
# ethosu_callback.c) can #include <soc_memory_map.h> (the local_to_global() the
# strong ethosu_address_remap uses).
#
# WHY HERE and not via CONFIG_RTSS_HE: hal_alif's common/CMakeLists.txt adds
# that include dir only under `if(CONFIG_RTSS_HE OR CONFIG_RTSS_HP)`, but that
# same gate also compiles the TrustZone sources sau_tcm_ns_setup.c / tgu.c,
# which hard-#error without a non-secure `ns` DTS node (the fork has one; this
# RAM-run board does not, and inventing one would be inventing HW config).  We
# therefore publish ONLY the header directory and leave the TZ sources off.
# zephyr_include_directories() adds to the global interface, so the header is
# visible to the hal_alif ethos_u library TU as well as the app.
zephyr_include_directories(${ZEPHYR_ALIF_MODULE_DIR}/common/include)

target_include_directories(app PRIVATE ${AEN_NPU_GEN_DIR})

# Apache-2.0 Arm InferenceProcess wrapper (vendored into this example).
target_include_directories(app PRIVATE ${CMAKE_CURRENT_SOURCE_DIR}/ethosu_utils)
target_sources(app PRIVATE
	src/main.cpp
	ethosu_utils/inference_process.cpp
)

# Make the per-model input size a real compile define so -DAEN_NPU_INPUT_BYTES
# reaches main.cpp's input_sram[] + the job's input DataPtr size.
target_compile_definitions(app PRIVATE AEN_NPU_INPUT_BYTES=${AEN_NPU_INPUT_BYTES})
```

## prj.conf
```kconfig
# SPDX-License-Identifier: Apache-2.0
#
# aen-npu-inference-person-mram -- MATCHED-RUNTIME FULL NPU inference on the
# E1M-AEN801 (Ensemble E8, M55-HE): the real person_detect MobileNet (int8,
# Alif system-config) through the Arm Apache InferenceProcess wrapper + TFLM's
# MicroInterpreter onto the Ethos-U85 (256-MAC).  The ~263 KiB Vela'd model
# overflows ITCM, so this image links into MRAM slot0 and boots via Flow D
# (J-Link direct MRAM); console over the Alp UART console (E1M edge UART0).

# --- MRAM slot0 link --------------------------------------------------------
# Nothing to set here: the board _defconfig sets CONFIG_USE_DT_CODE_PARTITION=y,
# which honours the board's zephyr,code-partition=&slot0_partition so the image
# links at the slot0 offset (0x80010000), not the MRAM base.  Without it
# FLASH_LOAD_OFFSET stays 0 and the reset vector lands at 0x80000xxx (faults on
# an SE slot0 boot).

# --- TFLM + Ethos-U stack ---------------------------------------------------

# TFLM is C++17; the InferenceProcess wrapper + MicroInterpreter are C++.
CONFIG_CPP=y
CONFIG_STD_CPP17=y
# The Arm InferenceProcess wrapper uses std::string / std::vector / std::queue.
CONFIG_REQUIRES_FULL_LIBCPP=y

# TFLM module (MicroInterpreter, op resolver, reference kernels, and -- because
# the Ethos-U driver is enabled -- the Ethos-U custom-op kernel ethosu.cc whose
# Register_ETHOSU() -> ethosu_invoke dispatches onto the NPU).
CONFIG_TENSORFLOW_LITE_MICRO=y

# THE KEY DRIVER.  CONFIG_ETHOS_U compiles the Arm Ethos-U core driver
# (ethosu_driver.c / ethosu_device_u85.c -> ethosu_invoke + the NPU command
# stream) and the Zephyr frontend (drivers/misc/ethos_u, ETHOS_U_ARM, which
# auto-instantiates the arm,ethos-u node at POST_KERNEL).
CONFIG_ETHOS_U=y

# THE STRONG REMAP -- but NOT via hal_alif's ethosu_callback.c.
#
# CONFIG_ARM_ETHOS_U is the symbol hal_alif's drivers/CMakeLists.txt gates its
# ethosu_callback.c on (alp-sdk defines it in zephyr/Kconfig).  That file does
# carry the strong ethosu_address_remap = local_to_global we need -- BUT it was
# written against an OLDER Arm core driver and ALSO defines
# ethosu_flush_dcache / ethosu_invalidate_dcache with the OLD signature
# (uint32_t *p, size_t bytes).  The pinned hal_ethos_u core driver uses the NEW
# signature (const uint64_t *base_addr, const size_t *base_addr_size, int n) and
# upstream Zephyr's ethos_u_common.c provides matching strong versions, so
# compiling ethosu_callback.c causes a duplicate-symbol link error AND, if it
# won, the core driver would call its dcache hooks with mismatched args.
#
# So we keep ARM_ETHOS_U OFF (do not compile the stale vendor callback) and
# instead provide the strong ethosu_address_remap = local_to_global() in the
# app (src/main.cpp), which overrides the core driver's weak identity remap.
# local_to_global() itself is hal_alif's (soc_memory_map.h) -- nothing is
# re-authored.  The correct-signature dcache hooks come from upstream
# ethos_u_common.c (ETHOS_U_DCACHE below).
# CONFIG_ARM_ETHOS_U is intentionally NOT set.

# Use upstream Zephyr's correct-signature cache hooks (ethos_u_common.c).  They
# are architectural no-ops under CONFIG_DCACHE=n, but keep the strong/weak
# resolution unambiguous and ready for a future DCACHE=y re-enable.
CONFIG_ETHOS_U_DCACHE=y

# NPU variant: the AE822 (E8) NPU is an Ethos-U85; pick the 256-MAC config so
# the core driver compiles ethosu_device_u85.c and the Vela ethos-u85-256
# command stream matches the silicon.  Agrees with gen_model.py --accel and
# the Alif --system-config Ethos_U85_SRAM_Only.
CONFIG_ETHOS_U85_256=y

# --- Heap / stack -----------------------------------------------------------

# TFLM + the Ethos-U Zephyr glue + the InferenceProcess wrapper allocate from
# the system heap (k_malloc for the per-thread heap/stacks/queue nodes).
CONFIG_HEAP_MEM_POOL_SIZE=65536

# AllocateTensors + Invoke run with the InferenceProcess on the main thread
# here (single job, no worker thread); give it the upstream sample's headroom.
CONFIG_MAIN_STACK_SIZE=16384

# --- DMA correctness (the #1 bench risk) ------------------------------------

# The Ethos-U is a DMA master reading the model + arena out of SRAM0.  With the
# M55 D-cache on, the CPU could leave the model/input dirty in cache or read
# stale output.  The hal_alif callback DOES provide clean/invalidate hooks
# (ethosu_flush/invalidate_dcache), but on this bench RAM-run we keep DCACHE=n
# (the eth_dwmac approach) so the NPU and CPU share a coherent view with no
# maintenance dependency.  (Follow-up: re-enable DCACHE -- the matched runtime's
# flush/invalidate hooks are already linked via ethosu_callback.c.)
CONFIG_DCACHE=n

# --- Console ----------------------------------------------------------------
# Console: Alp UART console -- E1M edge UART0 (Alif UART5, P3_4/P3_5, 115200
# 8N1, NS16550), the E1M-AEN801 carrier console. The board _defconfig already
# selects it; we set it explicitly here so the example is self-describing.
CONFIG_SERIAL=y
CONFIG_CONSOLE=y
CONFIG_UART_CONSOLE=y
CONFIG_UART_INTERRUPT_DRIVEN=y
# Serial-less bench? Comment the four lines above and uncomment these to read
# 'ram_console_buf' over SWD instead:
# CONFIG_RAM_CONSOLE=y
# CONFIG_RAM_CONSOLE_BUFFER_SIZE=2048
# CONFIG_UART_CONSOLE=n
CONFIG_PRINTK=y
# Keep logging off so the single RESULT line prints cleanly without log
# interleaving; the PASS gate reads that printk line, not log output.
CONFIG_LOG=n
```

## src/main.cpp
```c
/*
 * Copyright (c) 2026 Alp Lab AB
 * SPDX-License-Identifier: Apache-2.0
 *
 * aen-npu-inference-person-mram -- MATCHED-RUNTIME on-silicon FULL NPU inference
 * on the E1M-AEN801 (Ensemble E8, M55-HE) with a REAL model resident in MRAM.
 * The person_detect MobileNet (int8), Vela-compiled with the ALIF system-config
 * Ethos_U85_SRAM_Only, runs through the Arm Apache-2.0 InferenceProcess wrapper
 * (ethosu_utils -- the SAME runtime Alif's tflm_ethosu / executorch samples
 * use), which drives TFLM's MicroInterpreter with AddEthosU() so the fused
 * subgraph dispatches onto the Ethos-U85 (256-MAC) via ethosu_invoke.  Because
 * the ~263 KiB Vela'd model overflows the 256 KiB ITCM RAM-run region, the image
 * links into MRAM slot0 and is flashed + SE-booted via Flow D (J-Link direct MRAM).
 *
 * WHY THIS RUNS WHERE aen-npu-inference RETURNED ethosu_invoke=1:
 *   1. A STRONG in-app ethosu_address_remap = local_to_global() (defined below)
 *      overrides the Arm core driver's weak identity remap -- the NPU's AXI
 *      master now sees the correct global view of every base address it is
 *      programmed with.  ARM_ETHOS_U stays OFF: the stale hal_alif
 *      ethosu_callback.c has a dcache signature that clashes with the pinned
 *      core driver, so we re-provide ONLY the remap here (see prj.conf).
 *   2. A STRONG in-app ethosu_config_select() pins the command stream + every
 *      region to the SRAM AXI port (the Ethos_U85_SRAM_Only layout).
 *   3. The model is Vela-compiled with the Alif --system-config
 *      Ethos_U85_SRAM_Only, so the command stream matches the E8 RTSS-HE runtime.
 *
 * WHAT THIS PROVES (and what it does NOT):
 *   It proves the full matched path: a Vela-compiled .tflite ->
 *   InferenceProcess::runJob -> tflite::GetModel() -> MicroMutableOpResolver
 *   with AddEthosU() -> MicroInterpreter::Invoke() -> ethosu_invoke -> the NPU.
 *   A runJob()==false (success) + a populated output tensor is the "real
 *   inference ran on the NPU" evidence.
 *
 *   It does NOT validate model *accuracy* -- the input is a zero-filled frame,
 *   so the argmax is meaningless.  The embedded model is the REAL person_detect
 *   MobileNet (Vela ethos-u85-256: 44 ops, 100% NPU, ~7.1M MACs/inference),
 *   ~263 KiB.  A real-frame deployment would memcpy a captured 96x96 image into
 *   input_sram; the RESULT contract (runJob OK + populated output) is
 *   model-agnostic.
 *
 * HOW WE OBSERVE (mirrors the regcheck dual-path):
 *   1. main() prints one RESULT PASS/FAIL line to the RAM console (read
 *      'ram_console_buf' over J-Link mem8, ASCII-decode).
 *   2. The same evidence is latched into file-scope volatile globals so it is
 *      readable by symbol over SWD even if the console were not captured.
 *
 * DMA placement: the model + arena live in SRAM0 (global on-chip SRAM
 * @0x02000000), NOT the M55-HE DTCM, because the NPU DMA cannot reach DTCM.
 * Combined with CONFIG_DCACHE=n, the CPU and NPU share a coherent view.  See
 * the overlay + gen_model.py.
 */

#include <cstdint>
#include <cstring>
#include <string>
#include <vector>

#include <zephyr/kernel.h>
#include <zephyr/device.h>
#include <zephyr/devicetree.h>
#include <zephyr/sys/printk.h>

/* hal_alif local_to_global() -- ITCM/DTCM CPU-local -> NPU global view. */
#include <soc_memory_map.h>

/* Arm Apache-2.0 InferenceProcess wrapper (vendored: ethosu_utils/). */
#include "inference_process.hpp"

/* Generated by gen_model.py: networkModelData[] (rodata), NETWORK_MODEL_LEN,
 * NETWORK_MODEL_NAME, TENSOR_ARENA_SIZE, and the SRAM0 placement macros. */
#include "model.h"

using namespace InferenceProcess;

/* The Ethos-U node added by boards/alp_e1m_aen801_m55_he_ae822fa0e5597ls0_rtss_he.overlay. */
#define NPU_NODE DT_NODELABEL(ethosu_npu)

/*
 * STRONG ethosu_address_remap -- the matched-runtime fix for ethosu_invoke=1.
 *
 * The Arm Ethos-U core driver programs the NPU's QBASE + every BASEP with
 * ethosu_address_remap((uintptr_t)ptr, index) (ethosu_device_u85.c:147/158).
 * Its WEAK default (ethosu_device_u85.c:54) returns the address UNCHANGED --
 * the CPU-local M55 view -- which for any ITCM/DTCM-resident buffer is NOT the
 * address the NPU's AXI master must use, so the NPU reads the wrong memory and
 * ethosu_invoke fails (status 1).
 *
 * hal_alif ships this exact override in drivers/ethos_u/src/ethosu_callback.c
 * (ethosu_address_remap = local_to_global), but that vendor file ALSO defines
 * ethosu_flush/invalidate_dcache with a signature that is STALE relative to the
 * pinned Arm core driver -- compiling it (CONFIG_ARM_ETHOS_U) collides with the
 * correct-signature upstream ethos_u_common.c dcache hooks.  So we leave that
 * vendor file out and re-provide ONLY the remap here, calling hal_alif's own
 * local_to_global() (soc_memory_map.h) -- nothing is re-authored.  This is a
 * STRONG definition; it overrides the core driver's weak identity remap.
 *
 * For the SRAM0-resident model + arena + I/O of this app, local_to_global() is
 * a no-op (SRAM0 @0x02000000 is already a global system address); the override
 * is what makes the path correct in general and what `nm` shows as a strong
 * (non-weak) ethosu_address_remap with local_to_global linked in.
 */
extern "C" uint64_t ethosu_address_remap(uint64_t address, int index)
{
	(void)index;
	/* Double cast: silence the pointer/integer width warning on 32-bit. */
	return local_to_global((void *)(uint32_t)address);
}

/*
 * STRONG ethosu_config_select -- the SECOND half of the invoke=1 fix (NPU AXI
 * PORT selection), bench-isolated on E8.
 *
 * The core driver programs the NPU's QCONFIG (command stream) + REGIONCFG
 * (each BASEP region) by calling the WEAK ethosu_config_select(addr, index)
 * (ethosu_device_u85.c:60), which returns a MEM_ATTR index 0-3.  MEM_ATTR bit2
 * picks the AXI master PORT: index 0/1 -> SRAM port, index 2/3 -> EXT port
 * (ethosu_config_u85.h).  The Arm defaults route the command stream
 * (NPU_QCONFIG=2) and region 0 (NPU_REGIONCFG_0=3) to the EXT port -- correct
 * for the Arm reference layout (const/weights in external flash/DRAM, only the
 * scratch arena in SRAM), but WRONG for the Alif `Ethos_U85_SRAM_Only`
 * system-config this app Vela-compiles with: there the model + command stream +
 * arena ALL live in SRAM0 (ensemble_vela.ini: axi0_port=Sram for const/arena/
 * cache), which is reachable ONLY over the NPU's SRAM port.  Sending the
 * SRAM-resident command stream over the EXT port bus-aborts on the very first
 * fetch.
 *
 * BENCH-CONFIRMED on E8 (ETHOS_U_LOG_LEVEL=DBG): with the Arm default, invoke
 * returns 1 and the NPU reports STATUS=0x00000804 (bus_status=1,
 * faulting_interface=1), qread=0, cmd_end_reached=0 -- i.e. an AXI bus abort on
 * interface 1 (EXT) while fetching the SRAM-resident command stream.  Pinning
 * the command stream + every region to a SRAM-port MEM_ATTR (index 0) routes
 * the SRAM0 accesses over the SRAM port and clears the fault.  Every BASEP this
 * model uses (BASEP0..4) is in SRAM0, so a uniform SRAM-port selection is both
 * correct and the simplest expression of the SRAM_Only layout.  STRONG; it
 * overrides the core driver's weak default.
 */
extern "C" unsigned int ethosu_config_select(uint64_t address, int index)
{
	(void)address;
	(void)index;
	/* MEM_ATTR index 0 = SRAM AXI port (bit2=0), for the command stream
	 * (index -1) and all regions 0-7 -- everything is SRAM0-resident. */
	return 0U;
}

/*
 * Tensor arena -- DMA-reachable SRAM0, 16-byte aligned (NPU access
 * granularity).  TENSOR_ARENA_ATTR = __aligned(16) section("SRAM0").  This is
 * the working memory the MicroInterpreter (inside InferenceProcess) hands to
 * both the CPU reference kernels and the Ethos-U op; it MUST be NPU-reachable.
 */
TENSOR_ARENA_ATTR static uint8_t tensor_arena[TENSOR_ARENA_SIZE];

/*
 * DMA-reachable copy of the model.  networkModelData[] is const rodata
 * (initialized, in ITCM/flash); the Ethos-U reads the fused command stream +
 * weights out of the model via its own AXI master, so the bytes it executes
 * MUST live in NPU-reachable SRAM0.  An *initialized* array placed directly in
 * the SRAM0 custom section is NOT init-copied by Zephyr -> garbage -> bus
 * fault.  So keep the model in rodata and memcpy it into this uninitialized
 * SRAM0 buffer at startup.
 */
static uint8_t model_sram[NETWORK_MODEL_LEN] __aligned(NPU_ALIGN) __attribute__((section("SRAM0")));

/* Output capture buffer (SRAM0 -- the NPU writes the output tensor via DMA). */
static uint8_t output_sram[256] __aligned(NPU_ALIGN) __attribute__((section("SRAM0")));

/*
 * Latched evidence, readable by symbol over SWD independent of the RAM-console
 * decode.  volatile so the stores are not optimised away.
 */
volatile int      g_runjob_failed = -1;    /* runJob() return (false == OK)    */
volatile uint32_t g_in_bytes      = 0;     /* input tensor size in bytes       */
volatile uint32_t g_out_bytes     = 0;     /* output tensor size in bytes      */
volatile uint8_t  g_out_first[16] = { 0 }; /* first output bytes (raw int8)    */
volatile int      g_argmax        = -1;    /* argmax over the output bytes     */

int main(void)
{
	printk("\n=== aen-npu-inference-person-mram (matched runtime, MRAM slot0) ===\n");
	printk("model      : %s (%u bytes)\n", NETWORK_MODEL_NAME, (unsigned)NETWORK_MODEL_LEN);
	printk(
	    "arena      : %u bytes @ SRAM0 (%p)\n", (unsigned)TENSOR_ARENA_SIZE, (void *)tensor_arena);

	/*
	 * The Arm Ethos-U core driver auto-instantiates the NPU device at
	 * POST_KERNEL (the arm,ethos-u node is status="okay").  Reaching main()
	 * with device_is_ready()==1 means ethosu_init() (incl. the NPU soft reset)
	 * completed -- a prerequisite for ethosu_invoke to succeed.
	 */
	const struct device *npu       = DEVICE_DT_GET(NPU_NODE);
	bool                 npu_ready = device_is_ready(npu);
	printk(
	    "npu ready  : %d (Ethos-U85 @0x%08x)\n", (int)npu_ready, (unsigned)DT_REG_ADDR(NPU_NODE));

	/* Stage the model into DMA-reachable SRAM0 (see model_sram comment). */
	memcpy(model_sram, networkModelData, NETWORK_MODEL_LEN);

	/*
	 * Build the inference job.  InferenceProcess::runJob strictly validates
	 * input DataPtr.size == the network's input-tensor byte count, so the input
	 * size must match the model exactly.  person_detect's input is [1,96,96,1]
	 * int8 = 9216 bytes (output [1,2] int8 = 2 bytes); AEN_NPU_INPUT_BYTES
	 * defaults to that.  Override -DAEN_NPU_INPUT_BYTES when swapping a different
	 * model via -DAEN_NPU_MODEL -- a mismatch surfaces as RESULT FAIL with the
	 * network's expected size printed by runJob, so the operator re-tunes in one
	 * shot.  The SRAM0 input region (DMA-reachable) is sized to the input and
	 * zero-filled; a real deployment would memcpy a captured frame here.
	 */
#ifndef AEN_NPU_INPUT_BYTES
#define AEN_NPU_INPUT_BYTES 9216 /* person_detect: input [1,96,96,1] int8 */
#endif
	static uint8_t input_sram[AEN_NPU_INPUT_BYTES] __aligned(NPU_ALIGN)
	    __attribute__((section("SRAM0")));
	memset(input_sram, 0, sizeof(input_sram));

	const size_t input_bytes = AEN_NPU_INPUT_BYTES;

	g_in_bytes = (uint32_t)input_bytes;
	printk("input      : %u bytes (zero-filled, SRAM0)\n", (unsigned)input_bytes);

	InferenceJob job(std::string(NETWORK_MODEL_NAME),
	                 DataPtr((void *)model_sram, NETWORK_MODEL_LEN),
	                 { DataPtr((void *)input_sram, input_bytes) },
	                 { DataPtr((void *)output_sram, sizeof(output_sram)) },
	                 {});

	/*
	 * Run inference via the matched Arm InferenceProcess.  Internally:
	 *   GetModel -> MicroMutableOpResolver<1>::AddEthosU ->
	 *   MicroInterpreter(arena) -> AllocateTensors -> copy input ->
	 *   Invoke() (the fused Ethos-U op -> ethosu_invoke -> NPU IRQ) ->
	 *   copyOutput into the output DataPtr.
	 * runJob returns FALSE on success, TRUE on any failure.
	 */
	InferenceProcess::InferenceProcess inference(tensor_arena, TENSOR_ARENA_SIZE);
	bool                               failed = inference.runJob(job);
	g_runjob_failed                           = (int)failed;

	if (failed) {
		printk("RESULT FAIL: runJob failed (schema/alloc/invoke/size) "
		       "npu_ready=%d -- see log above for the exact stage\n",
		       (int)npu_ready);
		return 0;
	}

	/*
	 * runJob updated job.output[0].size to the actual output byte count and
	 * copied the NPU's output into output_sram.  Latch the first bytes +
	 * argmax for the RESULT line and the SWD symbol read.
	 */
	uint32_t out_bytes = (uint32_t)job.output[0].size;
	g_out_bytes        = out_bytes;

	uint32_t n           = out_bytes < 16u ? out_bytes : 16u;
	int      best_i      = -1;
	int      best_v      = -128; /* int8 floor */
	bool     any_nonzero = false;
	for (uint32_t i = 0; i < out_bytes; i++) {
		int8_t v = (int8_t)output_sram[i];
		if (i < n) {
			g_out_first[i] = (uint8_t)v;
		}
		if (v != 0) {
			any_nonzero = true;
		}
		if (v > best_v) {
			best_v = v;
			best_i = (int)i;
		}
	}
	g_argmax = best_i;

	printk("output     : %u bytes, argmax=%d (val=%d), first[0..%u]=",
	       (unsigned)out_bytes,
	       best_i,
	       best_v,
	       (unsigned)(n ? n - 1 : 0));
	for (uint32_t i = 0; i < n; i++) {
		printk("%02x ", g_out_first[i]);
	}
	printk("\n");

	/*
	 * PASS = inference completed AND the NPU actually produced a result.
	 * any_nonzero guards the silent-failure case (an all-zero output despite a
	 * runJob success would mean the NPU did not really write the tensor).
	 */
	bool ok = (!failed) && (out_bytes > 0) && any_nonzero;
	if (ok) {
		printk("RESULT PASS: NPU inference complete -- model=%s runJob=OK "
		       "out_bytes=%u argmax=%d npu_ready=%d\n",
		       NETWORK_MODEL_NAME,
		       (unsigned)out_bytes,
		       best_i,
		       (int)npu_ready);
	} else {
		printk("RESULT FAIL: runJob_failed=%d out_bytes=%u nonzero=%d "
		       "npu_ready=%d -- output not populated\n",
		       (int)failed,
		       (unsigned)out_bytes,
		       (int)any_nonzero,
		       (int)npu_ready);
	}

	return 0;
}
```
