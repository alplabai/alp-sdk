## CMakeLists.txt
```
# Copyright (c) 2026 Alp Lab AB
# SPDX-License-Identifier: Apache-2.0
#
# aen-npu-inference -- on-silicon FULL NPU inference on the E1M-AEN801 (Ensemble
# E8, M55-HE).  A Vela-compiled int8 model runs through TFLM's MicroInterpreter,
# whose Ethos-U custom-op resolver dispatches the fused subgraph onto the
# Ethos-U85 (256-MAC) NPU via the Arm Ethos-U core driver (ethosu_invoke).
#
# This is the inference follow-up to aen-npu-ethosu-regcheck (which proved the
# U85 is present + clocked).  It mirrors the upstream tflm_ethosu sample's
# end-to-end pattern: Vela-compile -> embed the network as a C array -> TFLM
# MicroInterpreter + MicroMutableOpResolver::AddEthosU() -> Invoke().
#
# Modules required at build time (pass via -DEXTRA_ZEPHYR_MODULES):
#   <alp-sdk>                                   (the SDK; provides ALP_SDK Kconfig)
#   <zephyr-workspace>/modules/hal/alif         (hal_alif -- SoC support)
#   <zephyr-workspace>/modules/hal/ethos_u      (Arm Ethos-U core driver lib)
#   <tflite-micro path>                         (TFLM sources + Zephyr glue)
#
# The model-gen step (gen_model.py) runs vela from .venv-vela and writes
# model.h into the build tree, so the source tree carries no generated blob.
#
# LICENSING (alp-sdk doctrine): the Alif Vela system-config (ensemble_vela.ini)
# is ALIF PROPRIETARY and is NOT vendored / redistributed by alp-sdk.  It is
# injected at build time from alp-sdk-internal via -DAEN_NPU_VELA_CONFIG=<path>
# (default empty -> Vela's built-in system-config, which does NOT match the
# bench-validated E8 RTSS-HE runtime).
#
# The ethosu_invoke=1 fix itself is alp-sdk's AEN Ethos-U backend
# (src/backends/inference/ethos_u_aen.cpp, CONFIG_ALP_SDK_INFERENCE_BACKEND_
# ETHOS_U_AEN=y in prj.conf) -- it supplies the strong ethosu_address_remap /
# ethosu_config_select overrides.  Measured 2026-07-28: the Vela
# --memory-mode/--system-config flags are NOT that fix by themselves (a
# byte-identical Vela blob to the aen-npu-inference-alif sibling still
# returned invoke=1 without the overrides); they only make the compiled
# command stream match the bench-validated Alif system-config when
# AEN_NPU_VELA_CONFIG is supplied.

cmake_minimum_required(VERSION 3.20.0)

find_package(Zephyr REQUIRED HINTS $ENV{ZEPHYR_BASE})
project(aen_npu_inference LANGUAGES C CXX)

# --------------------------------------------------------------------------
# Model-gen: Vela-compile the fixture for the U85 and emit model.h.
# --------------------------------------------------------------------------
# Defaults target the in-tree FIXTURE model (tiny_int8.tflite).  Override
# -DAEN_NPU_MODEL=<path> on the command line to point at a larger REAL int8
# model (e.g. a person-detect / mobilenet) once one is staged in-tree; the
# RESULT contract in main.c is model-agnostic.
#
# Vela default: prefer `vela` on PATH (a venv the user has activated, a
# system install, ...); fall back to the in-tree .venv-vela only if PATH has
# nothing.  That fallback assumes a venv location relative to the SOURCE
# tree, which does not exist in every checkout (e.g. a git worktree) -- so
# it is a fallback, not the primary lookup.  -DAEN_NPU_VELA=<path> always
# wins over both (CACHE set here is a no-op once the var is already defined
# on the command line).
find_program(_aen_npu_vela_on_path vela)
if(_aen_npu_vela_on_path)
    set(_aen_npu_vela_default ${_aen_npu_vela_on_path})
else()
    set(_aen_npu_vela_default "${CMAKE_CURRENT_SOURCE_DIR}/../../../.venv-vela/bin/vela")
endif()
set(AEN_NPU_VELA   "${_aen_npu_vela_default}"
    CACHE FILEPATH "Path to the Vela compiler executable (defaults to `vela` on PATH, else the in-tree .venv-vela)")
set(AEN_NPU_ACCEL  "ethos-u85-256"
    CACHE STRING   "Vela --accelerator-config (the AEN801 U85 is 256-MAC)")
set(AEN_NPU_MODEL  "${CMAKE_CURRENT_SOURCE_DIR}/../../../tests/fixtures/models/tiny_int8.tflite"
    CACHE FILEPATH "Input int8 .tflite to Vela-compile")
set(AEN_NPU_MODEL_NAME "tiny_int8_fixture"
    CACHE STRING   "Embedded model identity string")

# ALIF PROPRIETARY Vela config -- NOT redistributed by alp-sdk.  Obtain it from
# alp-sdk-internal and pass it via -DAEN_NPU_VELA_CONFIG=<path>/ensemble_vela.ini.
# When unset, Vela uses its built-in system-config (does NOT match the bench).
set(AEN_NPU_VELA_CONFIG ""
    CACHE FILEPATH "Path to the Alif Vela config .ini (ALIF PROPRIETARY -- from alp-sdk-internal)")
if(NOT AEN_NPU_VELA_CONFIG)
	message(WARNING
		"aen-npu-inference: AEN_NPU_VELA_CONFIG unset -- Vela will use its built-in "
		"system-config and the emitted command stream will NOT match the "
		"bench-validated E8 runtime.  Pass -DAEN_NPU_VELA_CONFIG=<alp-sdk-internal>/ensemble_vela.ini.")
endif()
set(AEN_NPU_SYSTEM_CONFIG "Ethos_U85_SRAM_Only"
    CACHE STRING   "Vela --system-config (HE core, single SRAM region)")
set(AEN_NPU_MEMORY_MODE   "Sram_Only"
    CACHE STRING   "Vela --memory-mode (single region -> SRAM0)")

set(AEN_NPU_GEN_DIR "${CMAKE_CURRENT_BINARY_DIR}/model-gen")
set(AEN_NPU_MODEL_H "${AEN_NPU_GEN_DIR}/model.h")

# Common gen_model.py args (the Vela --config is appended only when the
# Alif-proprietary .ini is supplied, so an unset config omits the flag).
set(_gen_args
	--vela       ${AEN_NPU_VELA}
	--accel      ${AEN_NPU_ACCEL}
	--model      ${AEN_NPU_MODEL}
	--name       ${AEN_NPU_MODEL_NAME}
	--build-dir  ${AEN_NPU_GEN_DIR}
	--out        ${AEN_NPU_MODEL_H}
)
# --system-config/--memory-mode name sections that live ONLY in the Alif
# proprietary ensemble_vela.ini -- pass them ONLY when that config is
# supplied, else Vela errors "Section ... not found" against its built-in
# vela.ini (matches the aen-npu-inference-alif sibling's pattern).
if(AEN_NPU_VELA_CONFIG)
	list(APPEND _gen_args --config ${AEN_NPU_VELA_CONFIG}
	     --system-config ${AEN_NPU_SYSTEM_CONFIG} --memory-mode ${AEN_NPU_MEMORY_MODE})
endif()

# Run at configure time so the header exists before the first compile, and
# again as a build rule so editing the input model / gen script re-runs it.
add_custom_command(
	OUTPUT  ${AEN_NPU_MODEL_H}
	COMMAND ${CMAKE_COMMAND} -E make_directory ${AEN_NPU_GEN_DIR}
	COMMAND ${PYTHON_EXECUTABLE} ${CMAKE_CURRENT_SOURCE_DIR}/gen_model.py ${_gen_args}
	DEPENDS ${AEN_NPU_MODEL} ${CMAKE_CURRENT_SOURCE_DIR}/gen_model.py
	COMMENT "aen-npu-inference: Vela-compiling ${AEN_NPU_MODEL} for ${AEN_NPU_ACCEL}"
	VERBATIM
)

# Configure-time generation (so the include path resolves on the first build).
if(NOT EXISTS ${AEN_NPU_MODEL_H})
	execute_process(
		COMMAND ${CMAKE_COMMAND} -E make_directory ${AEN_NPU_GEN_DIR}
		COMMAND ${PYTHON_EXECUTABLE} ${CMAKE_CURRENT_SOURCE_DIR}/gen_model.py ${_gen_args}
		RESULT_VARIABLE _gen_rc
	)
	if(NOT _gen_rc EQUAL 0)
		message(FATAL_ERROR "aen-npu-inference: model-gen failed (rc=${_gen_rc})")
	endif()
endif()

add_custom_target(aen_npu_model DEPENDS ${AEN_NPU_MODEL_H})
add_dependencies(app aen_npu_model)

# Publish hal_alif's common/include on the GLOBAL Zephyr include path so
# alp-sdk's AEN Ethos-U backend (src/backends/inference/ethos_u_aen.cpp,
# enabled by CONFIG_ALP_SDK_INFERENCE_BACKEND_ETHOS_U_AEN in prj.conf) can
# #include <soc_memory_map.h> (local_to_global(), its strong
# ethosu_address_remap uses).  Header only -- not CONFIG_RTSS_HE, which would
# also compile the TZ sources that hard-#error without a non-secure DTS node
# on this bench board (see aen-npu-inference-alif's CMakeLists.txt).
zephyr_include_directories(${ZEPHYR_ALIF_MODULE_DIR}/common/include)

target_include_directories(app PRIVATE ${AEN_NPU_GEN_DIR})
target_sources(app PRIVATE src/main.cpp)
```

## prj.conf
```kconfig
# SPDX-License-Identifier: Apache-2.0
#
# aen-npu-inference -- FULL NPU inference on the E1M-AEN801 (Ensemble E8,
# M55-HE): a Vela-compiled int8 model through TFLM's MicroInterpreter onto the
# Ethos-U85 (256-MAC).  Bench RAM-run flow.

# --- TFLM + Ethos-U stack (mirrors samples/.../tflm_ethosu) -----------------

# TFLM is C++17.  MicroInterpreter / MicroMutableOpResolver are only exposed via
# the C++ surface, so the app's main is .cpp.
CONFIG_CPP=y
CONFIG_STD_CPP17=y

# Pull in the tflite-micro module (TENSORFLOW_LITE_MICRO) -- the MicroInterpreter,
# the op resolver, the reference kernels, and (because CONFIG_ETHOS_U is also set)
# the Ethos-U custom-op kernel tensorflow/lite/micro/kernels/ethos_u/ethosu.cc,
# whose Register_ETHOSU() -> ethosu_invoke_v3() dispatches onto the NPU.
CONFIG_TENSORFLOW_LITE_MICRO=y

# Arm Ethos-U core driver (hal/ethos_u module): ethosu_init / ethosu_invoke_v3 /
# the IRQ handler + the Zephyr glue (drivers/misc/ethos_u/ethos_u_arm.c, auto-
# instantiated for the arm,ethos-u node at POST_KERNEL).  ETHOS_U depends on
# MULTITHREADING (default y).
CONFIG_ETHOS_U=y

# --- alp-sdk Ethos-U AXI/MEM_ATTR routing (the actual ethosu_invoke=1 fix) ---
# The Arm core driver's weak ethosu_address_remap()/ethosu_config_select()
# defaults route the command stream + regions to the EXT AXI port and leave
# ITCM/DTCM addresses untranslated -- wrong for this board's all-in-SRAM0
# layout (bus-aborts on the first NPU fetch).  alp-sdk's AEN Ethos-U backend
# (src/backends/inference/ethos_u_aen.cpp) supplies the STRONG overrides that
# fix this; enabling it here (even though this app drives inference through
# the raw InferenceProcess wrapper, not <alp/inference.h>) is enough to link
# them in -- Zephyr links every alp-sdk TU with --whole-archive, so the
# override wins regardless of whether the app calls into the SDK dispatcher.
CONFIG_ALP_SDK=y
CONFIG_ALP_SDK_INFERENCE_BACKEND_TFLM=y
CONFIG_ALP_SDK_INFERENCE_BACKEND_ETHOS_U_AEN=y
CONFIG_ALP_SDK_INFERENCE_ETHOS_U_VARIANT_U85=y

# NPU variant: the AE822 (E8) NPU is an Ethos-U85; pick the 256-MAC config so the
# core driver compiles ethosu_device_u85.c and Vela's ethos-u85-256 command
# stream matches the silicon.  This MUST agree with gen_model.py's
# --accelerator-config ethos-u85-256.
CONFIG_ETHOS_U85_256=y

# --- Heap / stack -----------------------------------------------------------

# TFLM + the Ethos-U Zephyr glue allocate from the system heap (the glue's
# mutex/semaphore objects via k_malloc; TFLM scratch).  Generous pool -- the
# tensor arena itself is a static SRAM0 buffer, NOT heap, so this only covers
# the runtime's bookkeeping.
CONFIG_HEAP_MEM_POOL_SIZE=65536

# MicroInterpreter::AllocateTensors + Invoke run on the main thread; give it
# headroom (the upstream sample uses an 8 KiB runner stack).
CONFIG_MAIN_STACK_SIZE=16384

# --- DMA correctness (the #1 bench risk) ------------------------------------

# The Ethos-U is a DMA master reading the model + arena out of SRAM0.  With the
# M55 data cache on, the CPU could leave the model/input dirty in cache (NPU
# reads stale memory) or read stale output the NPU wrote behind the cache.  The
# upstream driver guards this with clean/invalidate-by-address, but on this
# bench RAM-run we take the eth_dwmac approach and disable the D-cache outright
# so the NPU and CPU share a coherent view with no maintenance calls.  (Follow-up:
# re-enable DCACHE + add SCB_CleanDCache/InvalidateDCache around Invoke, like
# inference_process.cpp's DataPtr::clean()/invalidate(), once bench-proven.)
CONFIG_DCACHE=n

# --- Console ----------------------------------------------------------------
# Console: Alp UART console -- E1M edge UART0 (Alif UART5, P3_4/P3_5, 115200
# 8N1, NS16550), the E1M-AEN801 carrier console. The board _defconfig already
# selects it; we set it explicitly here so the example is self-describing.
CONFIG_SERIAL=y
CONFIG_CONSOLE=y
CONFIG_UART_CONSOLE=y
CONFIG_UART_INTERRUPT_DRIVEN=y
# Serial-less bench? Comment the four lines above and uncomment these to read
# 'ram_console_buf' over SWD instead:
# CONFIG_RAM_CONSOLE=y
# CONFIG_RAM_CONSOLE_BUFFER_SIZE=2048
# CONFIG_UART_CONSOLE=n
CONFIG_PRINTK=y
# Logging OFF so the single RESULT line is not interleaved.
CONFIG_LOG=n

# printf with %f is not used; keep the image lean.
```

## boards/alp_e1m_aen801_m55_he_ae822fa0e5597ls0_rtss_he.overlay
```dts
/*
 * Copyright (c) 2026 Alp Lab AB
 * SPDX-License-Identifier: Apache-2.0
 *
 * aen-npu-inference overlay for the E1M-AEN801 (Ensemble E8, M55-HE) RAM-run --
 * adds the Arm Ethos-U85 NPU node and retargets ROM to ITCM, identical to the
 * aen-npu-ethosu-regcheck overlay it is derived from.  See that app's overlay
 * header for the full provenance of the NPU node (base 0x49042000, IRQ 366,
 * secure/privilege flags from Alif's Apache-2.0 zephyr_alif fork).
 *
 * =====================  THE #1 BENCH RISK: DMA PLACEMENT  ====================
 * The Ethos-U85 is a DMA bus master: it reads the Vela command stream + weights
 * (the embedded model) and the intermediate tensors (the TFLM arena) over its
 * own AXI master, and writes the output tensor back the same way.  Those buffers
 * MUST live in memory the NPU can reach.
 *
 * The generated M55-HE board sets `zephyr,sram = &dtcm` -- the M55's tightly-
 * coupled DTCM.  DTCM is private to the CPU and is NOT on the NPU's DMA path, so
 * an arena/model left in the default .bss/.noinit (which lands in DTCM) would be
 * invisible to the NPU and the inference would read garbage / fault.
 *
 * Fix (mirrors the eth_dwmac DMA-buffers-in-sram0 + DCACHE=n finding): the model
 * + arena are tagged into the "SRAM0" linker region -- the global on-chip SRAM
 * @0x02000000 (4 MiB), declared by the SoC dtsi sram0 node:
 *
 *     sram0: sram@2000000 {
 *             compatible = "zephyr,memory-region", "mmio-sram";
 *             reg = <0x2000000 DT_SIZE_M(4)>;
 *             zephyr,memory-region = "SRAM0";   <-- becomes the "SRAM0" section
 *     };
 *
 * gen_model.py emits `__attribute__((section("SRAM0")))` on networkModelData[]
 * and main.cpp does the same on the tensor arena, so the linker places both in
 * that 4 MiB bank.  Combined with CONFIG_DCACHE=n (prj.conf), the CPU and NPU
 * share a coherent view of SRAM0 with no cache-maintenance calls.
 * ============================================================================
 */

/*
 * RAM-run: the SoC `select` puts code in XIP; retarget ROM to ITCM so the image
 * links + runs from RAM (J-Link loadbin+go, no reset).  PATH-REFERENCE form
 * (&itcm) -- the phandle-array form <&itcm> makes FLASH_SIZE=0 and overflows the
 * link.  Same as the regcheck overlay.
 */
/ {
	chosen {
		zephyr,flash = &itcm;
		/delete-property/ zephyr,code-partition;
	};
};

&soc {
	/*
	 * Arm Ethos-U85 NPU.  compatible "arm,ethos-u" (binding arm,ethos-u.yaml),
	 * driven by the Arm Ethos-U core driver's Zephyr frontend
	 * (drivers/misc/ethos_u/ethos_u_arm.c, DT_DRV_COMPAT arm_ethos_u).
	 * status="okay" makes DT_HAS_ARM_ETHOS_U_ENABLED true, which builds the
	 * frontend and auto-instantiates the device at POST_KERNEL -- ethosu_init()
	 * runs the NPU soft-reset before main(), and the TFLM Ethos-U kernel later
	 * grabs this driver instance via ethosu_reserve_driver() inside Invoke().
	 *
	 * IRQ 366 + secure/privilege flags transcribed verbatim from the fork node.
	 * No `clocks` property: the fork's ethosu85 node carries none -- the NPU
	 * clock/power is brought up outside the Zephyr clockctrl (regcheck already
	 * confirmed the block is clocked: device_is_ready=1, ID=0x20007001).
	 */
	ethosu_npu: ethosu85@49042000 {
		compatible = "arm,ethos-u";
		reg = <0x49042000 0x1000>;
		interrupts = <366 3>;
		interrupt-parent = <&nvic>;
		secure-enable;
		privilege-enable;
		status = "okay";
	};
};
```

## boards/alp_e1m_aen803_m55_he_ae822fa0e5597ls0_rtss_he.overlay
```dts
/*
 * Copyright (c) 2026 Alp Lab AB
 * SPDX-License-Identifier: Apache-2.0
 *
 * aen-npu-inference overlay for the E1M-AEN803 (Ensemble E8, M55-HE) RAM-run --
 * adds the Arm Ethos-U85 NPU node and retargets ROM to ITCM, identical to the
 * aen-npu-ethosu-regcheck overlay it is derived from.  See that app's overlay
 * header for the full provenance of the NPU node (base 0x49042000, IRQ 366,
 * secure/privilege flags from Alif's Apache-2.0 zephyr_alif fork).
 *
 * =====================  THE #1 BENCH RISK: DMA PLACEMENT  ====================
 * The Ethos-U85 is a DMA bus master: it reads the Vela command stream + weights
 * (the embedded model) and the intermediate tensors (the TFLM arena) over its
 * own AXI master, and writes the output tensor back the same way.  Those buffers
 * MUST live in memory the NPU can reach.
 *
 * The generated M55-HE board sets `zephyr,sram = &dtcm` -- the M55's tightly-
 * coupled DTCM.  DTCM is private to the CPU and is NOT on the NPU's DMA path, so
 * an arena/model left in the default .bss/.noinit (which lands in DTCM) would be
 * invisible to the NPU and the inference would read garbage / fault.
 *
 * Fix (mirrors the eth_dwmac DMA-buffers-in-sram0 + DCACHE=n finding): the model
 * + arena are tagged into the "SRAM0" linker region -- the global on-chip SRAM
 * @0x02000000 (4 MiB), declared by the SoC dtsi sram0 node:
 *
 *     sram0: sram@2000000 {
 *             compatible = "zephyr,memory-region", "mmio-sram";
 *             reg = <0x2000000 DT_SIZE_M(4)>;
 *             zephyr,memory-region = "SRAM0";   <-- becomes the "SRAM0" section
 *     };
 *
 * gen_model.py emits `__attribute__((section("SRAM0")))` on networkModelData[]
 * and main.cpp does the same on the tensor arena, so the linker places both in
 * that 4 MiB bank.  Combined with CONFIG_DCACHE=n (prj.conf), the CPU and NPU
 * share a coherent view of SRAM0 with no cache-maintenance calls.
 * ============================================================================
 */

/*
 * RAM-run: the SoC `select` puts code in XIP; retarget ROM to ITCM so the image
 * links + runs from RAM (J-Link loadbin+go, no reset).  PATH-REFERENCE form
 * (&itcm) -- the phandle-array form <&itcm> makes FLASH_SIZE=0 and overflows the
 * link.  Same as the regcheck overlay.
 */
/ {
	chosen {
		zephyr,flash = &itcm;
		/delete-property/ zephyr,code-partition;
	};
};

&soc {
	/*
	 * Arm Ethos-U85 NPU.  compatible "arm,ethos-u" (binding arm,ethos-u.yaml),
	 * driven by the Arm Ethos-U core driver's Zephyr frontend
	 * (drivers/misc/ethos_u/ethos_u_arm.c, DT_DRV_COMPAT arm_ethos_u).
	 * status="okay" makes DT_HAS_ARM_ETHOS_U_ENABLED true, which builds the
	 * frontend and auto-instantiates the device at POST_KERNEL -- ethosu_init()
	 * runs the NPU soft-reset before main(), and the TFLM Ethos-U kernel later
	 * grabs this driver instance via ethosu_reserve_driver() inside Invoke().
	 *
	 * IRQ 366 + secure/privilege flags transcribed verbatim from the fork node.
	 * No `clocks` property: the fork's ethosu85 node carries none -- the NPU
	 * clock/power is brought up outside the Zephyr clockctrl (regcheck already
	 * confirmed the block is clocked: device_is_ready=1, ID=0x20007001).
	 */
	ethosu_npu: ethosu85@49042000 {
		compatible = "arm,ethos-u";
		reg = <0x49042000 0x1000>;
		interrupts = <366 3>;
		interrupt-parent = <&nvic>;
		secure-enable;
		privilege-enable;
		status = "okay";
	};
};
```

## src/main.cpp
```c
/*
 * Copyright (c) 2026 Alp Lab AB
 * SPDX-License-Identifier: Apache-2.0
 *
 * aen-npu-inference -- on-silicon FULL NPU inference on the E1M-AEN801 (Ensemble
 * E8, M55-HE).  A Vela-compiled int8 model runs through TFLM's MicroInterpreter,
 * whose Ethos-U custom-op resolver dispatches the fused subgraph onto the
 * Ethos-U85 (256-MAC) NPU.  This is the inference follow-up to
 * aen-npu-ethosu-regcheck (which proved the U85 is present + clocked,
 * ID=0x20007001, device_is_ready=1).
 *
 * WHAT THIS PROVES (and what it does NOT):
 *   It proves the full path: a Vela-compiled .tflite -> tflite::GetModel() ->
 *   MicroMutableOpResolver with AddEthosU() (registers the "ethos-u" custom op)
 *   -> MicroInterpreter::Invoke().  When the interpreter hits the fused Ethos-U
 *   op, the TFLM kernel (tensorflow/lite/micro/kernels/ethos_u/ethosu.cc) calls
 *   ethosu_invoke_v3() on the Arm Ethos-U core driver, which streams the command
 *   stream to the NPU and blocks on its IRQ until the NPU finishes.  A
 *   kTfLiteOk return + a populated output tensor is the "real inference ran on
 *   the NPU" evidence.
 *
 *   It does NOT validate model *accuracy* -- the embedded model is the in-tree
 *   FIXTURE tiny_int8.tflite (Vela reports 1 NPU op, 100% NPU, 8 MACs), chosen
 *   so the bench app is hermetic and small.  A real-model end-to-end (a person-
 *   detect / mobilenet int8 with a known expected argmax) is the documented
 *   follow-up: rebuild with -DAEN_NPU_MODEL=<real.tflite>; the RESULT contract
 *   below is model-agnostic.
 *
 * HOW WE OBSERVE (mirrors the regcheck dual-path):
 *   1. main() prints one RESULT PASS/FAIL line to the RAM console (read
 *      'ram_console_buf' over J-Link mem8, ASCII-decode).
 *   2. The same evidence is latched into file-scope globals (g_invoke_status,
 *      g_out_bytes, g_out_first[]) so it is readable by symbol over SWD even if
 *      the console were not captured.  volatile so the stores survive -O2.
 *
 * PASS gate:
 *   - the model schema version is accepted,
 *   - AllocateTensors() == kTfLiteOk (arena big enough, all ops resolved),
 *   - Invoke() == kTfLiteOk (the Ethos-U op dispatched + the NPU completed),
 *   - the output tensor is non-empty (bytes > 0) and not all-zero (the NPU
 *     actually wrote a result; an all-zero output on a non-trivial model would
 *     be the silent-failure signal we want to catch).
 *
 * DMA placement (the #1 bench risk): the model + arena live in SRAM0 (global
 * on-chip SRAM @0x02000000), NOT the M55-HE DTCM, because the NPU DMA cannot
 * reach DTCM.  The model gets its section via gen_model.py; the arena via the
 * TENSOR_ARENA_ATTR macro in the generated model.h (also "SRAM0").  Combined
 * with CONFIG_DCACHE=n, the CPU and NPU share a coherent view.  See the overlay.
 */

#include <cstdint>
#include <cstring>

#include <zephyr/kernel.h>
#include <zephyr/device.h>
#include <zephyr/devicetree.h>
#include <zephyr/sys/printk.h>

#include "tensorflow/lite/micro/micro_interpreter.h"
#include "tensorflow/lite/micro/micro_mutable_op_resolver.h"
#include "tensorflow/lite/schema/schema_generated.h"

/* Generated by gen_model.py: networkModelData[] (in SRAM0), NETWORK_MODEL_LEN,
 * NETWORK_MODEL_NAME, TENSOR_ARENA_SIZE, and the TENSOR_ARENA_ATTR placement
 * macro (also SRAM0). */
#include "model.h"

/* The Ethos-U node added by boards/alp_e1m_aen801_m55_he_ae822fa0e5597ls0_rtss_he.overlay. */
#define NPU_NODE DT_NODELABEL(ethosu_npu)

/*
 * Tensor arena -- DMA-reachable SRAM0, 16-byte aligned (NPU access granularity).
 * TENSOR_ARENA_ATTR resolves to __aligned(16) __attribute__((section("SRAM0"))).
 * This is the working memory the MicroInterpreter hands to both the CPU
 * reference kernels and the Ethos-U op; it MUST be NPU-reachable.
 */
TENSOR_ARENA_ATTR static uint8_t tensor_arena[TENSOR_ARENA_SIZE];

/*
 * DMA-reachable copy of the model.  networkModelData[] is const rodata (correctly
 * initialized, in ITCM/flash); the Ethos-U reads the fused command stream +
 * weights out of the model via its own AXI master, so the bytes it executes MUST
 * live in NPU-reachable SRAM0.  An *initialized* array placed directly in the
 * SRAM0 custom section is NOT init-copied by Zephyr (zephyr,memory-region
 * sections get no load-copy) -> garbage -> bus fault.  So keep the model in
 * rodata and memcpy it into this uninitialized SRAM0 buffer at startup.
 */
static uint8_t model_sram[NETWORK_MODEL_LEN] __aligned(NPU_ALIGN) __attribute__((section("SRAM0")));

/*
 * Latched evidence, readable by symbol over SWD independent of the RAM-console
 * decode.  volatile so the stores are not optimised away.
 */
volatile int      g_invoke_status = -1;    /* TfLiteStatus of Invoke()         */
volatile int      g_alloc_status  = -1;    /* TfLiteStatus of AllocateTensors  */
volatile uint32_t g_in_bytes      = 0;     /* input tensor size in bytes       */
volatile uint32_t g_out_bytes     = 0;     /* output tensor size in bytes      */
volatile uint8_t  g_out_first[16] = { 0 }; /* first output bytes (raw int8)    */
volatile int      g_argmax        = -1;    /* argmax over the output bytes     */

int main(void)
{
	printk("\n=== aen-npu-inference ===\n");
	printk("model      : %s (%u bytes)\n", NETWORK_MODEL_NAME, (unsigned)NETWORK_MODEL_LEN);
	printk(
	    "arena      : %u bytes @ SRAM0 (%p)\n", (unsigned)TENSOR_ARENA_SIZE, (void *)tensor_arena);

	/*
	 * The Arm Ethos-U core driver auto-instantiates the NPU device at
	 * POST_KERNEL (the arm,ethos-u node is status="okay").  Reaching main()
	 * with device_is_ready()==1 means ethosu_init() (incl. the NPU soft reset)
	 * completed -- a prerequisite for ethosu_invoke_v3() to succeed.
	 */
	const struct device *npu       = DEVICE_DT_GET(NPU_NODE);
	bool                 npu_ready = device_is_ready(npu);
	printk(
	    "npu ready  : %d (Ethos-U85 @0x%08x)\n", (int)npu_ready, (unsigned)DT_REG_ADDR(NPU_NODE));

	/* Stage the model into DMA-reachable SRAM0 (see model_sram comment). */
	memcpy(model_sram, networkModelData, NETWORK_MODEL_LEN);

	/* Verify the embedded model's schema version. */
	const tflite::Model *model = tflite::GetModel(model_sram);
	if (model->version() != TFLITE_SCHEMA_VERSION) {
		printk("RESULT FAIL: model schema %u != supported %d\n",
		       (unsigned)model->version(),
		       TFLITE_SCHEMA_VERSION);
		return 0;
	}

	/*
	 * Op resolver.  AddEthosU() registers the "ethos-u" custom op whose kernel
	 * dispatches onto the NPU; the handful of builtin ops cover anything Vela
	 * left in CPU-land (for this fixture Vela fused everything into one NPU op,
	 * but registering the common builtins keeps the app reusable for a larger
	 * real model without a rebuild of the resolver).  Bound = 8 ops.
	 */
	tflite::MicroMutableOpResolver<8> resolver;
	resolver.AddEthosU();
	resolver.AddReshape();
	resolver.AddConv2D();
	resolver.AddDepthwiseConv2D();
	resolver.AddFullyConnected();
	resolver.AddSoftmax();
	resolver.AddQuantize();
	resolver.AddDequantize();

	tflite::MicroInterpreter interpreter(model, resolver, tensor_arena, TENSOR_ARENA_SIZE);

	/* Allocate tensors out of the SRAM0 arena. */
	TfLiteStatus alloc = interpreter.AllocateTensors();
	g_alloc_status     = (int)alloc;
	if (alloc != kTfLiteOk) {
		printk("RESULT FAIL: AllocateTensors=%d (arena too small / op "
		       "unresolved)\n",
		       (int)alloc);
		return 0;
	}

	/*
	 * Feed a deterministic input: zero-fill the input tensor by its reported
	 * size.  We read the size from the interpreter rather than hard-coding it
	 * so the app works unchanged for a different model.  (int8 zero == the
	 * tensor's encoding of its zero-point-relative origin; a fixed, repeatable
	 * stimulus is all the bench needs to prove the pipeline.)
	 */
	TfLiteTensor *input = interpreter.input(0);
	g_in_bytes          = (uint32_t)input->bytes;
	memset(input->data.raw, 0, input->bytes);
	printk("input      : %u bytes (zero-filled)\n", (unsigned)input->bytes);

	/*
	 * Run inference.  When the interpreter reaches the fused Ethos-U op,
	 * ethosu.cc -> ethosu_invoke_v3() streams the command stream to the NPU and
	 * blocks on the NPU IRQ until completion.  kTfLiteOk == the NPU finished.
	 */
	TfLiteStatus invoke = interpreter.Invoke();
	g_invoke_status     = (int)invoke;
	if (invoke != kTfLiteOk) {
		printk("RESULT FAIL: Invoke=%d (NPU dispatch failed / timed out)\n", (int)invoke);
		return 0;
	}

	/*
	 * Read the output tensor.  Latch the first bytes + the argmax for the
	 * RESULT line and for the SWD symbol read.
	 */
	TfLiteTensor *output = interpreter.output(0);
	g_out_bytes          = (uint32_t)output->bytes;

	uint32_t n           = output->bytes < 16u ? output->bytes : 16u;
	int      best_i      = -1;
	int      best_v      = -128; /* int8 floor */
	bool     any_nonzero = false;
	for (uint32_t i = 0; i < output->bytes; i++) {
		int8_t v = (int8_t)output->data.int8[i];
		if (i < n) {
			g_out_first[i] = (uint8_t)v;
		}
		if (v != 0) {
			any_nonzero = true;
		}
		if (v > best_v) {
			best_v = v;
			best_i = (int)i;
		}
	}
	g_argmax = best_i;

	printk("output     : %u bytes, argmax=%d (val=%d), first[0..%u]=",
	       (unsigned)output->bytes,
	       best_i,
	       best_v,
	       (unsigned)(n ? n - 1 : 0));
	for (uint32_t i = 0; i < n; i++) {
		printk("%02x ", g_out_first[i]);
	}
	printk("\n");

	/*
	 * PASS = inference completed AND the NPU actually produced a result.
	 * any_nonzero guards the silent-failure case (an all-zero output despite a
	 * kTfLiteOk would mean the NPU did not really write the tensor).
	 */
	bool ok = (invoke == kTfLiteOk) && (output->bytes > 0) && any_nonzero;
	if (ok) {
		printk("RESULT PASS: NPU inference complete -- model=%s "
		       "Invoke=OK out_bytes=%u argmax=%d npu_ready=%d\n",
		       NETWORK_MODEL_NAME,
		       (unsigned)output->bytes,
		       best_i,
		       (int)npu_ready);
	} else {
		printk("RESULT FAIL: Invoke=%d out_bytes=%u nonzero=%d "
		       "npu_ready=%d -- output not populated\n",
		       (int)invoke,
		       (unsigned)output->bytes,
		       (int)any_nonzero,
		       (int)npu_ready);
	}

	return 0;
}
```
