## CMakeLists.txt
```
# SPDX-License-Identifier: Apache-2.0
#
# aen-mcuboot-smoke -- minimal slot0 application to bench-validate the
# SES -> MCUboot -> slot0 -> app boot chain on the E1M-AEN801 (Ensemble E8).
# Built with --sysbuild against zephyr/sysbuild/aen/sysbuild.conf so MCUboot
# signs it into slot0; the app only proves it BOOTED (prints to the RAM console
# read over SWD) and reports VTOR to characterise where it runs from.
cmake_minimum_required(VERSION 3.20)

find_package(Zephyr REQUIRED HINTS $ENV{ZEPHYR_BASE})
project(aen_mcuboot_smoke LANGUAGES C)

target_sources(app PRIVATE src/main.c)
```

## sysbuild.conf
```
# SPDX-License-Identifier: Apache-2.0
#
# Sysbuild configuration for E1M-AEN secure-boot images.
#
# Loaded when a Zephyr application is built with sysbuild against
# this directory, e.g.:
#
#   west build -b alp_e1m_aen801_m55_he/ae822fa0e5597ls0/rtss_he path/to/app \
#       --sysbuild -- -DSB_CONF_FILE=<abs>/alp-sdk/zephyr/sysbuild/aen/sysbuild.conf \
#       '-DSB_CONFIG_BOOT_SIGNATURE_KEY_FILE="<abs>/alp-sdk/keys/mcuboot_shared_dev_ecdsa_p256.pem"'
#
# Produces:
#   build/zephyr/zephyr.signed.bin     -- MCUboot-signed application image
#   build/mcuboot/zephyr/zephyr.bin    -- MCUboot bootloader
#
# Boot chain on the Alif Ensemble (E1M-AEN): the Secure Enclave (SES)
# launches an ATOC image; here that image is MCUboot, which then verifies
# and chain-loads the application from MRAM slot0.  The MRAM partition map
# lives in the board DT (mcuboot @ 0x80000000, HE slot0 @ 0x80010000,
# HP slot0 @ 0x802b0000 (was slot1/OTA), reserved (ex-scratch), storage --
# MRAM base 0x80000000).  No slot1/scratch partition exists on this board;
# see zephyr/sysbuild/aen/sysbuild.conf and ADR-0006's AEN amendment.
#
#   SES --ATOC--> MCUboot (this build) --verify slot0--> application
#
# This is also the SoM-maker provisioning model: Alp Lab pre-provisions this
# MCUboot as the factory ATOC over the SE-UART so a shipped module boots
# out-of-box, and the customer then loads apps into slot0 with only a J-Link --
# no SETOOLS, no ATOC, no SE-UART day-1.  BOTH halves are bench-measured.
#
# The customer half, proven on E1M-AEN801: an imgtool-signed image written to
# slot0 by plain `JLinkExe loadbin` is verified by MCUboot and chainloaded, and
# survived three cold power-cycles.  Both refusal shapes leave the debug port
# ALIVE -- a tampered signature gives `E: Unable to find bootable image` with
# VTOR = 0x00000000, a non-MCUboot image gives `E: Bad image magic 0x20004c60`,
# and in both `Secure debug: enabled` with DHCSR (0xE000EDF0) = 00130003.
# A customer cannot brick their debug port with a bad slot0 image.
#
# TWO LIMITS travel with that promise and must not be dropped:
#   * ADDRESS: proven for slot0 writes at 0x80010000 ONLY.  Writing the ATOC
#     region, or erasing MCUboot itself, was NOT tested and is a different risk.
#   * NO A/B YET: both sessions ran CONFIG_SINGLE_APPLICATION_SLOT=y, so the
#     swap/upgrade path is UNTESTED.  Do not promise A/B or OTA on this basis.
# See docs/aen-provisioning.md.
#
# Verification policy -- DEFENCE IN DEPTH (updated 2026-07-31):
#   The Alif Secure Enclave (SES) is the hardware root of trust. It ECDSA-verifies
#   every signed ATOC entry against the device key BEFORE launch -- both this
#   MCUboot AND the signed slot0 application (app-cfg `signed:true`). That has not
#   changed and remains the factory path.
#
#   What HAS changed: MCUboot now ALSO verifies in software (ECDSA-P256 +
#   VALIDATE_SLOT0=y). The previous policy here was SIGNATURE_TYPE_NONE, justified
#   by "on the E8/M55 the software ECDSA-P256 verify (TinyCrypt uECC AND
#   mbedTLS-PSA) does NOT terminate". THAT JUSTIFICATION IS RETRACTED -- it does
#   not reproduce at 0da1f1b4, and the verify was proven live by flipping a
#   signature byte and observing a correct REJECT. See the CORRECTION block in
#   sysbuild/mcuboot.conf for the measurement.
#
#   The SE verify is not redundant with this one: the SE authenticates the ATOC
#   that launches MCUboot, MCUboot authenticates the slot0 image it chainloads.
#   They cover different links in the chain, which is why both are on.
#
# Status: bench-VALIDATED end-to-end on E1M-AEN801 (AE822FA0E5597LS0 Rev A0) at
# alp-sdk 0da1f1b4: SES -> MCUboot (ITCM) -> slot0 app (MRAM XIP) -> app main(),
# with ECDSA-P256 + VALIDATE_SLOT0=y confirmed in the built mcuboot/zephyr/.config
# rather than assumed. PC=80012FBC, VTOR=80010800, CFSR=00000000, IPSR=000.
# Still required: CONFIG_DCACHE=n + board ROM_START_OFFSET=0x800 + the mcuboot
# do_boot flash-base patch (zephyr/patches/mcuboot, carried via west patch -- do_boot
# used CONFIG_FLASH_BASE_ADDRESS=0x0/ITCM for the MRAM slot vector address). That
# patch should be upstreamed rather than carried indefinitely.

# Pull MCUboot into the build graph.
SB_CONFIG_BOOTLOADER_MCUBOOT=y

# Single-application slot: MCUboot reads the slot0 header and boots it; no swap
# machinery. Kept for this smoke test because it is the smallest configuration
# that exercises SES -> MCUboot -> slot0, NOT because swap-scratch fails -- the
# trailing claim here that "swap-scratch + software ECDSA hang" is retracted:
# swap-scratch boots at 0da1f1b4 and logs
#   I: Bootloader chainload address offset: 0x10000
# See the CORRECTION block in sysbuild/mcuboot.conf.
SB_CONFIG_MCUBOOT_MODE_SINGLE_APP=y

# Verify the slot0 signature in the bootloader with ECDSA-P256. Was TYPE_NONE on
# the premise that software ECDSA does not terminate on this part; that premise
# is retracted. Measured on E1M-AEN801 (AE822FA0E5597LS0 Rev A0) at 0da1f1b4:
# the verify completes, and a single flipped byte in the signature TLV is
# correctly REJECTED (`E: Unable to find bootable image`) rather than hanging.
# Trust is no longer delegated to the SES alone -- the SES verifies the ATOC on
# the factory path, and this verifies the image MCUboot is about to chainload.
SB_CONFIG_BOOT_SIGNATURE_TYPE_ECDSA_P256=y

# NO key file is set here, deliberately. Selecting a signature type without a key
# leaves nothing to sign with, so the key is passed as an ABSOLUTE path on the
# command line (see the README build command):
# `-DSB_CONFIG_BOOT_SIGNATURE_KEY_FILE="<abs>/alp-sdk/keys/mcuboot_shared_dev_ecdsa_p256.pem"`.
# The curated zephyr/sysbuild/aen/sysbuild.conf does not carry the key either.
# Built with no key at all, Zephyr's bootloader/Kconfig falls back to MCUboot's
# bundled root-ec-p256.pem -- see testcase.yaml.
#
# A relative key path cannot be fixed here. `SB_CONFIG_BOOT_SIGNATURE_KEY_FILE`
# is passed through verbatim (zephyr/share/sysbuild/images/bootloader/
# CMakeLists.txt:20) and MCUboot resolves a relative value against WEST_TOPDIR,
# not the repo -- while the keys live in <alp-sdk>/keys/.
# With alp-sdk as a west module those are different directories. See the note in
# README.md; pass an absolute path for a key outside the shared profile.
```

## prj.conf
```kconfig
# SPDX-License-Identifier: Apache-2.0
#
# Slot0 app for the MCUboot boot-chain bench test.  NO ITCM RAM-run overlay --
# this app links to the board's default code-partition (slot0 @ MRAM 0x80010000),
# which is the whole point: MCUboot must verify + chain-load it from slot0.
# Unlike the peripheral examples (which now default to the Alp UART console),
# this boot-chain smoke deliberately keeps the RAM console: observability is the
# buffer read over SWD as MCUboot chain-loads slot0 (survives the bootloader
# handoff without depending on UART bring-up order).

CONFIG_RAM_CONSOLE=y
CONFIG_RAM_CONSOLE_BUFFER_SIZE=2048
CONFIG_UART_CONSOLE=n
CONFIG_CONSOLE=y
CONFIG_PRINTK=y
CONFIG_SERIAL=n
CONFIG_LOG=n

# E8 M55-HE: D-cache maintenance (SCB_EnableDCache) hangs; all bench apps use DCACHE=n.
# Without this, the slot0 app faults/hangs in its own cache init when MCUboot jumps to it.
CONFIG_DCACHE=n

# E8 ARMv8-M with ~480 IRQs: the vector table needs 0x800 alignment, which exceeds
# the default 0x200 MCUboot header. Without this, _vector_table lands at slot0+0x800
# but MCUboot jumps to slot0+0x200 (header size) -> garbage SP/PC -> HardFault -> reboot
# loop. Set the header reservation = the vector alignment so the jump target = the vectors.
CONFIG_ROM_START_OFFSET=0x800
```

## src/main.c
```c
/*
 * Copyright (c) 2026 Alp Lab AB
 * SPDX-License-Identifier: Apache-2.0
 *
 * aen-mcuboot-smoke -- bench proof of the SES -> MCUboot -> slot0 -> app boot
 * chain on the E1M-AEN801 (Ensemble E8, M55-HE).  Built with --sysbuild against
 * zephyr/sysbuild/aen/sysbuild.conf; MCUboot signs this image into slot0
 * (MRAM 0x80010000).  Flashed as: MCUboot bootloader -> ATOC (SES launches it),
 * this signed image -> slot0.  If this app's banner appears in the RAM console,
 * MCUboot verified + chain-loaded it from slot0 -- the chain works.
 *
 * VTOR (SCB Vector Table Offset, 0xE000ED08) is reported to characterise WHERE
 * the app runs from after the chain-load (the open bench question vs the proven
 * SES->app-direct/ITCM path): slot0 XIP -> VTOR in [0x80010000, 0x802b0000);
 * copied-to-TCM -> VTOR low (ITCM 0x0 region).  Either way, reaching main()
 * means MCUboot booted slot0.
 *
 * The upper bound (0x802b0000) is HE's own slot0 window top, unchanged by
 * #1069's disjoint-slot0 fix -- it is NOT "slot1"/OTA any more (that concept
 * is gone on this SKU; 0x802b0000 is now where HP's OWN slot0 starts, a
 * separate physical window this HE-only build never touches).  See
 * metadata/e1m_modules/E1M-AEN801.yaml `memory_map:`.
 */

#include <stdint.h>
#include <stdbool.h>

#include <zephyr/kernel.h>
#include <zephyr/sys/printk.h>

#define SCB_VTOR (*(volatile uint32_t *)0xE000ED08U)

#define SLOT0_BASE 0x80010000U
#define HE_SLOT0_TOP 0x802b0000U /* == HP's own slot0 base since #1069, not "slot1" */

/* Latched in a known symbol so the human can also read it over J-Link mem32. */
volatile uint32_t g_vtor = 0xDEADBEEFU;

int main(void)
{
	g_vtor = SCB_VTOR;

	printk("\n=== aen-mcuboot-smoke ===\n");
	printk("VTOR = 0x%08x\n", g_vtor);

	bool slot0_xip = (g_vtor >= SLOT0_BASE) && (g_vtor < HE_SLOT0_TOP);

	printk("exec model: %s\n",
	       slot0_xip ? "XIP from slot0 (MRAM)" : "not slot0 (TCM/SRAM copy or direct)");
	printk("RESULT PASS: app reached main() -> SES->MCUboot->slot0->app chain OK "
	       "(VTOR=0x%08x, %s)\n",
	       g_vtor,
	       slot0_xip ? "slot0-XIP" : "relocated");

	return 0;
}
```
