## CMakeLists.txt
```
# SPDX-License-Identifier: Apache-2.0
#
# On-silicon GPIO validation for the E1M-AEN801 (Alif Ensemble E8), driving a
# safe GPIO pin (P8_0 / gpio8 pin 0) high then low through the upstream
# DesignWare gpio_dw driver (Tier-1).  A RAM console carries the PASS/FAIL line;
# the human ALSO reads the DesignWare DR/DDR registers over J-Link to confirm.
#
# Standalone Zephyr app (no alp_project.py board.yaml flow): build with
#   ZEPHYR_BASE=<zephyr-base> west build \
#     -b alp_e1m_aen801_m55_he/ae822fa0e5597ls0/rtss_he <this-dir> -- \
#     "-DEXTRA_ZEPHYR_MODULES=<alp-sdk>;<hal_alif>"
# Zephyr applies boards/<fully-qualified-board>.overlay by itself.

cmake_minimum_required(VERSION 3.20)

find_package(Zephyr REQUIRED HINTS $ENV{ZEPHYR_BASE})
project(aen_gpio_bench LANGUAGES C)

target_sources(app PRIVATE src/main.c)
```

## prj.conf
```kconfig
# SPDX-License-Identifier: Apache-2.0
#
# Bench config for the GPIO RAM-run on the E1M-AEN801 (Alif Ensemble E8).
#
# Console is the E1M edge UART0.

# --- Console -----------------------------------------------------------------
# Console: Alp UART console -- E1M edge UART0 (Alif UART5, P3_4/P3_5, 115200
# 8N1, NS16550), the E1M-AEN801 carrier console. The board _defconfig already
# selects it; we set it explicitly here so the example is self-describing.
CONFIG_SERIAL=y
CONFIG_CONSOLE=y
CONFIG_UART_CONSOLE=y
CONFIG_UART_INTERRUPT_DRIVEN=y
# Serial-less bench? Comment the four lines above and uncomment these to read
# 'ram_console_buf' over SWD instead:
# CONFIG_RAM_CONSOLE=y
# CONFIG_RAM_CONSOLE_BUFFER_SIZE=2048
# CONFIG_UART_CONSOLE=n
CONFIG_PRINTK=y

# --- GPIO + pinctrl ----------------------------------------------------------
# CONFIG_GPIO_DW is `default y` when DT_HAS_SNPS_DESIGNWARE_GPIO_ENABLED, which
# the okay'd gpio8 node provides; set it explicitly for clarity.  PINCTRL is
# needed to mux P8_0's pad to the GPIO function (gpio_dw does NOT touch the pad
# mux), applied from main() via pinctrl_apply_state().
CONFIG_GPIO=y
CONFIG_GPIO_DW=y
CONFIG_PINCTRL=y

# Keep the image small + deterministic for a RAM-run.
CONFIG_LOG=n
```

## boards/alp_e1m_aen801_m55_he.overlay
```dts
/*
 * Copyright (c) 2026 Alp Lab AB
 * SPDX-License-Identifier: Apache-2.0
 *
 * On-silicon GPIO validation overlay for the E1M-AEN801 (Alif Ensemble E8,
 * M55-HE), bench RAM-run via J-Link.
 *
 * Pin choice -- SAFE GPIO: gpio8 / pin 0 == SoC pad P8_0 (base 0x49008000).
 *   Why safe on THIS bench batch:
 *     - NOT the console (UART5 P3_4/P3_5), NOT a boot/strap, NOT the EEPROM bus
 *       (I2C2 P5_6/P5_7), NOT the BRD_I2C LPI2C0 (P7_4/P7_5).
 *     - P8_0's only non-GPIO alternate functions are OSPI1_SCLKN / AUDIO_CLK /
 *       FAULT0 / LPCAM_D0 / SD_D0 / CDC_D0 / CAM_D0 -- the SoM's OSPI1 HyperRAM
 *       (W958D8NB) is BOM-optional and NOT populated on this batch, and no
 *       camera / SD / display is wired, so the pad is free and uncontended.
 *     - We do NOT touch port 4 (P4_x AF1 = JTAG0 trace) so SWD/JTAG debug is
 *       undisturbed.
 *
 * DesignWare gpio_dw register map for this node (PORT-A, derived because
 * 0x49008000 & 0x3f == 0 -> dw_derive_port_from_base()==0):
 *     DR  (SWPORTA_DR)  = 0x49008000   <- driven output level (bit 0)
 *     DDR (SWPORTA_DDR) = 0x49008004   <- direction, 1=output (bit 0)
 *     EXT_PORTA         = 0x49008050   <- read-back of pad level
 *
 * gpio_dw does NOT apply any pad mux, so we attach a pinctrl state that selects
 * P8_0 -> GPIO (function 0) and main() applies it explicitly via
 * pinctrl_apply_state() before configuring the pin.
 *
 * The P8_0 pad mux is NOT expressed here as a pinctrl-0 on &gpio8: the upstream
 * "snps,designware-gpio" binding does not carry pinctrl (gpio_dw never applies a
 * pad mux), and alp-sdk does not shadow upstream bindings.  main() instead muxes
 * P8_0 -> GPIO directly through the Alif pinctrl driver (pinctrl_configure_pins).
 */

/*
 * MANDATORY bench RAM-run retarget: run from ITCM so J-Link can loadbin+run
 * without programming MRAM, and drop the MCUboot code-partition fixup.
 */
/ {
	chosen {
		/* PATH-REFERENCE form (&itcm), NOT the <&itcm> phandle-array form:
		 * the phandle-array form yields CONFIG_FLASH_SIZE=0 and the image
		 * overflows the (empty) FLASH region at link time. */
		zephyr,flash = &itcm;
		/delete-property/ zephyr,code-partition;
	};

	aliases {
		alp-gpio0 = &gpio8;
	};
};

&gpio8 {
	status = "okay";
};
```

## boards/alp_e1m_aen801_m55_he_ae822fa0e5597ls0_rtss_he.overlay
```dts
/*
 * Copyright (c) 2026 Alp Lab AB
 * SPDX-License-Identifier: Apache-2.0
 *
 * On-silicon GPIO validation overlay for the E1M-AEN801 (Alif Ensemble E8,
 * M55-HE), bench RAM-run via J-Link.
 *
 * Pin choice -- SAFE GPIO: gpio8 / pin 0 == SoC pad P8_0 (base 0x49008000).
 *   Why safe on THIS bench batch:
 *     - NOT the console (UART5 P3_4/P3_5), NOT a boot/strap, NOT the EEPROM bus
 *       (I2C2 P5_6/P5_7), NOT the BRD_I2C LPI2C0 (P7_4/P7_5).
 *     - P8_0's only non-GPIO alternate functions are OSPI1_SCLKN / AUDIO_CLK /
 *       FAULT0 / LPCAM_D0 / SD_D0 / CDC_D0 / CAM_D0 -- there is no OSPI1 bus
 *       device on this SoM (chip: TBD; the NOR + HyperRAM both live on the
 *       separate OSPI0 bus -- though the netlist's OSPI1_RESETn/OSPI1_INTn
 *       net names DO reach U10, the NOR, on other pads), and no camera / SD /
 *       display is wired, so the pad is free and uncontended.
 *     - We do NOT touch port 4 (P4_x AF1 = JTAG0 trace) so SWD/JTAG debug is
 *       undisturbed.
 *
 * DesignWare gpio_dw register map for this node (PORT-A, derived because
 * 0x49008000 & 0x3f == 0 -> dw_derive_port_from_base()==0):
 *     DR  (SWPORTA_DR)  = 0x49008000   <- driven output level (bit 0)
 *     DDR (SWPORTA_DDR) = 0x49008004   <- direction, 1=output (bit 0)
 *     EXT_PORTA         = 0x49008050   <- read-back of pad level
 *
 * gpio_dw does NOT apply any pad mux, so we attach a pinctrl state that selects
 * P8_0 -> GPIO (function 0) and main() applies it explicitly via
 * pinctrl_apply_state() before configuring the pin.
 *
 * The P8_0 pad mux is NOT expressed here as a pinctrl-0 on &gpio8: the upstream
 * "snps,designware-gpio" binding does not carry pinctrl (gpio_dw never applies a
 * pad mux), and alp-sdk does not shadow upstream bindings.  main() instead muxes
 * P8_0 -> GPIO directly through the Alif pinctrl driver (pinctrl_configure_pins).
 */

/*
 * MANDATORY bench RAM-run retarget: run from ITCM so J-Link can loadbin+run
 * without programming MRAM, and drop the MCUboot code-partition fixup.
 */
/ {
	chosen {
		/* PATH-REFERENCE form (&itcm), NOT the <&itcm> phandle-array form:
		 * the phandle-array form yields CONFIG_FLASH_SIZE=0 and the image
		 * overflows the (empty) FLASH region at link time. */
		zephyr,flash = &itcm;
		/delete-property/ zephyr,code-partition;
	};

	aliases {
		alp-gpio0 = &gpio8;
	};
};

&gpio8 {
	status = "okay";
};
```

## boards/alp_e1m_aen803_m55_he_ae822fa0e5597ls0_rtss_he.overlay
```dts
/*
 * Copyright (c) 2026 Alp Lab AB
 * SPDX-License-Identifier: Apache-2.0
 *
 * On-silicon GPIO validation overlay for the E1M-AEN803 (Alif Ensemble E8,
 * M55-HE), bench RAM-run via J-Link.
 *
 * Pin choice -- SAFE GPIO: gpio8 / pin 0 == SoC pad P8_0 (base 0x49008000).
 *   Why safe on THIS bench batch:
 *     - NOT the console (UART5 P3_4/P3_5), NOT a boot/strap, NOT the EEPROM bus
 *       (I2C2 P5_6/P5_7), NOT the BRD_I2C LPI2C0 (P7_4/P7_5).
 *     - P8_0's only non-GPIO alternate functions are OSPI1_SCLKN / AUDIO_CLK /
 *       FAULT0 / LPCAM_D0 / SD_D0 / CDC_D0 / CAM_D0 -- there is no OSPI1 bus
 *       device on this SoM (chip: TBD; the NOR + HyperRAM both live on the
 *       separate OSPI0 bus -- though the netlist's OSPI1_RESETn/OSPI1_INTn
 *       net names DO reach U10, the NOR, on other pads), and no camera / SD /
 *       display is wired, so the pad is free and uncontended.
 *     - We do NOT touch port 4 (P4_x AF1 = JTAG0 trace) so SWD/JTAG debug is
 *       undisturbed.
 *
 * DesignWare gpio_dw register map for this node (PORT-A, derived because
 * 0x49008000 & 0x3f == 0 -> dw_derive_port_from_base()==0):
 *     DR  (SWPORTA_DR)  = 0x49008000   <- driven output level (bit 0)
 *     DDR (SWPORTA_DDR) = 0x49008004   <- direction, 1=output (bit 0)
 *     EXT_PORTA         = 0x49008050   <- read-back of pad level
 *
 * gpio_dw does NOT apply any pad mux, so we attach a pinctrl state that selects
 * P8_0 -> GPIO (function 0) and main() applies it explicitly via
 * pinctrl_apply_state() before configuring the pin.
 *
 * The P8_0 pad mux is NOT expressed here as a pinctrl-0 on &gpio8: the upstream
 * "snps,designware-gpio" binding does not carry pinctrl (gpio_dw never applies a
 * pad mux), and alp-sdk does not shadow upstream bindings.  main() instead muxes
 * P8_0 -> GPIO directly through the Alif pinctrl driver (pinctrl_configure_pins).
 */

/*
 * MANDATORY bench RAM-run retarget: run from ITCM so J-Link can loadbin+run
 * without programming MRAM, and drop the MCUboot code-partition fixup.
 */
/ {
	chosen {
		/* PATH-REFERENCE form (&itcm), NOT the <&itcm> phandle-array form:
		 * the phandle-array form yields CONFIG_FLASH_SIZE=0 and the image
		 * overflows the (empty) FLASH region at link time. */
		zephyr,flash = &itcm;
		/delete-property/ zephyr,code-partition;
	};

	aliases {
		alp-gpio0 = &gpio8;
	};
};

&gpio8 {
	status = "okay";
};
```

## src/main.c
```c
/*
 * Copyright (c) 2026 Alp Lab AB
 * SPDX-License-Identifier: Apache-2.0
 *
 * On-silicon GPIO validation for the E1M-AEN801 (Alif Ensemble E8) over the
 * UPSTREAM DesignWare gpio_dw driver (ADR 0017 Tier-1, "snps,designware-gpio").
 *
 * What it proves -- and what it does NOT
 * ---------------------------------------
 * Drive a SAFE, uncontended pin -- P8_0 (gpio8, pin 0) -- as a push-pull
 * output, set it HIGH then LOW through the portable Zephyr GPIO API, and after
 * each step read back the DesignWare data (DR) + direction (DDR) registers so
 * the result is verifiable two independent ways:
 *
 *   1. in-firmware:  this app reads DR/DDR/EXT_PORTA via sys_read32() and prints
 *      them, plus every gpio_pin_configure/gpio_pin_set return code, and a
 *      single 'RESULT PASS:' / 'RESULT FAIL:' line.
 *   2. over J-Link:  the human reads the same registers with mem32 (addresses
 *      below) -- the ground truth on silicon, independent of any printk.
 *
 * This ONLY proves the gpio_dw controller-register path: pinctrl_configure_pins
 * accepted the mux request, and DDR/DR read back what gpio_pin_configure /
 * gpio_pin_set wrote.  It does NOT prove the pad electrically moved.  Per the
 * Synopsys DW_apb_gpio databook, for a pin whose SWPORTA_DDR direction bit is
 * OUTPUT, reading EXT_PORTA for that bit returns the SWPORTA_DR value, not the
 * external/pad signal -- only an INPUT-direction pin's EXT_PORTA bit reads the
 * real pad level. TEST_PIN is never put into INPUT mode here, so EXT_PORTA is
 * mathematically identical to DR for this whole run and cannot independently
 * confirm anything DR didn't already say. (Bench-confirmed 2026-07-27 on real
 * AE822 silicon: an earlier version of this comment attributed a dark LED
 * seen on a different, similar pad to CLKCTL_PER_SLV->GPIO_CTRL[n] bit 16
 * GPIO_CTRL_CKEN (the per-port GPIO functional-clock enable) being clear.
 * CORRECTION, same bench, later + decisive: that theory is REFUTED -- a
 * follow-up A/B drove SWPORTA_DDR/SWPORTA_DR from the debugger with CKEN
 * still clear after a cold reset and the pad moved (`0x49002050 =
 * 0x00000010` with `0x4902F088 = 0x00000100`, bit 16 unset). CKEN is
 * measured NOT required for pad drive on AE822. The actual explanation for
 * "the LED was dark": the old bench app toggled a handful of times over a
 * couple of seconds and returned with the pad left LOW -- a window nobody
 * was watching, not a pad that couldn't move. Once changed to loop forever,
 * the maintainer confirmed by eye that the LED blinks. GPIO output on E8 is
 * proven on silicon this way; this app's own criterion is still only the
 * gpio_dw controller-register path described above, unrelated to CKEN
 * either way.)
 * To prove the pad actually moved, probe P8_0 with a multimeter/scope, or
 * route it to a visible LED load and confirm illumination -- this app alone
 * cannot make that claim.
 *
 * DesignWare gpio register map for gpio8 @ 0x49008000 (PORT-A; gpio_dw derives
 * port 0 because 0x49008000 & 0x3f == 0):
 *     DR  (SWPORTA_DR)  = 0x49008000    bit0 = driven output level
 *     DDR (SWPORTA_DDR) = 0x49008004    bit0 = 1 -> output
 *     EXT_PORTA         = 0x49008050    bit0 = mirrors DR for an OUTPUT pin
 *                                              (see above) -- printed for
 *                                              J-Link cross-check only, not
 *                                              part of the pass criterion
 *
 * Expected (pin = bit 0):
 *     after configure OUTPUT_HIGH / set 1:  DDR bit0 = 1, DR bit0 = 1
 *     after set 0:                          DDR bit0 = 1, DR bit0 = 0
 *
 * Console is the RAM buffer 'ram_console_buf' (see prj.conf); the bench UART is
 * not wired to USB.  BENCH-VALIDATION app -- not a customer teaching example.
 */

#include <zephyr/kernel.h>
#include <zephyr/device.h>
#include <zephyr/drivers/gpio.h>
#include <zephyr/drivers/pinctrl.h>
#include <zephyr/dt-bindings/pinctrl/alif-ensemble-pinctrl.h>
#include <zephyr/sys/sys_io.h>
#include <zephyr/sys/util.h>

/* gpio8 node + the pad-mux state attached in the overlay. */
#define GPIO8_NODE DT_NODELABEL(gpio8)
#define TEST_PIN   0U /* P8_0 -> DR/DDR bit 0 */
#define TEST_BIT   BIT(TEST_PIN)

/* DesignWare PORT-A register absolute addresses for this node. These match
 * what gpio_dw writes; we read them directly purely to self-verify. */
#define GPIO8_BASE     DT_REG_ADDR(GPIO8_NODE) /* 0x49008000 */
#define DW_SWPORTA_DR  (GPIO8_BASE + 0x00U)    /* 0x49008000 */
#define DW_SWPORTA_DDR (GPIO8_BASE + 0x04U)    /* 0x49008004 */
#define DW_EXT_PORTA   (GPIO8_BASE + 0x50U)    /* 0x49008050 */

/* P8_0 -> GPIO (AF0).  gpio_dw does not touch the pad mux, and the upstream
 * "snps,designware-gpio" binding carries no pinctrl-0, so apply the mux straight
 * through the Alif pinctrl SoC driver (pinctrl_soc_pin_t is the uint32_t PINMUX
 * word; the Alif impl ignores the reg argument).
 *
 * ALIF_PAD_REN = the pad RECEIVER-ENABLE bit (pinctrl_soc.h REN_BIT_POS=16, the
 * low bit of the pad-config byte [23:16] of the pinmux word) -- same REN the
 * I2C2 path needs to sense SDA.  Set here so EXT_PORTA is at least well-defined,
 * but for an OUTPUT-direction pin on this controller EXT_PORTA mirrors DR
 * regardless of REN (see the file header) -- REN does NOT make this test
 * independently prove the pad moved. */
#define ALIF_PAD_REN (1U << 16)
static const pinctrl_soc_pin_t p8_0_gpio[] = { PIN_P8_0__GPIO | ALIF_PAD_REN };

static const struct device *const gpio8 = DEVICE_DT_GET(GPIO8_NODE);

static void dump_regs(const char *tag)
{
	uint32_t dr  = sys_read32(DW_SWPORTA_DR);
	uint32_t ddr = sys_read32(DW_SWPORTA_DDR);
	uint32_t ext = sys_read32(DW_EXT_PORTA);

	printk("  [%s] DR=0x%08x (bit0=%u) DDR=0x%08x (bit0=%u) EXT=0x%08x (bit0=%u)\n",
	       tag,
	       dr,
	       (unsigned int)((dr >> TEST_PIN) & 1U),
	       ddr,
	       (unsigned int)((ddr >> TEST_PIN) & 1U),
	       ext,
	       (unsigned int)((ext >> TEST_PIN) & 1U));
}

int main(void)
{
	int      rc;
	uint32_t dr_hi, ddr_hi, dr_lo, ddr_lo, ext_hi, ext_lo;

	printk("\n=== AEN801 GPIO bench (gpio_dw / P8_0 / gpio8 pin %u) ===\n", TEST_PIN);
	printk("base=0x%08x  DR=0x%08x  DDR=0x%08x  EXT=0x%08x\n",
	       (unsigned int)GPIO8_BASE,
	       (unsigned int)DW_SWPORTA_DR,
	       (unsigned int)DW_SWPORTA_DDR,
	       (unsigned int)DW_EXT_PORTA);

	/* 1. mux P8_0 -> GPIO (gpio_dw never touches the pad mux). */
	rc = pinctrl_configure_pins(p8_0_gpio, ARRAY_SIZE(p8_0_gpio), 0U);
	printk("pinctrl_configure_pins(P8_0->GPIO) rc=%d\n", rc);
	if (rc != 0) {
		printk("RESULT FAIL: pinctrl_configure_pins rc=%d\n", rc);
		return 0;
	}

	/* 2. device readiness. */
	if (!device_is_ready(gpio8)) {
		printk("RESULT FAIL: gpio8 device not ready\n");
		return 0;
	}
	printk("gpio8 device ready\n");
	dump_regs("pre-config");

	/* 3. configure as output, init HIGH. */
	rc = gpio_pin_configure(gpio8, TEST_PIN, GPIO_OUTPUT_HIGH);
	printk("gpio_pin_configure(OUTPUT_HIGH) rc=%d\n", rc);
	if (rc != 0) {
		printk("RESULT FAIL: gpio_pin_configure rc=%d\n", rc);
		return 0;
	}
	dump_regs("after-config-high");

	/* 4. explicit drive HIGH. */
	rc = gpio_pin_set(gpio8, TEST_PIN, 1);
	printk("gpio_pin_set(1) rc=%d\n", rc);
	if (rc != 0) {
		printk("RESULT FAIL: gpio_pin_set(1) rc=%d\n", rc);
		return 0;
	}
	k_busy_wait(1000); /* let the level settle for the J-Link mem32 read */
	dump_regs("driven-high");
	dr_hi  = sys_read32(DW_SWPORTA_DR);
	ddr_hi = sys_read32(DW_SWPORTA_DDR);
	ext_hi = sys_read32(DW_EXT_PORTA); /* mirrors DR for this OUTPUT pin -- see header */

	/* --- J-Link readback window #1 (HIGH): mem32 0x49008000 / 0x49008004 --- */

	/* 5. drive LOW. */
	rc = gpio_pin_set(gpio8, TEST_PIN, 0);
	printk("gpio_pin_set(0) rc=%d\n", rc);
	if (rc != 0) {
		printk("RESULT FAIL: gpio_pin_set(0) rc=%d\n", rc);
		return 0;
	}
	k_busy_wait(1000);
	dump_regs("driven-low");
	dr_lo  = sys_read32(DW_SWPORTA_DR);
	ddr_lo = sys_read32(DW_SWPORTA_DDR);
	ext_lo = sys_read32(DW_EXT_PORTA); /* mirrors DR for this OUTPUT pin -- see header */

	/* --- J-Link readback window #2 (LOW): mem32 0x49008000 / 0x49008004 --- */

	/* 6. verdict: DDR shows the pin as output in BOTH states, and DR tracks
	 *    the requested level (controller-register path only -- see the file
	 *    header for why EXT_PORTA cannot add independent proof here: for an
	 *    OUTPUT pin it mirrors DR by construction, so folding it into this
	 *    verdict would let the app PASS on register plumbing alone while
	 *    implying pad/electrical proof it does not have. ext_hi/ext_lo are
	 *    still read + printed above for the J-Link cross-check, deliberately
	 *    excluded from the pass/fail gate below. */
	bool ddr_ok = ((ddr_hi & TEST_BIT) != 0U) && ((ddr_lo & TEST_BIT) != 0U);
	bool dr_ok  = ((dr_hi & TEST_BIT) != 0U) && ((dr_lo & TEST_BIT) == 0U);

	if (ddr_ok && dr_ok) {
		printk("RESULT PASS: gpio_dw P8_0 controller-register path -- DDR "
		       "bit0=1, DR high=1 low=0 (mux accepted + DDR/DR correct). "
		       "NOT pad/electrical proof -- probe P8_0 or wire a load to "
		       "confirm it actually moved.\n");
	} else {
		printk("RESULT FAIL: ddr_ok=%d dr_ok=%d "
		       "DR_hi=0x%08x DR_lo=0x%08x EXT_hi=0x%08x EXT_lo=0x%08x\n",
		       (int)ddr_ok,
		       (int)dr_ok,
		       dr_hi,
		       dr_lo,
		       ext_hi,
		       ext_lo);
	}

	/* Leave the pin LOW + park; the registers stay readable over J-Link. */
	return 0;
}
```
