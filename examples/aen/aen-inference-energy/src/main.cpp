/*
 * Copyright (c) 2026 Alp Lab AB
 * SPDX-License-Identifier: Apache-2.0
 *
 * aen-inference-energy -- how many millijoules does ONE Ethos-U inference cost?
 *
 * The honest answer this app measures, and the one it does NOT.  It measures
 * the INCREMENTAL energy drawn from ONE named carrier rail while the model
 * runs, minus the energy that same rail draws over an identical window with no
 * inference running, divided by how many inferences fitted in the window.
 * That is a *carrier-rail delta*.  It is NOT the NPU's energy, NOT the
 * silicon's energy, and NOT comparable to a vendor datasheet figure: the rail
 * is upstream of the module regulators, so it overstates the die by 1/efficiency
 * (roughly 10-20 %), and the idle subtraction removes the static draw of
 * everything else on the board.  The host-side contract
 * (scripts/alp_model/measure.py) encodes exactly that scope and validates the
 * labels, which is why they must never be relabelled downstream.
 *
 * HOW IT MEASURES
 *   1. Rail scan.  All six EVK INA236 monitors are probed, and each is watched
 *      through a short inferring window and a short quiet one -- the board is
 *      the authority on which rail feeds the compute, not a guess baked into
 *      this file.  A rail only qualifies if its step clears three standard
 *      errors, and rails are ranked in MILLIAMPS, never in shunt microvolts --
 *      this board mixes 20 mOhm and 50 mOhm shunts, so microvolts are not
 *      comparable between rails.  If NOTHING qualifies, the app falls back to
 *      the rail carrying the most POWER and reports which rule it used, because
 *      ranking by a difference that is entirely noise picks whichever rail's
 *      dither happened to be largest.  Bench-observed: with a trivial model
 *      that chose a 0.6 mA housekeeping rail over the 93 mA compute rail.
 *   2. Range pick.  Given the shunt swing just observed, the app picks the
 *      finer +/-20.48 mV ADC range when the rail fits inside it with headroom,
 *      and stays on +/-81.92 mV when it does not.  Saturating the range would
 *      silently clip the very peaks the measurement is about.
 *   3. Windows.  M pairs of (active, idle) windows of equal length, each
 *      sampled on the INA236's conversion-ready flag so every conversion is
 *      consumed exactly once -- blind-rate polling would double-count a slow
 *      conversion and miss a fast one.
 *   4. Emission.  Every sample is printed as a raw (cycle-count, POWER-count)
 *      pair.  The app also integrates on-target and prints its own answer, but
 *      the host's unit-tested trapezoidal integrator is the authority; the
 *      on-target number exists to be cross-checked against it.  Two independent
 *      implementations agreeing is evidence; one number is a claim.
 *
 * WHAT THE BASELINE ACTUALLY IS (read this before quoting the number).  The
 * idle window keeps the CPU spinning on the cycle counter with the NPU quiet --
 * it is not a WFI/low-power baseline.  That is deliberate: subtracting a
 * spin-idle baseline removes the CPU's own always-on draw and leaves the
 * inference work itself, whereas subtracting a WFI baseline would fold "CPU
 * awake at all" into the per-inference figure.  It is reported as
 * `baseline: "cpu-spin-npu-idle"` in the ENERGY-CFG line so the number is never
 * read as something it is not.
 *
 * Register-level facts about the INA236 (fields, LSBs, the calibration and
 * power equations) are NOT restated here -- they live in chips/ina236 with
 * their SBOSA81D citations, and this app only chooses among them.
 */

#include <cmath>
#include <cstdint>
#include <cstring>

#include <zephyr/kernel.h>
#include <zephyr/device.h>
#include <zephyr/devicetree.h>
#include <zephyr/sys/printk.h>

#include <cmsis_core.h>

/* hal_alif local_to_global() -- ITCM/DTCM CPU-local -> NPU global view. */
#include <soc_memory_map.h>

#include <tensorflow/lite/micro/micro_interpreter.h>
#include <tensorflow/lite/micro/micro_mutable_op_resolver.h>
#include <tensorflow/lite/schema/schema_generated.h>

#include "alp/peripheral.h"
#include "alp/boards/alp_e1m_evk.h" /* EVK_I2C_* + EVK_INA236_* board facts */
#include "alp/chips/ina236.h"

/* Generated by ../aen-npu-inference-alif/gen_model.py: networkModelData[],
 * NETWORK_MODEL_LEN, NETWORK_MODEL_NAME, TENSOR_ARENA_SIZE, and the SRAM0
 * placement macros (MODEL_ATTR / TENSOR_ARENA_ATTR / NPU_ALIGN). */
#include "model.h"

#define NPU_NODE DT_NODELABEL(ethosu_npu)

/* ------------------------------------------------------------------------- *
 * Ethos-U strong overrides.
 *
 * Both of these are transcribed from examples/aen/aen-npu-inference-alif,
 * where each was isolated on this exact silicon.  They are repeated (not
 * shared) because they must be STRONG definitions in the application image --
 * that is the only place that can override the core driver's weak defaults.
 * See that app's src/main.cpp for the full derivation.
 * ------------------------------------------------------------------------- */

/* The Arm core driver programs QBASE + every BASEP through this hook.  Its weak
 * default returns the address unchanged -- the CPU-local M55 view -- which for
 * an ITCM/DTCM-resident buffer is not what the NPU's AXI master must use.
 * local_to_global() is hal_alif's own; nothing is re-authored here. */
extern "C" uint64_t ethosu_address_remap(uint64_t address, int index)
{
	(void)index;
	/* Double cast: silence the pointer/integer width warning on 32-bit. */
	return local_to_global((void *)(uint32_t)address);
}

/* MEM_ATTR index 0 = the NPU's SRAM AXI port.  The Arm defaults route the
 * command stream and region 0 to the EXT port, which bus-aborts here because
 * the model, command stream and arena all live in SRAM0 -- reachable only over
 * the SRAM port.  Bench-confirmed on E8: the Arm default gives invoke=1 with
 * NPU STATUS=0x00000804 (bus_status=1, faulting_interface=1). */
extern "C" unsigned int ethosu_config_select(uint64_t address, int index)
{
	(void)address;
	(void)index;
	return 0U;
}

/* ------------------------------------------------------------------------- *
 * Measurement parameters.
 * ------------------------------------------------------------------------- */

/* INA236 conversion timing.  16 averaged conversions of 140 us shunt + 140 us
 * bus = 4.48 ms per reported sample (the driver computes this from the
 * datasheet tables; we only pick the codes).  Two reasons for this pick:
 *   - Rate: 4.48 ms per conversion sits an order of magnitude above the ~0.5 ms
 *     an I2C register read costs at 100 kHz, so the sampler is never the
 *     bottleneck and never aliases.
 *   - Window: 250 samples then spans ~1.12 s, comfortably long enough that the
 *     ~4.5 ms of averaging that straddles each window boundary is a ~0.4 %
 *     edge effect rather than a real error.
 * Averaging is free accuracy here: energy is the integral of power, and the
 * hardware average preserves the mean it integrates. */
static constexpr ina236_avg_t  SAMPLE_AVG    = INA236_AVG_16;
static constexpr ina236_ct_t   SAMPLE_VBUSCT = INA236_CT_140US;
static constexpr ina236_ct_t   SAMPLE_VSHCT  = INA236_CT_140US;
static constexpr ina236_mode_t SAMPLE_MODE   = INA236_MODE_SHUNT_BUS_CONT;

/* Samples per window.  The default is sized against
 * CONFIG_RAM_CONSOLE_BUFFER_SIZE: this many samples x 2 phases x WINDOW_PAIRS
 * lines must fit, or the capture truncates mid-window -- which would look like
 * a shorter (but valid) window and yield a quietly wrong energy figure instead
 * of an obvious failure.
 *
 * Override for the WHOLE-BOARD CROSS-CHECK build.  Validating this measurement
 * against the bench PSU's input power needs windows long enough for a slow
 * external instrument to resolve each phase (tens of seconds, not one), which
 * is far more samples than the console can carry.  So pair a long window with
 * -DAEN_ENERGY_EMIT_SAMPLES=0: the energy is integrated incrementally as
 * samples arrive, so window length is bounded by the measurement, not by the
 * buffer.  That build reports only the summary lines and is NOT parseable by
 * the host re-integrator -- which is the honest outcome, since there is no
 * sample stream for it to re-integrate.
 *
 *   -DAEN_ENERGY_SAMPLES_PER_WINDOW=4000 -DAEN_ENERGY_WINDOW_PAIRS=1 \
 *   -DAEN_ENERGY_EMIT_SAMPLES=0            (~17.9 s per phase)
 *
 * KEEP A LONG WINDOW UNDER THE CYCLE-COUNTER WRAP.  The 32-bit counter wraps
 * every 2^32/160e6 = 26.8 s at this clock, and `span_cycles` is a single
 * unsigned difference across the whole window -- so a window longer than that
 * silently reports a wrapped, meaningless span, and the host's
 * cycles-per-second reconciliation would compare two equally-wrapped spans and
 * prefer them over the devicetree value. 4000 samples x 4.48 ms = 17.9 s
 * leaves ~33 % margin. The per-sample timestamps are unaffected either way
 * (consecutive deltas are far below the wrap); only the whole-window span is.
 * A build that needs longer must integrate across several sub-windows. */
#ifndef AEN_ENERGY_SAMPLES_PER_WINDOW
#define AEN_ENERGY_SAMPLES_PER_WINDOW 250
#endif
#ifndef AEN_ENERGY_WINDOW_PAIRS
#define AEN_ENERGY_WINDOW_PAIRS 3
#endif
#ifndef AEN_ENERGY_EMIT_SAMPLES
#define AEN_ENERGY_EMIT_SAMPLES 1
#endif

static constexpr size_t SAMPLES_PER_WINDOW = AEN_ENERGY_SAMPLES_PER_WINDOW;

/* Repeated (active, idle) pairs.  Three is the minimum that yields a spread
 * (a sample standard deviation) rather than a bare single number. */
static constexpr size_t WINDOW_PAIRS = AEN_ENERGY_WINDOW_PAIRS;

/* Per-sample buffering exists ONLY to replay the stream on the console after a
 * window closes; the energy itself is accumulated as samples arrive.  With
 * emission off the buffer collapses to nothing. */
static constexpr bool   EMIT_SAMPLES = (AEN_ENERGY_EMIT_SAMPLES != 0);
static constexpr size_t SAMPLE_BUF   = EMIT_SAMPLES ? SAMPLES_PER_WINDOW : 1;

/* Samples per rail during the scan -- just enough to rank six rails by how much
 * their shunt voltage moves, not to measure any of them accurately. */
static constexpr size_t SCAN_SAMPLES = 16;

/* Switch to the finer +/-20.48 mV ADC range only if the largest shunt magnitude
 * seen during the scan stays below this, leaving ~25 % headroom for peaks the
 * short scan did not catch.  Above it, clipping is the worse error. */
static constexpr int32_t ADCRANGE_20MV_MAX_UV = 15000;

/* One shunt-ADC count during the SCAN, which always runs on the coarse
 * +/-81.92 mV range (2.5 uV per count, SBOSA81D section 6.5).  Used as the
 * floor on the significance test's standard error: a rail whose scan samples
 * are bit-identical has a computed spread of exactly zero, and a zero-spread
 * gate accepts a one-count difference as significant. */
static constexpr float SCAN_SHUNT_LSB_UV = 2.5f;

/* ------------------------------------------------------------------------- *
 * Cycle counter.
 *
 * The DWT cycle counter is the finest clock on this core: it ticks once per CPU
 * cycle (160 MHz here => 6.25 ns).  It is optional in the architecture, so
 * DWT_CTRL.NOCYCCNT is checked and Zephyr's k_cycle_get_32() is used instead
 * when the hardware does not implement it -- silently timestamping every sample
 * with a frozen zero would turn every duration into nonsense.
 *
 * Both sources are read as a raw uint32 that WRAPS (every ~26.8 s at 160 MHz).
 * Every consumer takes unsigned differences, which stay correct across a single
 * wrap, and the host is handed the raw counts plus a millisecond cross-check per
 * window so it can verify the cycles-per-second figure rather than trust it.
 * ------------------------------------------------------------------------- */

static bool g_dwt_in_use;

static void cycles_init(void)
{
	/* TRCENA gates the whole trace/debug block, DWT included. */
	DCB->DEMCR |= DCB_DEMCR_TRCENA_Msk;
	__DSB();
	if (DWT->CTRL & DWT_CTRL_NOCYCCNT_Msk) {
		g_dwt_in_use = false; /* not implemented -- fall back */
		return;
	}
	DWT->CYCCNT = 0U;
	DWT->CTRL |= DWT_CTRL_CYCCNTENA_Msk;
	__DSB();
	/* Prove it actually advances before trusting it: a counter that reads
	 * back frozen despite CYCCNTENA (a locked or gated debug block) must fall
	 * back too, not be believed. */
	uint32_t a = DWT->CYCCNT;
	__NOP();
	__NOP();
	__NOP();
	g_dwt_in_use = (DWT->CYCCNT != a);
}

static inline uint32_t cycles_now(void)
{
	return g_dwt_in_use ? DWT->CYCCNT : k_cycle_get_32();
}

/* Cycles per second for whichever source is live.  Both count CPU cycles on
 * this core, so both scale by the kernel's configured cycle rate. */
static inline uint32_t cycles_per_s(void)
{
	return sys_clock_hw_cycles_per_sec();
}

/* ------------------------------------------------------------------------- *
 * The six EVK rail monitors.
 *
 * Address AND per-rail shunt / full-scale current come from
 * <alp/boards/alp_e1m_evk.h>, which is generated from the board YAML -- so a
 * respin that changes a shunt reaches this app without an edit here.  A
 * hardcoded copy would silently drift, and a wrong shunt is a wrong energy.
 * ------------------------------------------------------------------------- */
static const struct {
	const char *name;
	uint8_t     addr;
	float       shunt_ohms;
	float       max_a;
} RAILS[] = {
	{ "+3V3", EVK_I2C_ADDR_INA236_3V3, EVK_INA236_SHUNT_3V3_OHMS, EVK_INA236_MAX_3V3_A },
	{ "+1V8", EVK_I2C_ADDR_INA236_1V8, EVK_INA236_SHUNT_1V8_OHMS, EVK_INA236_MAX_1V8_A },
	{ "+VIO", EVK_I2C_ADDR_INA236_VIO, EVK_INA236_SHUNT_VIO_OHMS, EVK_INA236_MAX_VIO_A },
	{ "+VCAM0", EVK_I2C_ADDR_INA236_VCAM0, EVK_INA236_SHUNT_VCAM0_OHMS, EVK_INA236_MAX_VCAM0_A },
	{ "+VCAM1", EVK_I2C_ADDR_INA236_VCAM1, EVK_INA236_SHUNT_VCAM1_OHMS, EVK_INA236_MAX_VCAM1_A },
	{ "+5V", EVK_I2C_ADDR_INA236_5V, EVK_INA236_SHUNT_5V_OHMS, EVK_INA236_MAX_5V_A },
};

/* ------------------------------------------------------------------------- *
 * NPU-reachable buffers (SRAM0).  The NPU reads the command stream, weights and
 * arena over its own AXI master and cannot reach DTCM, so all three live in the
 * global on-chip SRAM the generated placement macros target.
 * ------------------------------------------------------------------------- */
TENSOR_ARENA_ATTR static uint8_t tensor_arena[TENSOR_ARENA_SIZE];

/* networkModelData[] is initialised rodata; Zephyr does NOT init-copy the SRAM0
 * custom section, so an initialised array placed directly there would be
 * garbage the NPU then executes.  Keep the model in rodata and stage a copy. */
static uint8_t model_sram[NETWORK_MODEL_LEN] __aligned(NPU_ALIGN) __attribute__((section("SRAM0")));

/* ------------------------------------------------------------------------- *
 * Sample buffer -- one window at a time, emitted after the window closes.
 *
 * Printing during a window would corrupt the very thing being measured: the
 * console write costs time and energy inside the integration interval.  So
 * samples are buffered in DTCM and flushed between windows.
 * ------------------------------------------------------------------------- */
struct sample_t {
	uint32_t cycles;
	uint16_t power_raw;
};
static sample_t g_window[SAMPLE_BUF];

enum phase_t { PHASE_IDLE = 0, PHASE_ACTIVE = 1 };

static const char *phase_name(phase_t p)
{
	return (p == PHASE_ACTIVE) ? "active" : "idle";
}

/* Latched evidence, readable by symbol over SWD even with no console. */
volatile int      g_rail_index    = -1;
volatile int      g_alloc_status  = -1;
volatile int      g_invoke_status = -1;
volatile uint32_t g_total_inferences;
volatile float    g_mj_per_inference;

/* ------------------------------------------------------------------------- *
 * One window.
 *
 * Both phases run the SAME loop with the SAME polling cadence, and differ only
 * in what they do between polls: run an inference, or spin.  That symmetry is
 * what makes the sampler's own cost cancel in the active-minus-idle
 * subtraction -- if the idle window polled at a different rate, its I2C traffic
 * would not cancel and the difference would carry the sampler's energy too.
 *
 * Returns the number of inferences completed (0 for an idle window).
 * ------------------------------------------------------------------------- */
struct window_result {
	uint32_t inferences;  /* completed inferences (0 for an idle window)   */
	size_t   samples;     /* conversions actually captured                */
	size_t   buffered;    /* of those, how many were kept for emission    */
	float    energy_mj;   /* trapezoidal integral, accumulated in-flight  */
	uint32_t i2c_errors;  /* failed conversion-ready / power reads         */
	uint32_t span_cycles; /* window duration, cycle counter               */
	uint32_t span_ms;     /* same window, kernel millisecond clock        */
	bool     timed_out;   /* deadline hit before `cap` samples arrived     */
	int      last_rc;     /* last non-OK driver status, ALP_OK if none     */
};

/* How long a window may overrun its predicted duration before it is abandoned.
 * A sampling loop gated on a hardware flag must never be able to spin forever:
 * if the monitor stops producing conversions -- a wedged bus, a device knocked
 * out of continuous mode -- an unbounded loop turns into a silent hang, and the
 * only evidence left is a truncated console that looks like a crash.  With a
 * deadline the same failure becomes a reported short window, which the operator
 * can act on and the host can reject. */
static constexpr uint32_t WINDOW_DEADLINE_MULT = 4U;

static void run_window(ina236_t                 *mon,
                       tflite::MicroInterpreter *interp,
                       phase_t                   phase,
                       uint32_t                  poll_cycles,
                       size_t                    cap,
                       uint32_t                  deadline_ms,
                       float                     power_lsb_w,
                       float                     cyc_per_s,
                       window_result            *out)
{
	uint32_t inferences = 0;
	size_t   got        = 0;
	uint32_t errs       = 0;
	int      last_rc    = ALP_OK;
	bool     timed_out  = false;
	float    energy_j   = 0.0f;
	uint32_t prev_c     = 0;
	uint16_t prev_raw   = 0;

	uint32_t t_start_c  = cycles_now();
	int64_t  t_start_ms = k_uptime_get();
	uint32_t next_poll  = t_start_c + poll_cycles;

	while (got < cap) {
		/* The deadline uses the kernel's 64-bit millisecond clock, NOT the
		 * cycle counter, for two reasons: a long-window build's allowance
		 * exceeds what a 32-bit cycle count can express at 160 MHz (it wraps
		 * every ~26.8 s), and the millisecond clock keeps running when a
		 * debugger owns the trace block. */
		if ((uint32_t)(k_uptime_get() - t_start_ms) > deadline_ms) {
			timed_out = true;
			break;
		}
		/* Signed comparison of the unsigned difference: correct across a
		 * counter wrap, unlike a plain `now >= next_poll`. */
		if ((int32_t)(cycles_now() - next_poll) >= 0) {
			next_poll += poll_cycles;
			/* An inference can overrun a poll slot; resynchronise rather
			 * than burning through a backlog of missed deadlines. */
			if ((int32_t)(cycles_now() - next_poll) >= 0) {
				next_poll = cycles_now() + poll_cycles;
			}
			bool         ready = false;
			alp_status_t rc    = ina236_conversion_ready(mon, &ready);
			if (rc != ALP_OK) {
				errs++;
				last_rc = (int)rc;
			} else if (ready) {
				uint16_t raw = 0;
				rc           = ina236_read_power_raw(mon, &raw);
				if (rc != ALP_OK) {
					errs++;
					last_rc = (int)rc;
				} else {
					/* Timestamp the read, not the loop top: the
					 * trapezoid integrates against real intervals,
					 * so honest timestamps absorb poll jitter. */
					uint32_t c = cycles_now();
					/* Accumulate the trapezoid as samples arrive, so
					 * window length is set by the measurement rather
					 * than by how many samples fit in RAM. */
					if (got > 0 && cyc_per_s > 0.0f) {
						float dt = (float)(c - prev_c) / cyc_per_s;
						float p0 = (float)prev_raw * power_lsb_w;
						float p1 = (float)raw * power_lsb_w;
						energy_j += 0.5f * (p0 + p1) * dt;
					}
					prev_c   = c;
					prev_raw = raw;
					if (EMIT_SAMPLES && got < SAMPLE_BUF) {
						g_window[got].cycles    = c;
						g_window[got].power_raw = raw;
					}
					got++;
				}
			}
		} else if (phase == PHASE_ACTIVE) {
			TfLiteStatus st = interp->Invoke();
			g_invoke_status = (int)st;
			if (st != kTfLiteOk) {
				break; /* a failing invoke must not be averaged in */
			}
			inferences++;
		}
		/* PHASE_IDLE between polls: spin.  See the baseline note in the file
		 * header -- this is a CPU-spin/NPU-quiet baseline, not WFI. */
	}

	out->inferences  = inferences;
	out->samples     = got;
	out->buffered    = (EMIT_SAMPLES && got < SAMPLE_BUF) ? got : (EMIT_SAMPLES ? SAMPLE_BUF : 0);
	out->energy_mj   = energy_j * 1000.0f;
	out->i2c_errors  = errs;
	out->span_cycles = cycles_now() - t_start_c;
	out->span_ms     = (uint32_t)(k_uptime_get() - t_start_ms);
	out->timed_out   = timed_out;
	out->last_rc     = last_rc;

	/* A window longer than the cycle counter's wrap (2^32 cycles = 26.8 s at
	 * 160 MHz) cannot report a meaningful whole-window span, and a wrapped
	 * span is indistinguishable from a real one -- so say so instead of
	 * emitting it silently.  The per-sample deltas the energy integral uses
	 * are unaffected; only this summary span is. */
	if (out->span_ms >
	    (uint32_t)(4294967295U / (cyc_per_s > 0.0f ? (uint32_t)(cyc_per_s / 1000.0f) : 1U))) {
		printk("ENERGY-WARN %s window %u ms exceeds the cycle-counter wrap -- span_cycles "
		       "is not meaningful; lower AEN_ENERGY_SAMPLES_PER_WINDOW\n",
		       phase_name(phase),
		       (unsigned)out->span_ms);
	}
}

/* Emit one window's samples plus its span.  The host re-integrates from these
 * raw counts; the ENERGY-W line's millisecond span is an independent clock so
 * the host can confirm the cycles-per-second figure instead of trusting it. */
static void emit_window(size_t idx, phase_t phase, const window_result &w)
{
	uint32_t base = (w.buffered > 0) ? g_window[0].cycles : 0U;
	for (size_t i = 0; i < w.buffered; i++) {
		printk("ENERGY-S %u %s %u %u\n",
		       (unsigned)idx,
		       phase_name(phase),
		       (unsigned)(g_window[i].cycles - base),
		       (unsigned)g_window[i].power_raw);
	}
	/* The inference count belongs HERE, per window, not in the one-shot
	 * ENERGY-CFG header: it is measured, not configured, and it differs per
	 * window.  The host divides each window pair's energy delta by it, so a
	 * single header value could not express it -- and reading it from a field
	 * the firmware never emitted is exactly how the host parser came to
	 * raise KeyError on a real capture. */
	printk("ENERGY-W %u %s %u %u %u %u\n",
	       (unsigned)idx,
	       phase_name(phase),
	       (unsigned)w.samples,
	       (unsigned)w.span_cycles,
	       (unsigned)w.span_ms,
	       (unsigned)w.inferences);
	/* Say so when the printed stream is shorter than what was integrated, so a
	 * host re-integrating the stream cannot mistake a partial replay for the
	 * whole window and silently report a fraction of the real energy. */
	if (w.buffered != w.samples) {
		printk("ENERGY-WPART %u %s emitted=%u of %u samples (device integral is "
		       "authoritative for this build)\n",
		       (unsigned)idx,
		       phase_name(phase),
		       (unsigned)w.buffered,
		       (unsigned)w.samples);
	}
	/* Only when something went wrong -- a clean run stays quiet so the
	 * diagnostic line means what it says. */
	if (w.timed_out || w.i2c_errors > 0) {
		printk("ENERGY-WERR %u %s timed_out=%d i2c_errors=%u last_rc=%d got=%u/%u\n",
		       (unsigned)idx,
		       phase_name(phase),
		       (int)w.timed_out,
		       (unsigned)w.i2c_errors,
		       w.last_rc,
		       (unsigned)w.samples,
		       (unsigned)SAMPLES_PER_WINDOW);
	}
}

/* Mean AND spread of the shunt voltage over a short burst.
 *
 * The spread is not decoration: ranking six rails by a raw difference of means
 * picks whichever rail's noise happened to move most, which on this bench chose
 * a 0.6 mA housekeeping rail over the 93 mA compute rail.  The standard error
 * derived from `sd_out` is what lets the caller tell a real load step from
 * dither in the last ADC count. */
static bool scan_shunt_stats(ina236_t                 *mon,
                             tflite::MicroInterpreter *interp,
                             phase_t                   phase,
                             uint32_t                  poll_cycles,
                             uint32_t                  deadline_ms,
                             float                    *mean_out,
                             float                    *sd_out,
                             uint32_t                 *errors_out)
{
	/* Welford's online algorithm in float, NOT sum/sum-of-squares in
	 * integers.
	 *
	 * The integer form truncated the mean before squaring it, so
	 * `var = sum_sq/n - mean*mean` carried an error of up to 2*|mean|: on a
	 * ~2050 uV rail that turned a true sigma of 3.5 uV into a reported
	 * 53 uV, a 15x inflation.  The significance gate below is a multiple of
	 * this sigma, so the inflation made the gate 3-15x too strict and pushed
	 * genuine load steps into the largest-current fallback.  Welford also
	 * avoids the catastrophic cancellation the sum-of-squares form suffers
	 * when the mean dwarfs the spread -- exactly this measurement. */
	float    mean      = 0.0f;
	float    m2        = 0.0f;
	size_t   got       = 0;
	uint32_t errs      = 0;
	uint32_t next_poll = cycles_now() + poll_cycles;
	int64_t  t_start   = k_uptime_get();
	bool     complete  = true;

	while (got < SCAN_SAMPLES) {
		/* Same deadline discipline as run_window: a loop gated on a hardware
		 * flag must never be able to spin forever.  Without it, a monitor
		 * that stops converting mid-scan hangs the app before it ever
		 * reaches the measurement. */
		if ((uint32_t)(k_uptime_get() - t_start) > deadline_ms) {
			complete = false;
			break;
		}
		if ((int32_t)(cycles_now() - next_poll) >= 0) {
			next_poll  = cycles_now() + poll_cycles;
			bool ready = false;
			if (ina236_conversion_ready(mon, &ready) != ALP_OK) {
				errs++;
			} else if (ready) {
				int32_t uv = 0;
				if (ina236_read_shunt_uv(mon, &uv) != ALP_OK) {
					errs++;
				} else {
					got++;
					float d = (float)uv - mean;
					mean += d / (float)got;
					m2 += d * ((float)uv - mean);
				}
			}
		} else if (phase == PHASE_ACTIVE) {
			/* A failing invoke means the "active" burst never inferred, so a
			 * delta computed from it describes nothing.  Count it instead of
			 * silently measuring an idle rail and labelling it active. */
			if (interp->Invoke() != kTfLiteOk) errs++;
		}
	}

	*mean_out   = mean;
	*sd_out     = (got > 1) ? __builtin_sqrtf(m2 / (float)(got - 1)) : 0.0f;
	*errors_out = errs;
	return complete;
}

int main(void)
{
	printk("\n=== aen-inference-energy ===\n");
	printk("model      : %s (%u bytes)\n", NETWORK_MODEL_NAME, (unsigned)NETWORK_MODEL_LEN);

	cycles_init();
	const uint32_t cps = cycles_per_s();
	printk("clock      : %u Hz, timestamp source %s\n",
	       (unsigned)cps,
	       g_dwt_in_use ? "DWT CYCCNT" : "k_cycle_get_32 (DWT NOCYCCNT)");

	const struct device *npu       = DEVICE_DT_GET(NPU_NODE);
	bool                 npu_ready = device_is_ready(npu);
	printk(
	    "npu ready  : %d (Ethos-U85 @0x%08x)\n", (int)npu_ready, (unsigned)DT_REG_ADDR(NPU_NODE));

	/* --- Bring up the model once ------------------------------------------
	 * Built ONCE, invoked many times.  Rebuilding the interpreter per
	 * iteration would fold model parsing and tensor allocation into the
	 * measured window, and the reported cost per "inference" would then
	 * include work a real application does exactly once. */
	memcpy(model_sram, networkModelData, NETWORK_MODEL_LEN);

	const tflite::Model *model = tflite::GetModel(model_sram);
	if (model->version() != TFLITE_SCHEMA_VERSION) {
		printk("RESULT FAIL: model schema %u != supported %d\n",
		       (unsigned)model->version(),
		       TFLITE_SCHEMA_VERSION);
		return 0;
	}

	tflite::MicroMutableOpResolver<8> resolver;
	resolver.AddEthosU();
	resolver.AddReshape();
	resolver.AddConv2D();
	resolver.AddDepthwiseConv2D();
	resolver.AddFullyConnected();
	resolver.AddSoftmax();
	resolver.AddQuantize();
	resolver.AddDequantize();

	tflite::MicroInterpreter interpreter(model, resolver, tensor_arena, TENSOR_ARENA_SIZE);
	TfLiteStatus             alloc = interpreter.AllocateTensors();
	g_alloc_status                 = (int)alloc;
	if (alloc != kTfLiteOk) {
		printk("RESULT FAIL: AllocateTensors=%d\n", (int)alloc);
		return 0;
	}
	TfLiteTensor *input = interpreter.input(0);
	memset(input->data.raw, 0, input->bytes);

	/* One warm-up invoke, outside every window: the first call through the
	 * Ethos-U driver reserves the device and faults in code paths a steady
	 * state never repeats, and folding that into window 0 would inflate it. */
	TfLiteStatus warm = interpreter.Invoke();
	g_invoke_status   = (int)warm;
	if (warm != kTfLiteOk) {
		printk("RESULT FAIL: warm-up Invoke=%d (NPU dispatch failed) npu_ready=%d\n",
		       (int)warm,
		       (int)npu_ready);
		return 0;
	}
	printk("inference  : warm-up OK (input %u B, output %u B)\n",
	       (unsigned)input->bytes,
	       (unsigned)interpreter.output(0)->bytes);

	/* --- Open the rail-monitor bus --------------------------------------- */
	alp_i2c_config_t i2c_cfg = ALP_I2C_CONFIG_DEFAULT(EVK_I2C_BUS_SENSORS);
	alp_i2c_t       *bus     = alp_i2c_open(&i2c_cfg);
	if (bus == NULL) {
		printk("RESULT FAIL: alp_i2c_open(EVK_I2C_BUS_SENSORS) returned NULL\n");
		return 0;
	}

	const uint32_t period_us =
	    ina236_sample_period_us(SAMPLE_AVG, SAMPLE_VBUSCT, SAMPLE_VSHCT, SAMPLE_MODE);
	if (period_us == 0U) {
		printk("RESULT FAIL: sample period 0 (shutdown mode selected)\n");
		return 0;
	}
	/* Poll four times per conversion so a completed conversion is picked up
	 * within a quarter period; the recorded timestamp is the real read time,
	 * so the residual jitter does not bias the integral. */
	const uint32_t poll_cycles = (uint32_t)(((uint64_t)period_us * cps) / 4000000ULL);

	/* --- Scan: which rail actually feeds the compute? ---------------------
	 * Every rail is measured the same way and ranked by how far its shunt
	 * voltage moves between inferring and quiet.  An absent monitor simply
	 * does not compete. */
	printk("scan       : %u rails, %u samples/phase, period %u us\n",
	       (unsigned)ARRAY_SIZE(RAILS),
	       (unsigned)SCAN_SAMPLES,
	       (unsigned)period_us);

	/* Two independent rankings are kept, because the delta ranking is only
	 * trustworthy when SOME rail actually shows a significant step.
	 *   best_sig     -- largest significant (>= NOISE_SIGMA standard errors,
	 *                   and positive: active must draw MORE) delta.
	 *   best_current -- largest steady-state current, i.e. the rail carrying
	 *                   the most power regardless of whether this workload
	 *                   moves it.  The fallback, and reported as such.
	 * A tiny model genuinely produces no significant delta on any rail; in
	 * that case picking "the rail whose noise moved most" is worse than
	 * useless, because the resulting energy figure looks real. */
	static constexpr float NOISE_SIGMA = 3.0f;

	/* Per-rail scan results, kept for EVERY rail rather than folded into a
	 * running best.  The operator override below reassigns which rail is
	 * measured, and the ADC range is then picked from that rail's observed
	 * peak -- with only the auto-winner's peak retained, an override silently
	 * picked the range from a DIFFERENT rail and could clip the very peaks
	 * the measurement is about. */
	struct scan_result {
		bool     answered;
		bool     complete;
		float    act_uv;
		float    idl_uv;
		float    act_sd;
		float    idl_sd;
		int32_t  bus_mv;
		float    peak_uv;
		float    delta_ma; /* rail-comparable: uV / shunt_ohms */
		float    act_mw;   /* rail-comparable: current x bus voltage */
		bool     significant;
		uint32_t errors;
	};
	static scan_result scan[ARRAY_SIZE(RAILS)] = {};

	const uint32_t scan_deadline_ms =
	    (uint32_t)(((uint64_t)SCAN_SAMPLES * period_us * WINDOW_DEADLINE_MULT) / 1000ULL);

	for (size_t i = 0; i < ARRAY_SIZE(RAILS); i++) {
		ina236_t     probe;
		alp_status_t rc = ina236_init(
		    &probe, bus, RAILS[i].addr, RAILS[i].shunt_ohms, RAILS[i].max_a, INA236_ADCRANGE_81MV);
		if (rc != ALP_OK) {
			printk("ENERGY-SCAN %-6s 0x%02x absent rc=%d\n", RAILS[i].name, RAILS[i].addr, (int)rc);
			continue;
		}
		if (ina236_configure(&probe, SAMPLE_AVG, SAMPLE_VBUSCT, SAMPLE_VSHCT, SAMPLE_MODE) !=
		    ALP_OK) {
			printk("ENERGY-SCAN %-6s 0x%02x configure failed\n", RAILS[i].name, RAILS[i].addr);
			continue;
		}
		/* Discard the conversions in flight across the reconfiguration --
		 * they average over both the old and new settings. */
		k_msleep((int32_t)(2U * period_us / 1000U) + 2);

		scan_result *r = &scan[i];
		r->answered    = true;
		uint32_t e_act = 0, e_idl = 0;
		bool     c_act = scan_shunt_stats(&probe,
		                                  &interpreter,
		                                  PHASE_ACTIVE,
		                                  poll_cycles,
		                                  scan_deadline_ms,
		                                  &r->act_uv,
		                                  &r->act_sd,
		                                  &e_act);
		bool     c_idl = scan_shunt_stats(&probe,
		                                  &interpreter,
		                                  PHASE_IDLE,
		                                  poll_cycles,
		                                  scan_deadline_ms,
		                                  &r->idl_uv,
		                                  &r->idl_sd,
		                                  &e_idl);
		r->complete    = c_act && c_idl;
		r->errors      = e_act + e_idl;
		(void)ina236_read_bus_mv(&probe, &r->bus_mv);

		float d_uv = r->act_uv - r->idl_uv;
		r->peak_uv = (fabsf(r->act_uv) > fabsf(r->idl_uv)) ? fabsf(r->act_uv) : fabsf(r->idl_uv);

		/* Standard error of the difference of two means, floored at one shunt
		 * ADC count.  Without the floor a rail whose 16 scan samples are
		 * BIT-IDENTICAL (reachable -- +1V8 reads 0 uV in both phases on this
		 * board) gives se = 0, and then any +1-count offset satisfies
		 * `d > 3*0` and is declared significant.  The 3-sigma gate would be
		 * vacuous on exactly the quiet housekeeping rails it exists to
		 * reject.  The scan runs on ADCRANGE_81MV, so one count is 2.5 uV. */
		float se =
		    __builtin_sqrtf((r->act_sd * r->act_sd + r->idl_sd * r->idl_sd) / (float)SCAN_SAMPLES);
		if (se < SCAN_SHUNT_LSB_UV) se = SCAN_SHUNT_LSB_UV;
		r->significant = (d_uv > 0.0f) && (d_uv > NOISE_SIGMA * se) && r->complete;

		/* Rank in CURRENT and POWER, never in raw shunt microvolts.  This
		 * board mixes 20 mOhm and 50 mOhm shunts, so microvolts are not
		 * comparable across rails: 190 uV is 9.5 mA on 20 mOhm but 3.8 mA on
		 * 50 mOhm, a 2.5x bias that made a small camera rail able to
		 * outrank the real compute rail. */
		r->delta_ma = (d_uv / RAILS[i].shunt_ohms) / 1000.0f;
		r->act_mw   = ((r->act_uv / RAILS[i].shunt_ohms) / 1000.0f) * ((float)r->bus_mv / 1000.0f);

		printk("ENERGY-SCAN %-6s 0x%02x active_uv=%.1f(sd=%.1f) idle_uv=%.1f(sd=%.1f) "
		       "delta_uv=%.1f delta_ma=%.3f bus_mv=%d act_mw=%.1f se_uv=%.2f "
		       "significant=%d complete=%d errors=%u\n",
		       RAILS[i].name,
		       RAILS[i].addr,
		       (double)r->act_uv,
		       (double)r->act_sd,
		       (double)r->idl_uv,
		       (double)r->idl_sd,
		       (double)d_uv,
		       (double)r->delta_ma,
		       (int)r->bus_mv,
		       (double)r->act_mw,
		       (double)se,
		       (int)r->significant,
		       (int)r->complete,
		       (unsigned)r->errors);

		ina236_deinit(&probe);
	}

	/* Pick by the largest SIGNIFICANT delta in milliamps; fall back to the
	 * rail carrying the most POWER when no rail shows a significant step (a
	 * trivial model genuinely produces none, and then "the rail whose noise
	 * moved most" is worse than useless because the figure looks real). */
	int best_sig = -1, best_pwr = -1;
	for (size_t i = 0; i < ARRAY_SIZE(RAILS); i++) {
		if (!scan[i].answered) continue;
		if (scan[i].significant && (best_sig < 0 || scan[i].delta_ma > scan[best_sig].delta_ma)) {
			best_sig = (int)i;
		}
		if (best_pwr < 0 || scan[i].act_mw > scan[best_pwr].act_mw) best_pwr = (int)i;
	}

	if (best_pwr < 0) {
		printk("RESULT FAIL: no INA236 answered on EVK_I2C_BUS_SENSORS\n");
		return 0;
	}

	int         best      = (best_sig >= 0) ? best_sig : best_pwr;
	const char *criterion = (best_sig >= 0) ? "largest-significant-delta" : "largest-power";

	/* Operator override: pin a specific monitor by 7-bit address, e.g.
	 * -DAEN_ENERGY_RAIL_ADDR=0x4A.  The automatic pick is right when a
	 * workload moves a rail measurably; when it does not, the person who
	 * knows which rail feeds the module should be able to say so without
	 * editing this file. */
#ifdef AEN_ENERGY_RAIL_ADDR
	for (size_t i = 0; i < ARRAY_SIZE(RAILS); i++) {
		if (RAILS[i].addr == (uint8_t)(AEN_ENERGY_RAIL_ADDR)) {
			if (!scan[i].answered) {
				printk("RESULT FAIL: AEN_ENERGY_RAIL_ADDR=0x%02x did not answer\n",
				       (unsigned)RAILS[i].addr);
				return 0;
			}
			best      = (int)i;
			criterion = "operator-override";
			break;
		}
	}
#endif
	g_rail_index = best;

	/* --- Range pick, from what the SELECTED rail actually saw ------------
	 * Read after the override, so the range always describes the rail that
	 * is about to be measured. */
	const float       best_peak  = scan[best].peak_uv;
	const float       best_delta = scan[best].act_uv - scan[best].idl_uv;
	ina236_adcrange_t range =
	    (best_peak < (float)ADCRANGE_20MV_MAX_UV) ? INA236_ADCRANGE_20MV : INA236_ADCRANGE_81MV;
	printk("rail       : %s @0x%02x by %s delta_uv=%.1f peak_uv=%.1f -> ADCRANGE %s\n",
	       RAILS[best].name,
	       RAILS[best].addr,
	       criterion,
	       (double)best_delta,
	       (double)best_peak,
	       range == INA236_ADCRANGE_20MV ? "20.48mV" : "81.92mV");

	ina236_t mon;
	if (ina236_init(
	        &mon, bus, RAILS[best].addr, RAILS[best].shunt_ohms, RAILS[best].max_a, range) !=
	        ALP_OK ||
	    ina236_configure(&mon, SAMPLE_AVG, SAMPLE_VBUSCT, SAMPLE_VSHCT, SAMPLE_MODE) != ALP_OK) {
		printk("RESULT FAIL: selected rail %s failed re-init/configure\n", RAILS[best].name);
		return 0;
	}
	k_msleep((int32_t)(2U * period_us / 1000U) + 2);

	const float power_lsb_w = ina236_power_lsb_w(&mon);

	printk("ENERGY-CFG {\"rail\":\"%s\",\"addr\":%u,\"shunt_ohms\":%f,"
	       "\"current_lsb_a\":%f,\"power_lsb_w\":%f,\"adcrange\":%d,\"avg\":%u,"
	       "\"vbusct_us\":%u,\"vshct_us\":%u,\"sample_period_us\":%u,"
	       "\"cycles_per_s\":%u,\"samples_per_window\":%u,\"windows\":%u,"
	       "\"npu_dispatched\":%s,\"baseline\":\"cpu-spin-npu-idle\","
	       "\"rail_selected_by\":\"%s\",\"timestamp_source\":\"%s\"}\n",
	       RAILS[best].name,
	       (unsigned)RAILS[best].addr,
	       (double)RAILS[best].shunt_ohms,
	       (double)mon.current_lsb_a,
	       (double)power_lsb_w,
	       (int)range,
	       /* Derived from the enums, never restated as literals: a hardcoded
	        * 16/140/140 makes the emitted config describe a run that did not
	        * happen the moment someone changes SAMPLE_AVG or a CT code.  The
	        * driver owns both datasheet tables, so ask it. */
	       (unsigned)ina236_avg_count(SAMPLE_AVG),
	       (unsigned)ina236_conversion_time_us(SAMPLE_VBUSCT),
	       (unsigned)ina236_conversion_time_us(SAMPLE_VSHCT),
	       (unsigned)period_us,
	       (unsigned)cps,
	       (unsigned)SAMPLES_PER_WINDOW,
	       (unsigned)WINDOW_PAIRS,
	       npu_ready ? "true" : "false",
	       criterion,
	       g_dwt_in_use ? "dwt-cyccnt" : "k-cycle-get-32");

	/* --- The measurement ------------------------------------------------- */
	float    per_window_mj[WINDOW_PAIRS] = { 0.0f };
	uint32_t total_inferences            = 0;
	uint32_t n_last                      = 0;
	bool     all_ok                      = true;

	/* Expected window duration in ms, times the overrun allowance. */
	const uint32_t deadline_ms =
	    (uint32_t)(((uint64_t)SAMPLES_PER_WINDOW * period_us * WINDOW_DEADLINE_MULT) / 1000ULL);
	size_t pairs_used = 0;

	for (size_t w = 0; w < WINDOW_PAIRS; w++) {
		window_result act = {}, idl = {};

		/* Phase markers carry the kernel uptime so an EXTERNAL instrument's
		 * trace (a bench PSU log, a power analyser) can be aligned to the
		 * exact interval each phase occupied.  Printed before the window
		 * opens, so the console write is outside the integration interval. */
		printk("ENERGY-PHASE %u %s begin uptime_ms=%lld\n",
		       (unsigned)w,
		       phase_name(PHASE_ACTIVE),
		       (long long)k_uptime_get());
		run_window(&mon,
		           &interpreter,
		           PHASE_ACTIVE,
		           poll_cycles,
		           SAMPLES_PER_WINDOW,
		           deadline_ms,
		           power_lsb_w,
		           (float)cps,
		           &act);
		printk("ENERGY-PHASE %u %s end uptime_ms=%lld\n",
		       (unsigned)w,
		       phase_name(PHASE_ACTIVE),
		       (long long)k_uptime_get());
		float e_act = act.energy_mj;
		emit_window(w, PHASE_ACTIVE, act);

		printk("ENERGY-PHASE %u %s begin uptime_ms=%lld\n",
		       (unsigned)w,
		       phase_name(PHASE_IDLE),
		       (long long)k_uptime_get());
		run_window(&mon,
		           &interpreter,
		           PHASE_IDLE,
		           poll_cycles,
		           SAMPLES_PER_WINDOW,
		           deadline_ms,
		           power_lsb_w,
		           (float)cps,
		           &idl);
		printk("ENERGY-PHASE %u %s end uptime_ms=%lld\n",
		       (unsigned)w,
		       phase_name(PHASE_IDLE),
		       (long long)k_uptime_get());
		float e_idl = idl.energy_mj;
		emit_window(w, PHASE_IDLE, idl);

		/* A pair is only usable if inference ran AND both windows cover
		 * comparable wall-clock time.  windowed_delta() is a subtraction of
		 * two integrals, not a rate comparison, so mismatched durations bias
		 * the baseline -- a short idle window subtracts too little and
		 * inflates the per-inference figure.  10 % is well above the jitter
		 * a healthy pair shows (bench-observed: 1101 vs 1102 ms). */
		uint32_t span_lo     = act.span_ms < idl.span_ms ? act.span_ms : idl.span_ms;
		uint32_t span_hi     = act.span_ms > idl.span_ms ? act.span_ms : idl.span_ms;
		bool     spans_match = (span_hi == 0) ? false : ((span_hi - span_lo) * 10U <= span_hi);

		if (act.inferences == 0 || !spans_match || act.timed_out || idl.timed_out) {
			all_ok = false;
			printk("ENERGY-PAIR %u SKIPPED: n=%u spans %u/%u ms match=%d "
			       "timed_out=%d/%d\n",
			       (unsigned)w,
			       (unsigned)act.inferences,
			       (unsigned)act.span_ms,
			       (unsigned)idl.span_ms,
			       (int)spans_match,
			       (int)act.timed_out,
			       (int)idl.timed_out);
			continue;
		}
		per_window_mj[pairs_used++] = (e_act - e_idl) / (float)act.inferences;
		total_inferences += act.inferences;
		n_last = act.inferences;
		printk("ENERGY-PAIR %u active_mj=%f idle_mj=%f n=%u mj_per_inference=%f\n",
		       (unsigned)w,
		       (double)e_act,
		       (double)e_idl,
		       (unsigned)act.inferences,
		       (double)per_window_mj[pairs_used - 1]);
	}

	if (pairs_used == 0) {
		printk("RESULT FAIL: no usable (active, idle) pair -- see ENERGY-PAIR / "
		       "ENERGY-WERR lines above\n");
		return 0;
	}
	g_total_inferences = total_inferences;

	/* Mean and sample standard deviation across the pairs.  The spread is the
	 * honest error bar on the mean: a spread comparable to the value itself
	 * means the measurement is noise, and the reader must be able to see that
	 * rather than infer it. */
	float mean = 0.0f;
	for (size_t w = 0; w < pairs_used; w++) {
		mean += per_window_mj[w];
	}
	mean /= (float)pairs_used;

	/* Sample standard deviation needs at least two pairs; with one usable pair
	 * there is no spread to report, and reporting 0.0 would read as "perfectly
	 * repeatable" rather than "never repeated". */
	float spread      = 0.0f;
	bool  have_spread = (pairs_used >= 2);
	if (have_spread) {
		float var = 0.0f;
		for (size_t w = 0; w < pairs_used; w++) {
			float d = per_window_mj[w] - mean;
			var += d * d;
		}
		var /= (float)(pairs_used - 1);
		spread = (var > 0.0f) ? __builtin_sqrtf(var) : 0.0f;
	}
	g_mj_per_inference = mean;

	/* The device's own answer, in the host's schema.  `source` and `scope` are
	 * the labels the host contract validates -- carrier-rail delta, never
	 * silicon or NPU energy -- so they are emitted verbatim and never
	 * "upgraded" here. */
	printk("ENERGY-RESULT {\"source\":\"measured\",\"scope\":\"carrier-rail-delta\","
	       "\"value_mj_per_inference\":%f,\"rails\":[\"%s\"],\"n_inferences\":%u,"
	       "\"window_ms\":%f,\"sample_count\":%u,\"pairs_used\":%u,"
	       "\"total_inferences\":%u,\"spread_mj\":",
	       (double)mean,
	       RAILS[best].name,
	       (unsigned)n_last,
	       (double)((float)SAMPLES_PER_WINDOW * (float)period_us / 1000.0f),
	       (unsigned)(SAMPLES_PER_WINDOW * 2U * pairs_used),
	       (unsigned)pairs_used,
	       (unsigned)total_inferences);
	/* JSON `null`, not a negative sentinel.  A single pair has no spread to
	 * report, and 0.0 would read as "perfectly repeatable" rather than "never
	 * repeated".  The earlier "-0.000000" sentinel did not work either:
	 * json.loads gives -0.0, and `-0.0 < 0` is False in Python, so every
	 * reader saw 0.0 -- the precise misreading it was meant to prevent.
	 * measure.py's spread_mj is already `float | None`. */
	if (have_spread) {
		printk("%f}\n", (double)spread);
	} else {
		printk("null}\n");
	}

	if (mean > 0.0f) {
		printk("RESULT PASS: %f mJ/inference (+/-%f) rail=%s n=%u pairs=%u/%u "
		       "all_pairs_ok=%d\n",
		       (double)mean,
		       (double)spread,
		       RAILS[best].name,
		       (unsigned)n_last,
		       (unsigned)pairs_used,
		       (unsigned)WINDOW_PAIRS,
		       (int)all_ok);
	} else {
		/* A non-positive delta is a real outcome, not a crash: it means the
		 * inference load did not rise above this rail's noise.  Reporting it
		 * as FAIL keeps a meaningless number from being quoted as a result. */
		printk("RESULT FAIL: delta not resolvable -- mean=%f spread=%f all_windows_ok=%d "
		       "rail=%s (inference load below this rail's noise, or wrong rail)\n",
		       (double)mean,
		       (double)spread,
		       (int)all_ok,
		       RAILS[best].name);
	}

	ina236_deinit(&mon);
	return 0;
}
