## CMakeLists.txt
```
# SPDX-License-Identifier: Apache-2.0
#
# M55-HP (RTSS-HP) first-light smoke for the E1M-AEN801 (Alif Ensemble E8) -- the
# first alp-sdk image on the SECOND M55.  SES-booted as an M55_HP ATOC
# (loadAddress 0x50000000); proves the HP core runs by writing an advancing
# liveness beacon to global SRAM0 (read over the system AXI-AP).
#
# Standalone Zephyr app: build for the HP board target with
#   ZEPHYR_BASE=<zephyr-base> west build \
#     -b alp_e1m_aen801_m55_hp/ae822fa0e5597ls0/rtss_hp <this-dir> -- \
#     "-DEXTRA_ZEPHYR_MODULES=<alp-sdk>;<hal_alif>"
# Zephyr applies boards/<fully-qualified-board>.overlay by itself.

cmake_minimum_required(VERSION 3.20)

find_package(Zephyr REQUIRED HINTS $ENV{ZEPHYR_BASE})
project(aen_hp_core_smoke LANGUAGES C)

target_sources(app PRIVATE src/main.c)
```

## prj.conf
```kconfig
# SPDX-License-Identifier: Apache-2.0
#
# Bench config for the M55-HP first-light smoke on the E1M-AEN801 (Alif Ensemble
# E8).  Unlike the peripheral/regcheck examples -- which now default to the Alp
# UART console (E1M edge UART0) -- this first-light smoke deliberately keeps the
# RAM console: its load-bearing signal is the SRAM0 beacon + banner read raw
# over SWD (the AXI-AP), so console output must land in a memory buffer, not a
# UART.  The HP board _defconfig selects a UART5 console; we override it here.

# --- RAM console (read 'ram_console_buf' over SWD via the AXI-AP) -------------
CONFIG_RAM_CONSOLE=y
CONFIG_RAM_CONSOLE_BUFFER_SIZE=2048
CONFIG_UART_CONSOLE=n
CONFIG_CONSOLE=y
CONFIG_SERIAL=n
CONFIG_PRINTK=y

CONFIG_ALP_SDK=y

# E8 D-cache maintenance loop hangs on this silicon (shared bench rule); and the
# SRAM0 beacon must be coherent with the host read over the system bus, so keep
# the D-cache off (a cached beacon write could sit in the HP D-cache, unseen by
# the AXI-AP read).
CONFIG_DCACHE=n

# Keep the image small + deterministic.  LOG MUST stay off -- CONFIG_LOG=y
# reroutes printk into the logging subsystem, which has no RAM-console backend.
CONFIG_LOG=n
```

## boards/alp_e1m_aen801_m55_hp.overlay
```dts
/*
 * Copyright (c) 2026 Alp Lab AB
 * SPDX-License-Identifier: Apache-2.0
 *
 * M55-HP first-light smoke overlay for the E1M-AEN801 (Alif Ensemble E8), SES-
 * booted as an M55_HP ATOC.
 *
 * The image is ITCM-linked so the SES loads it to the HP ITCM global base
 * (0x50000000, vs the HE core's 0x58000000) and boots the HP core.  No
 * peripheral nodes are needed -- the app prints to the RAM console and writes
 * the SRAM0 liveness beacon by absolute address.
 */
/ {
	chosen {
		/* PATH-REFERENCE form (&itcm) so CONFIG_FLASH links into ITCM; the
		 * SES HP ATOC loadAddress (0x50000000) puts it at the HP ITCM global
		 * base.  Drop the code-partition fixup (this is not an MCUboot slot). */
		zephyr,flash = &itcm;
		/delete-property/ zephyr,code-partition;
	};
};
```

## boards/alp_e1m_aen803_m55_hp_ae822fa0e5597ls0_rtss_hp.overlay
```dts
/*
 * Copyright (c) 2026 Alp Lab AB
 * SPDX-License-Identifier: Apache-2.0
 *
 * M55-HP first-light smoke overlay for the E1M-AEN803 (Alif Ensemble E8), SES-
 * booted as an M55_HP ATOC.
 *
 * The image is ITCM-linked so the SES loads it to the HP ITCM global base
 * (0x50000000, vs the HE core's 0x58000000) and boots the HP core.  No
 * peripheral nodes are needed -- the app prints to the RAM console and writes
 * the SRAM0 liveness beacon by absolute address.
 */
/ {
	chosen {
		/* PATH-REFERENCE form (&itcm) so CONFIG_FLASH links into ITCM; the
		 * SES HP ATOC loadAddress (0x50000000) puts it at the HP ITCM global
		 * base.  Drop the code-partition fixup (this is not an MCUboot slot). */
		zephyr,flash = &itcm;
		/delete-property/ zephyr,code-partition;
	};
};
```

## src/main.c
```c
/*
 * Copyright (c) 2026 Alp Lab AB
 * SPDX-License-Identifier: Apache-2.0
 *
 * First-light smoke for the M55-HP (RTSS-HP) core of the E1M-AEN801 (Alif
 * Ensemble E8).  Every prior bench app ran on the M55-HE core; this is the first
 * alp-sdk image targeted at the SECOND M55.
 *
 * Boot model
 * ----------
 * The HP core is held in reset at power-on (the J-Link AP map shows only the HE
 * core's AHB-AP with a readable CPUID; the HP core's AP reads no CPUID until it
 * is released).  It is released by the Secure Enclave booting an `M55_HP` ATOC:
 * SETOOLS authors the package with cpu_id="M55_HP", loadAddress=0x50000000 (the
 * HP ITCM global base, vs the HE core's 0x58000000), flags ["load","boot"]; the
 * SES loads this image there and starts the HP core.
 *
 * Observability
 * -------------
 * The bench reads memory over SWD via the HE/AXI debug AP, not the HP core's AP,
 * so this app does NOT rely on the HP core's RAM console being reachable.
 * Instead it writes a LIVENESS BEACON to global SRAM0 (0x02000000) -- on-chip SRAM
 * at the same address from every master, so the host reads it over the system
 * AXI-AP regardless of HP core state.  SRAM0 is NOT always-on: an M55-HE STOP
 * powers it off unless the HE image names it in
 * CONFIG_ALP_SDK_POWER_ALIF_SE_OFF_KEEP_MEMORY (aen-power-stop h-hp-running):
 *
 *   SRAM0[0] = 0xA11FE000  magic  ("ALIVE")
 *   SRAM0[1] = SCB.CPUID          (0x411FD220 = Cortex-M55)
 *   SRAM0[2] = SCB.VTOR           (vector base; expect 0x00000000 -- the HP core
 *                                  runs from its local ITCM at 0x0, so VTOR reads 0.
 *                                  The SES HP load is confirmed by CPUID + an
 *                                  advancing heartbeat, not by VTOR.)
 *   SRAM0[3] = heartbeat          (incremented every ~100 ms -> ADVANCING means
 *                                  the HP core is actively executing, not a stale
 *                                  value left by a prior image)
 *
 * The RAM console line is bonus (read it via the AXI-AP at the HP DTCM global
 * address if wired); the beacon is the primary, AP-agnostic proof.
 *
 * BENCH-VALIDATION app -- not a customer teaching example.
 */

#include <zephyr/kernel.h>

/* Cortex-M System Control Block, by absolute address (no CMSIS header needed). */
#define SCB_CPUID (*(volatile uint32_t *)0xE000ED00U)
#define SCB_VTOR  (*(volatile uint32_t *)0xE000ED08U)

/* Global SRAM0 liveness beacon (on-chip SRAM, master-agnostic address). */
#define SRAM0_BEACON ((volatile uint32_t *)0x02000000U)
#define BEACON_MAGIC 0xA11FE000U /* "ALIVE" */

int main(void)
{
	uint32_t cpuid = SCB_CPUID;
	uint32_t vtor  = SCB_VTOR;
	uint32_t hb    = 0U;

	/* Seed the beacon immediately so even a one-shot read after boot proves
	 * the HP core reached main(). */
	SRAM0_BEACON[0] = BEACON_MAGIC;
	SRAM0_BEACON[1] = cpuid;
	SRAM0_BEACON[2] = vtor;
	SRAM0_BEACON[3] = hb;

	printk("\n=== AEN801 M55-HP core smoke (first light) ===\n");
	printk("HP core alive: CPUID=0x%08x VTOR=0x%08x\n", cpuid, vtor);
	printk("SRAM0 beacon @0x02000000: magic=0x%08x cpuid=0x%08x vtor=0x%08x\n",
	       BEACON_MAGIC,
	       cpuid,
	       vtor);
	printk("RESULT PASS: M55-HP reached main() and seeded the SRAM0 beacon\n");

	/* Advancing heartbeat: a host that reads SRAM0[3] twice sees it move, which
	 * proves the HP core is actively running (not a stale beacon). */
	while (1) {
		SRAM0_BEACON[3] = ++hb;
		printk("HP heartbeat %u\n", hb);
		k_msleep(100);
	}

	return 0;
}
```
