## CMakeLists.txt
```
# SPDX-License-Identifier: Apache-2.0
#
# On-silicon LPRTC validation for the E1M-AEN801 (Alif Ensemble E8), reading the
# always-on lprtc@42000000 (Synopsys DesignWare APB RTC) through the portable
# Zephyr counter_* class API over the alp-sdk Tier-2 counter_dw_rtc driver.  A
# RAM console carries the PASS/FAIL line; the human ALSO reads the LPRTC CCVR
# register over J-Link to confirm the count advances independently of any printk.
#
# This is a COUNTER regcheck, NOT a calendar-RTC test: the DW-APB-RTC has no
# date/time registers, so it cannot back alp_rtc_* as-is (see README -- the
# counter->calendar shim is TBD).
#
# Standalone Zephyr app (no alp_project.py board.yaml flow): build with
#   ZEPHYR_BASE=<zephyr-base> west build \
#     -b alp_e1m_aen801_m55_he/ae822fa0e5597ls0/rtss_he <this-dir> -- \
#     "-DEXTRA_ZEPHYR_MODULES=<alp-sdk>;<hal_alif>"
# Zephyr applies boards/<fully-qualified-board>.overlay by itself.

cmake_minimum_required(VERSION 3.20)

find_package(Zephyr REQUIRED HINTS $ENV{ZEPHYR_BASE})
project(aen_rtc_regcheck LANGUAGES C)

target_sources(app PRIVATE src/main.c)
```

## prj.conf
```kconfig
# SPDX-License-Identifier: Apache-2.0
#
# Bench config for the LPRTC counter RAM-run on the E1M-AEN801 (Alif Ensemble
# E8).

# Console: Alp UART console -- E1M edge UART0 (Alif UART5, P3_4/P3_5, 115200
# 8N1, NS16550), the E1M-AEN801 carrier console. The board _defconfig already
# selects it; we set it explicitly here so the example is self-describing.
CONFIG_SERIAL=y
CONFIG_CONSOLE=y
CONFIG_UART_CONSOLE=y
CONFIG_UART_INTERRUPT_DRIVEN=y
# Serial-less bench? Comment the four lines above and uncomment these to read
# 'ram_console_buf' over SWD instead:
# CONFIG_RAM_CONSOLE=y
# CONFIG_RAM_CONSOLE_BUFFER_SIZE=2048
# CONFIG_UART_CONSOLE=n
CONFIG_PRINTK=y

# --- LPRTC counter -----------------------------------------------------------
# CONFIG_COUNTER_RTC_SNPS_DW (the Tier-2 driver) is `default y` under `if
# ALP_SDK` once the okay'd "snps,dw-apb-rtc" node (lprtc@42000000) exists, so
# ALP_SDK MUST be on to surface it; COUNTER pulls in the Zephyr counter
# subsystem the driver registers against.
CONFIG_ALP_SDK=y
CONFIG_COUNTER=y

# Keep the image small + deterministic for a RAM-run.
CONFIG_LOG=n
```

## boards/alp_e1m_aen801_m55_he.overlay
```dts
/*
 * Copyright (c) 2026 Alp Lab AB
 * SPDX-License-Identifier: Apache-2.0
 *
 * On-silicon LPRTC validation overlay for the E1M-AEN801 (Alif Ensemble E8,
 * M55-HE), bench RAM-run via J-Link.
 *
 * Validates the alp-sdk Tier-2 counter_dw_rtc driver on the always-on
 * lprtc@42000000 (compatible "snps,dw-apb-rtc").  The driver binds it as a
 * Zephyr COUNTER device: a free-running 32-bit up-counter (CCVR) with one
 * compare/alarm channel (CMR), clocked at 32768 Hz from the VBAT-domain LF
 * source.
 *
 * NOT a calendar RTC: the DW-APB-RTC has no battery-backed date/time registers,
 * so it does NOT back the alp_rtc_* calendar surface (the alp on-silicon RTC
 * backend binds the Zephyr RTC *class* via the alp-rtc alias -- it will NOT bind
 * this counter).  A counter->calendar shim backend is still TBD (see README).
 * This overlay therefore exercises the COUNTER path only, via alp-counter.
 *
 * LPRTC register the human reads over J-Link to confirm the count advances
 * (ground truth, independent of any printk).  Offsets from the vendored
 * register header zephyr/drivers/counter/counter_dw_rtc.h:
 *     CCVR (current counter value) = base + DW_RTC_REG_CCVR(0x00) = 0x42000000
 * mem32 0x42000000 should advance ~32768 ticks/second.
 *
 * CLOCK-GATE NOTE (BENCH-UNVERIFIED): the LPRTC clock is gated from VBAT.  The
 * fork SoC layer writes VBAT_LPRTC0_CLK_EN (0x1A609010) when rtc0 is okay;
 * upstream Zephyr v4.4's ensemble soc.c (the alp-sdk build path) does NOT, and
 * the driver does not write VBAT either.  If CCVR never advances on the bench,
 * the gate is the cause -- enable it from the SoC bring-up (or confirm the
 * always-on VBAT domain already runs it).  Do NOT add a VBAT write without the
 * Alif TRM confirming the bit.  See the dtsi node + driver header.
 */

/*
 * MANDATORY bench RAM-run retarget: run from ITCM so J-Link can loadbin+run
 * without programming MRAM, and drop the MCUboot code-partition fixup.
 */
/ {
	chosen {
		/* PATH-REFERENCE form (&itcm), NOT the <&itcm> phandle-array form:
		 * the phandle-array form yields CONFIG_FLASH_SIZE=0 and the image
		 * overflows the (empty) FLASH region at link time. */
		zephyr,flash = &itcm;
		/delete-property/ zephyr,code-partition;
	};

	aliases {
		/* The wildcard counter backend resolves alp-counter0; keep the
		 * alias here so a portable alp_counter_open() path also works.
		 * (The LPRTC is a counter, not a calendar RTC -- it is NOT wired to
		 * an alp-rtc<N> alias.) */
		alp-counter0 = &rtc0;
	};
};

/* Enable the LPRTC node so the snps,dw-apb-rtc driver instantiates a device.
 * Okay'ing rtc0 is ALSO what the fork SoC layer keys its VBAT clock-gate on
 * (see the note above); on the alp-sdk upstream build that gate is bench-TBD. */
&rtc0 {
	status = "okay";
};
```

## boards/alp_e1m_aen803_m55_he_ae822fa0e5597ls0_rtss_he.overlay
```dts
/*
 * Copyright (c) 2026 Alp Lab AB
 * SPDX-License-Identifier: Apache-2.0
 *
 * On-silicon LPRTC validation overlay for the E1M-AEN803 (Alif Ensemble E8,
 * M55-HE), bench RAM-run via J-Link.
 *
 * Validates the alp-sdk Tier-2 counter_dw_rtc driver on the always-on
 * lprtc@42000000 (compatible "snps,dw-apb-rtc").  The driver binds it as a
 * Zephyr COUNTER device: a free-running 32-bit up-counter (CCVR) with one
 * compare/alarm channel (CMR), clocked at 32768 Hz from the VBAT-domain LF
 * source.
 *
 * NOT a calendar RTC: the DW-APB-RTC has no battery-backed date/time registers,
 * so it does NOT back the alp_rtc_* calendar surface (the alp on-silicon RTC
 * backend binds the Zephyr RTC *class* via the alp-rtc alias -- it will NOT bind
 * this counter).  A counter->calendar shim backend is still TBD (see README).
 * This overlay therefore exercises the COUNTER path only, via alp-counter.
 *
 * LPRTC register the human reads over J-Link to confirm the count advances
 * (ground truth, independent of any printk).  Offsets from the vendored
 * register header zephyr/drivers/counter/counter_dw_rtc.h:
 *     CCVR (current counter value) = base + DW_RTC_REG_CCVR(0x00) = 0x42000000
 * mem32 0x42000000 should advance ~32768 ticks/second.
 *
 * CLOCK-GATE NOTE (BENCH-UNVERIFIED): the LPRTC clock is gated from VBAT.  The
 * fork SoC layer writes VBAT_LPRTC0_CLK_EN (0x1A609010) when rtc0 is okay;
 * upstream Zephyr v4.4's ensemble soc.c (the alp-sdk build path) does NOT, and
 * the driver does not write VBAT either.  If CCVR never advances on the bench,
 * the gate is the cause -- enable it from the SoC bring-up (or confirm the
 * always-on VBAT domain already runs it).  Do NOT add a VBAT write without the
 * Alif TRM confirming the bit.  See the dtsi node + driver header.
 */

/*
 * MANDATORY bench RAM-run retarget: run from ITCM so J-Link can loadbin+run
 * without programming MRAM, and drop the MCUboot code-partition fixup.
 */
/ {
	chosen {
		/* PATH-REFERENCE form (&itcm), NOT the <&itcm> phandle-array form:
		 * the phandle-array form yields CONFIG_FLASH_SIZE=0 and the image
		 * overflows the (empty) FLASH region at link time. */
		zephyr,flash = &itcm;
		/delete-property/ zephyr,code-partition;
	};

	aliases {
		/* The wildcard counter backend resolves alp-counter0; keep the
		 * alias here so a portable alp_counter_open() path also works.
		 * (The LPRTC is a counter, not a calendar RTC -- it is NOT wired to
		 * an alp-rtc<N> alias.) */
		alp-counter0 = &rtc0;
	};
};

/* Enable the LPRTC node so the snps,dw-apb-rtc driver instantiates a device.
 * Okay'ing rtc0 is ALSO what the fork SoC layer keys its VBAT clock-gate on
 * (see the note above); on the alp-sdk upstream build that gate is bench-TBD. */
&rtc0 {
	status = "okay";
};
```

## src/main.c
```c
/*
 * Copyright (c) 2026 Alp Lab AB
 * SPDX-License-Identifier: Apache-2.0
 *
 * On-silicon LPRTC validation for the E1M-AEN801 (Alif Ensemble E8) over the
 * alp-sdk Tier-2 counter_dw_rtc driver (ADR 0017 Tier-2, "snps,dw-apb-rtc" -- a
 * Zephyr counter-class driver vendored from the Apache-2.0 zephyr_alif fork for
 * the always-on lprtc@42000000 DesignWare APB RTC).
 *
 * What it proves
 * --------------
 * Start the free-running 32-bit LPRTC counter through the PORTABLE Zephyr
 * counter_* class API and confirm the count actually ADVANCES on silicon, two
 * independent ways:
 *
 *   1. in-firmware:  this app reads counter_get_value() twice with a busy-wait
 *      between, prints both raw tick values + their delta + every API return
 *      code, and a single 'RESULT PASS:' / 'RESULT FAIL:' line.
 *   2. over J-Link:  the human reads the LPRTC CCVR register with mem32
 *      (0x42000000, see the overlay) across the same window -- the ground truth
 *      on silicon, independent of any printk.
 *
 * NOT a calendar RTC.  The DW-APB-RTC is a bare counter (CCVR free-running
 * up-count + one CMR compare).  It has NO date/time registers, so it does NOT
 * back the alp_rtc_* calendar surface; this regcheck exercises the COUNTER path
 * only.  Turning the LPRTC into an alp_rtc_* calendar source needs a
 * counter->calendar shim (software epoch-base in retained storage) that is NOT
 * authored yet -- see the README.
 *
 * BENCH NOTE -- tick rate: the node's clock-frequency is 32768 (the LF source
 * the VBAT domain feeds the LPRTC), transcribed from the fork e1.dtsi.  A wrong
 * clock-frequency would only mis-scale counter_us_to_ticks(); it does NOT change
 * whether the count advances, so this test (advance == PASS) is valid
 * regardless.
 *
 * BENCH NOTE -- clock gate: on the alp-sdk upstream-Zephyr build the VBAT
 * LPRTC clock-gate (VBAT_LPRTC0_CLK_EN, 0x1A609010) is enabled by no visible
 * code (the fork SoC layer does it; upstream soc.c does not; the driver does
 * not).  If CCVR never advances here, the gate is the likely cause -- see the
 * overlay / dtsi notes.  This is a documented blocker, not a code defect.
 *
 * Console is the RAM buffer 'ram_console_buf' (see prj.conf); the bench UART is
 * not wired to USB.  BENCH-VALIDATION app -- not a customer teaching example.
 */

#include <errno.h>
#include <zephyr/kernel.h>
#include <zephyr/device.h>
#include <zephyr/drivers/counter.h>

/* The counter device is the "snps,dw-apb-rtc" node (lprtc@42000000); the
 * counter_dw_rtc driver binds it directly. */
#define COUNTER_NODE DT_NODELABEL(rtc0)

/* Dwell between the two counter reads.  The LPRTC ticks at 32768 Hz, so ~100 ms
 * advances it by ~3277 ticks -- comfortably nonzero for an advance check, and
 * far from a 32-bit wrap (~36 hours at 32768 Hz). */
#define READ_GAP_US 100000U

static const struct device *const lprtc = DEVICE_DT_GET(COUNTER_NODE);

int main(void)
{
	int      rc;
	uint32_t freq, top, v1, v2, delta;

	printk("\n=== AEN801 LPRTC counter bench "
	       "(counter_dw_rtc / lprtc@42000000) ===\n");

	/* 1. device readiness.  If the counter node did not instantiate a device
	 *    the build would have failed at link (undefined __device_dts_ord_*),
	 *    so reaching here means the device object exists -- check it is ready. */
	if (!device_is_ready(lprtc)) {
		printk("RESULT FAIL: lprtc device not ready\n");
		return 0;
	}
	printk("lprtc device ready\n");

	/* 2. static parameters.  freq is the node clock-frequency (32768 Hz from
	 *    the e1.dtsi); top is the free-running 32-bit reload value
	 *    (expect 0xFFFFFFFF). */
	freq = counter_get_frequency(lprtc);
	top  = counter_get_top_value(lprtc);
	printk("counter_get_frequency() = %u Hz\n", freq);
	printk("counter_get_top_value() = 0x%08x\n", top);

	/* 3. start the free-running counter.  The LPRTC lives in the always-on VBAT
	 *    domain, so the SES typically leaves it already running -- counter_start
	 *    then returns -EALREADY, which is NOT a failure here (it directly answers
	 *    the open VBAT clock-gate question: the counter is already clocked, so no
	 *    VBAT_LPRTC0_CLK_EN write is needed on this build path).  Treat 0 and
	 *    -EALREADY as success and go on to the advance check. */
	rc = counter_start(lprtc);
	printk("counter_start() rc=%d%s\n",
	       rc,
	       (rc == -EALREADY) ? " (-EALREADY: LPRTC already running in VBAT domain)" : "");
	if (rc != 0 && rc != -EALREADY) {
		printk("RESULT FAIL: counter_start rc=%d\n", rc);
		return 0;
	}

	/* 4. first reading. */
	rc = counter_get_value(lprtc, &v1);
	printk("counter_get_value() #1 rc=%d  ticks=0x%08x (%u)\n", rc, v1, v1);
	if (rc != 0) {
		printk("RESULT FAIL: counter_get_value #1 rc=%d\n", rc);
		return 0;
	}

	/* --- J-Link readback window #1: mem32 0x42000000 (LPRTC CCVR) --- */

	/* 5. let the counter advance, then read again. */
	k_busy_wait(READ_GAP_US);

	rc = counter_get_value(lprtc, &v2);
	printk("counter_get_value() #2 rc=%d  ticks=0x%08x (%u)\n", rc, v2, v2);
	if (rc != 0) {
		printk("RESULT FAIL: counter_get_value #2 rc=%d\n", rc);
		return 0;
	}

	/* --- J-Link readback window #2: mem32 0x42000000 (LPRTC CCVR) --- */

	/* 6. verdict: a free-running up-counter must have advanced between the two
	 *    reads.  Use unsigned wrap so a (very unlikely) 32-bit wrap across the
	 *    ~100 ms gap still yields the true positive delta. */
	delta = v2 - v1;
	printk("delta (v2 - v1) = %u ticks over ~%u us\n", delta, READ_GAP_US);

	if (delta != 0U) {
		printk("RESULT PASS: lprtc counter advances "
		       "(v1=0x%08x v2=0x%08x delta=%u ticks over ~%u us)\n",
		       v1,
		       v2,
		       delta,
		       READ_GAP_US);
	} else {
		printk("RESULT FAIL: counter did not advance "
		       "(v1=0x%08x v2=0x%08x delta=0)  -- check the VBAT LPRTC "
		       "clock-gate (0x1A609010); see the overlay note\n",
		       v1,
		       v2);
	}

	/* Leave the counter running + park; CCVR stays live for the J-Link read. */
	return 0;
}
```
