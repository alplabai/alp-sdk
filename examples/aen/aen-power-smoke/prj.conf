## CMakeLists.txt
```
# SPDX-License-Identifier: Apache-2.0
#
# Stage-A low-power smoke for the E1M-AEN801 (Alif Ensemble E8, Cortex-M55-HE).
#
# Proves the CPU can enter and leave the architectural Cortex-M55 WFI sleep
# (a periodic k_timer wake + k_cpu_idle) and that the SysTick system clock keeps
# the kernel alive across the sleep -- a wake "beacon"/heartbeat in global SRAM0
# (0x02000000) advances between idles.  This is the WFI-equivalent baseline that
# the Stage-B board pm_state_set IWIC hook (suspend-to-idle / deep IWIC sleep)
# builds on once the Tier-1.5 PM plumbing (HAS_PM + power-states DT + WICCONTROL
# hook) lands.
#
# Stage-A is deliberately CONFIG_PM-FREE: pinned upstream Zephyr 4.4.0's Alif E8
# SoC does NOT `select HAS_PM` (only the alifsemi/zephyr_alif FORK does), so
# CONFIG_PM cannot be enabled over the pinned tree, and upstream provides no
# pm_state_set for the Alif SoC.  Stage-A therefore exercises only the
# arch-level WFI via the idle path + k_cpu_idle(), which needs no PM subsystem
# and builds today.
#
# Standalone Zephyr app (no alp_project.py board.yaml flow): build with
#   ZEPHYR_BASE=<zephyr-base> west build \
#     -b alp_e1m_aen801_m55_he/ae822fa0e5597ls0/rtss_he <this-dir> -- \
#     "-DEXTRA_ZEPHYR_MODULES=<alp-sdk>;<hal_alif>"
# Zephyr applies boards/<fully-qualified-board>.overlay by itself.

cmake_minimum_required(VERSION 3.20)

find_package(Zephyr REQUIRED HINTS $ENV{ZEPHYR_BASE})
project(aen_power_smoke LANGUAGES C)

target_sources(app PRIVATE src/main.c)
```

## prj.conf
```kconfig
# SPDX-License-Identifier: Apache-2.0
#
# Stage-A low-power smoke for the E1M-AEN801 (Alif Ensemble E8, M55-HE),
# bench RAM-run via J-Link.  Unlike the peripheral examples (which now default
# to the Alp UART console), the PM apps deliberately keep the RAM console:
# console output must survive the WFI/low-power path (a UART mid-idle can gate
# its clock and drop bytes), so it is retargeted to a RAM buffer the human reads
# over SWD (mem8 of the 'ram_console_buf' symbol) and ASCII-decodes.

# Tier-2 driver Kconfigs (incl. CONFIG_ARM_MHUV2 / CONFIG_HAS_ALIF_SE_SERVICES)
# are gated under ALP_SDK; without it zephyr/CMakeLists.txt never adds
# include/ to the app's include path, so the power_probe() call below
# (#1812/#1813, <alp/power.h>) fails with "no such file or directory".
# Precedent: examples/aen/aen-aipm-read/prj.conf.
CONFIG_ALP_SDK=y

# --- RAM console (read 'ram_console_buf' over SWD) ---------------------------
CONFIG_RAM_CONSOLE=y
CONFIG_RAM_CONSOLE_BUFFER_SIZE=4096
CONFIG_UART_CONSOLE=n
CONFIG_CONSOLE=y
CONFIG_SERIAL=n
CONFIG_PRINTK=y

# --- Stage-A is CONFIG_PM-FREE (intentional) ---------------------------------
# Pinned upstream Zephyr 4.4.0's Alif E8 SoC does NOT `select HAS_PM`
# (zephyr/soc/alif has no HAS_PM and ships no power.c/pm_state_set; only the
# alifsemi/zephyr_alif fork's soc/alif/ensemble/Kconfig selects it, lines 28/50).
# So CONFIG_PM (zephyr/subsys/pm/Kconfig:23 `depends on SYS_CLOCK_EXISTS &&
# HAS_PM`) is unreachable over the pinned tree, and upstream ships no Alif
# pm_state_set.  Stage-A therefore proves WFI via the kernel idle path only:
# main blocks on a periodic k_timer's semaphore -> the idle thread runs __WFI()
# with NO PM subsystem, and SysTick wakes it (it also takes one explicit
# k_cpu_idle() per round).  Do NOT set CONFIG_PM here: it would either be
# silently dropped (HAS_PM unset) or, if forced, fail to link (undefined
# pm_state_set).  Enabling it is the Stage-B work item.
# CONFIG_PM is intentionally left UNSET.

# SysTick is the M55 system clock (CONFIG_CORTEX_M_SYSTICK default y); it is the
# wake source for the WFI below.  SysTick is architectural exception #15, NOT an
# NVIC IRQ, so it is unaffected by the EWIC/IWIC "interrupts 0-63 only" wake
# range -- it always wakes a plain WFI.  Tickless is fine; the kernel reprograms
# SysTick to the next timeout before idling, so the wake k_timer still fires.
CONFIG_TICKLESS_KERNEL=y

# E8 D-cache maintenance loop hangs on this silicon (shared bench rule); and
# the SRAM0 liveness beacon (see src/main.c) must be coherent with the host
# read over the system bus, so keep the D-cache off (a cached beacon write
# could sit in the core's D-cache, unseen by the AXI-AP read).
CONFIG_DCACHE=n

# Keep the image small + deterministic for a RAM-run.  LOG MUST stay off --
# CONFIG_LOG=y reroutes printk into the logging subsystem, which has no
# RAM-console backend, so the RESULT line never reaches 'ram_console_buf'.
CONFIG_LOG=n
```

## boards/alp_e1m_aen801_m55_he.overlay
```dts
/*
 * Copyright (c) 2026 Alp Lab AB
 * SPDX-License-Identifier: Apache-2.0
 *
 * Stage-A low-power smoke overlay for the E1M-AEN801 (Alif Ensemble E8,
 * M55-HE), bench RAM-run via J-Link.  No peripheral nodes are needed -- the
 * smoke uses only the architectural SysTick (system clock) as both timekeeper
 * and WFI wake source, plus a global-SRAM0 beacon written by absolute address
 * (0x02000000), so the only job of this overlay is the standard bench RAM-run
 * retarget (run from ITCM, drop the MCUboot code-partition fixup), matching the
 * sibling aen-*-regcheck apps.
 */

/ {
	chosen {
		/* PATH-REFERENCE form (&itcm), NOT the <&itcm> phandle-array form:
		 * the phandle-array form yields CONFIG_FLASH_SIZE=0 and the image
		 * overflows the (empty) FLASH region at link time. */
		zephyr,flash = &itcm;
		/delete-property/ zephyr,code-partition;
	};
};
```

## boards/alp_e1m_aen803_m55_he_ae822fa0e5597ls0_rtss_he.overlay
```dts
/*
 * Copyright (c) 2026 Alp Lab AB
 * SPDX-License-Identifier: Apache-2.0
 *
 * Stage-A low-power smoke overlay for the E1M-AEN803 (Alif Ensemble E8,
 * M55-HE), bench RAM-run via J-Link.  No peripheral nodes are needed -- the
 * smoke uses only the architectural SysTick (system clock) as both timekeeper
 * and WFI wake source, plus a global-SRAM0 beacon written by absolute address
 * (0x02000000), so the only job of this overlay is the standard bench RAM-run
 * retarget (run from ITCM, drop the MCUboot code-partition fixup), matching the
 * sibling aen-*-regcheck apps.
 */

/ {
	chosen {
		/* PATH-REFERENCE form (&itcm), NOT the <&itcm> phandle-array form:
		 * the phandle-array form yields CONFIG_FLASH_SIZE=0 and the image
		 * overflows the (empty) FLASH region at link time. */
		zephyr,flash = &itcm;
		/delete-property/ zephyr,code-partition;
	};
};
```

## src/main.c
```c
/*
 * Copyright (c) 2026 Alp Lab AB
 * SPDX-License-Identifier: Apache-2.0
 *
 * Stage-A low-power smoke for the E1M-AEN801 (Alif Ensemble E8, Cortex-M55-HE).
 *
 * What it proves
 * --------------
 * The CPU can enter the architectural Cortex-M55 WFI sleep and be woken again
 * by the SysTick system clock, with the kernel surviving the round trip:
 *   1. device boots, the RAM console comes up;
 *   2. a periodic k_timer is the cadence/wake source -- each round the app waits
 *      on the timer's semaphore (the thread blocks -> the idle thread runs WFI),
 *      then takes one extra explicit architectural WFI via k_cpu_idle();
 *   3. between idles a "beacon" / heartbeat advances in global SRAM0 and
 *      k_uptime_get() moves forward -- i.e. we really slept and really woke,
 *      repeatedly;
 * reported with a single 'RESULT PASS:' / 'RESULT FAIL:' line.
 *
 * The wake "beacon" lives in global SRAM0 at 0x02000000 (same scheme as the
 * sibling aen-hp-core-smoke): always-on on-chip SRAM at the same address from
 * every master, so the host can read it over the system AXI-AP -- mem32 of
 * 0x02000000 -- as an AP-agnostic witness alongside the console RESULT line:
 *
 *   SRAM0[0] = 0xA11FE000  magic ("ALIVE")
 *   SRAM0[1] = SCB.CPUID         (0x411FD220 = Cortex-M55)
 *   SRAM0[2] = completed sleep/wake rounds (heartbeat; ADVANCES => core woke)
 *   SRAM0[3] = final RESULT code (1 = PASS, 2 = FAIL; 0 = not finished)
 *
 * Why WFI + a k_timer wake, and NOT CONFIG_PM here
 * ------------------------------------------------
 * Pinned upstream Zephyr 4.4.0's Alif E8 SoC does NOT `select HAS_PM`
 * (zephyr/soc/alif has no HAS_PM selection and ships no power.c / pm_state_set;
 * only the alifsemi/zephyr_alif FORK's soc/alif/ensemble/Kconfig does --
 * `select HAS_PM` at lines 28 and 50).  So CONFIG_PM
 * (zephyr/subsys/pm/Kconfig: `config PM ... depends on SYS_CLOCK_EXISTS &&
 * HAS_PM`, line 23) is UNREACHABLE over the pinned tree, AND upstream provides
 * no Alif pm_state_set() to link against (upstream subsys/pm/pm.c calls
 * pm_state_set() directly with no weak Alif fallback).  Forcing CONFIG_PM would
 * therefore either be silently dropped (HAS_PM unset) or fail to link.
 *
 * Stage-A therefore exercises the genuine WFI-equivalent baseline: a periodic
 * k_timer beats the wake cadence and the kernel's idle path lowers an idle CPU
 * to __WFI() with NO PM subsystem; SysTick wakes it.  This is the exact arch
 * entry that the Stage-B IWIC pm_state_set path wraps.
 *
 * SysTick as the wake source
 * --------------------------
 * CONFIG_CORTEX_M_SYSTICK is `default y` for the M55 (CPU_CORTEX_M55 selects
 * CPU_CORTEX_M_HAS_SYSTICK), and the upstream HE devicetree provides the
 * `arm,armv8.1m-systick` node (timer@e000e010 via arm/armv8.1-m.dtsi).  SysTick
 * is architectural EXCEPTION #15, NOT an NVIC IRQ -- so it is wholly unaffected
 * by the EWIC/IWIC "interrupts 0-63 only" deep-sleep wake range (fork
 * soc/alif/common/rtss/power.c:215-217, 287-291) and always wakes a plain WFI.
 * That is exactly why it is the right Stage-A wake: no peripheral, no IRQ-number
 * constraint, no PM dependency.
 *
 * Stage-B (NOT in this app -- documented for the bench)
 * -----------------------------------------------------
 * The deeper Alif sleeps (suspend-to-idle = deep IWIC sleep, suspend-to-ram,
 * soft-off) are driven by a board/SoC pm_state_set() that programs the WakeUp
 * Interrupt Controller via the AON WICCONTROL register.  For the RTSS-HE core
 * that register is AON_RTSS_HE_CTRL:
 *
 *     AON_BASE          = 0x1A604000          (fork soc_common.h:15)
 *     AON_RTSS_HE_CTRL  = AON_BASE + 0x10
 *                       = 0x1A604010          (fork soc_common.h:18)
 *     WICCONTROL (HE)   = AON_RTSS_HE_CTRL     (fork rtss/power.c:27-28)
 *                       => 0x1A604010
 *  (the RTSS-HP core would use AON_RTSS_HP_CTRL = AON_BASE + 0x0 = 0x1A604000,
 *   fork soc_common.h:16 / power.c:25-26.)
 *
 * with bit8 = WIC enable (WICCONTROL_WIC_Pos, fork power.c:45) and bit9 =
 * IWIC-vs-EWIC select (WICCONTROL_IWIC_Pos, fork power.c:50; IWIC=1, EWIC=0,
 * power.c:40-41).  Bringing that up over the pinned tree is a separate Tier-1.5
 * task: add `select HAS_PM`, the `power-states`/`cpu-power-states` DT nodes
 * (fork ensemble_rtss_he.dtsi:153-197: &suspend_idle &standby_s2ram &stop_s2ram
 * &subsys_off, all status=disabled by default), and the pm_state_set IWIC hook
 * (fork power.c:432).  See this front's report for the full node list.
 *
 * Portable <alp/power.h> probe (issues #1812 / #1813)
 * ----------------------------------------------------
 * AFTER the WFI/SysTick proof below has already printed its own
 * RESULT line, main() also runs the exact repro from #1812:
 * alp_power_open() + alp_power_configure_wake_source() + (when that
 * succeeds) alp_power_request_sleep() -- the portable API a customer
 * would actually reach for, which no AEN example called before this.
 * Deliberately LAST: once a real alif_aipm backend lands (#1812's
 * "Proposed resolution"), a successful DEEP_SLEEP request here means
 * the SE reboots the core, so anything after this call would never
 * run -- running the probe first would cost the WFI proof its own
 * RESULT line.  With CONFIG_PM unset (this file's whole reason for
 * existing, above), src/backends/power/zephyr_pm_policy.c never
 * compiles in -- its Kconfig depends on PM -- so the wildcard
 * src/backends/power/zephyr_stub.c wins backend selection at priority
 * 0.  As of #1813 that stub is HONEST about what it can't do:
 * alp_power_wake_capabilities() reports zero armable wake sources,
 * and alp_power_configure_wake_source() refuses a real bitmap right
 * there, at configuration time, instead of accepting it and only
 * failing later at alp_power_request_sleep() (the #1812 bug).  This
 * is a teaching moment as much as the WFI proof: check the
 * capability, check the return, and fall back to a baseline you know
 * works (the arch-level WFI loop above) rather than trusting a
 * portable call that silently did nothing.  It logs but never gates
 * PASS/FAIL -- the beacon/heartbeat contract above is unchanged.
 *
 * Console is the RAM buffer 'ram_console_buf' (see prj.conf); the bench app
 * UART is not wired to USB.  BENCH-VALIDATION app -- not a customer teaching
 * example.
 */

#include <zephyr/kernel.h>

#include <alp/power.h>

/* Cortex-M System Control Block CPUID, by absolute address (no CMSIS header). */
#define SCB_CPUID (*(volatile uint32_t *)0xE000ED00U)

/* Global SRAM0 liveness beacon (always-on on-chip SRAM, master-agnostic addr).
 * Read mem32 of 0x02000000 over the system AXI-AP. */
#define SRAM0_BEACON ((volatile uint32_t *)0x02000000U)
#define BEACON_MAGIC 0xA11FE000U /* "ALIVE" */

/* Beacon RESULT codes (SRAM0[3]). */
#define RESULT_NONE 0U
#define RESULT_PASS 1U
#define RESULT_FAIL 2U

/* Number of sleep/wake rounds to take, and the wake-timer period. */
#define IDLE_ROUNDS  8U
#define WAKE_TICK_MS 50U

/*
 * The k_timer is the wake cadence.  Its expiry handler gives a semaphore; main
 * blocks on that semaphore, so the idle thread runs and lowers the CPU into WFI
 * until the next SysTick-driven timer expiry releases main.  This is the
 * portable stand-in for the Stage-B "wake on the configured WIC source": here
 * the SysTick-backed kernel timer is the source.
 */
static K_SEM_DEFINE(wake_sem, 0, 1);

static void wake_timer_fn(struct k_timer *t)
{
	ARG_UNUSED(t);
	k_sem_give(&wake_sem);
}

/* Periodic wake source: expiry gives wake_sem (see wake_timer_fn). */
static K_TIMER_DEFINE(wake_timer, wake_timer_fn, NULL);

/*
 * Run the portable <alp/power.h> repro from #1812 and log what happened.
 * Informational only -- never touches the beacon or PASS/FAIL result; see
 * the file-header section above for why this exists on Stage-A specifically.
 */
static void power_probe(void)
{
	alp_power_t *pm = alp_power_open();

	if (pm == NULL) {
		printk("power: alp_power_open() failed (unexpected -- the "
		       "wildcard stub backend always hands back a handle)\n");
		return;
	}

	uint32_t wake_caps = alp_power_wake_capabilities(pm);

	printk("power: alp_power_wake_capabilities()=0x%08x (armable "
	       "ALP_POWER_WAKE_* bits; 0 == none on this CONFIG_PM-free "
	       "build)\n",
	       wake_caps);

	alp_status_t cfg_rc = alp_power_configure_wake_source(pm, ALP_POWER_WAKE_RTC);

	if (cfg_rc != ALP_OK) {
		/* Expected on this build: the stub can arm nothing, so it
		 * refuses the bitmap right here instead of lying (#1813). */
		printk("power: alp_power_configure_wake_source(RTC) -> %d "
		       "(ALP_ERR_NOSUPPORT expected -- no real PM backend "
		       "links without CONFIG_PM)\n",
		       (int)cfg_rc);
		alp_power_close(pm);
		return;
	}

	/* Only reachable once a real AEN power backend is linked (#1812's
	 * "Proposed resolution") -- exercise the full sleep round-trip. */
	alp_power_wake_info_t info = { 0 };
	alp_status_t          sleep_rc =
	    alp_power_request_sleep(pm, ALP_POWER_MODE_DEEP_SLEEP, WAKE_TICK_MS, &info);

	printk("power: alp_power_request_sleep(DEEP_SLEEP) -> %d "
	       "(realised_mode=%d wake_source=0x%x slept_ms=%u)\n",
	       (int)sleep_rc,
	       (int)info.realised_mode,
	       info.wake_source,
	       info.slept_ms);
	alp_power_close(pm);
}

int main(void)
{
	uint32_t cpuid = SCB_CPUID;
	int64_t  t_start, t_now, t_prev;
	uint32_t advanced = 0U;

	/* Seed the beacon immediately so even a one-shot read after boot proves
	 * main() was reached, before any sleeping. */
	SRAM0_BEACON[0] = BEACON_MAGIC;
	SRAM0_BEACON[1] = cpuid;
	SRAM0_BEACON[2] = 0U;
	SRAM0_BEACON[3] = RESULT_NONE;

	printk("\n=== AEN801 Stage-A low-power smoke "
	       "(k_timer wake -> WFI, SysTick) ===\n");

	t_start = k_uptime_get();
	t_prev  = t_start;
	printk("boot uptime=%lld ms; CPUID=0x%08x; taking %u WFI sleeps "
	       "(~%u ms each)\n",
	       t_start,
	       cpuid,
	       IDLE_ROUNDS,
	       WAKE_TICK_MS);

	/* Drive the wake cadence with a periodic k_timer (the brief's k_timer
	 * wake). The first expiry is one period out; it then repeats. */
	k_timer_start(&wake_timer, K_MSEC(WAKE_TICK_MS), K_MSEC(WAKE_TICK_MS));

	for (uint32_t i = 0U; i < IDLE_ROUNDS; i++) {
		/*
		 * Block on the timer's semaphore: main de-schedules, the kernel
		 * idle thread runs WFI, and the SysTick-backed k_timer expiry
		 * wakes the core and releases us.  Then take one EXPLICIT
		 * architectural WFI via k_cpu_idle() for good measure -- with a
		 * live SysTick it returns on the next tick, proving the core
		 * parks in WFI and the SysTick exception brings it back.  This
		 * explicit k_cpu_idle() is the exact arch entry the Stage-B IWIC
		 * path wraps.
		 */
		k_sem_take(&wake_sem, K_FOREVER);
		k_cpu_idle();

		t_now = k_uptime_get();
		if (t_now > t_prev) {
			advanced++;
		}
		t_prev = t_now;

		/* Heartbeat: completed rounds, in SRAM0 -- advances => woke. */
		SRAM0_BEACON[2] = i + 1U;

		printk("round %u/%u: woke, beacon=%u uptime=%lld ms\n",
		       i + 1U,
		       IDLE_ROUNDS,
		       (uint32_t)SRAM0_BEACON[2],
		       t_now);
	}

	k_timer_stop(&wake_timer);
	t_now = k_uptime_get();

	if (SRAM0_BEACON[2] != IDLE_ROUNDS) {
		SRAM0_BEACON[3] = RESULT_FAIL;
		printk("RESULT FAIL: beacon=%u expected %u (a round did not "
		       "complete)\n",
		       (uint32_t)SRAM0_BEACON[2],
		       IDLE_ROUNDS);
		return 0;
	}
	if (advanced != IDLE_ROUNDS) {
		SRAM0_BEACON[3] = RESULT_FAIL;
		printk("RESULT FAIL: uptime advanced on only %u/%u rounds "
		       "(SysTick not waking?)\n",
		       advanced,
		       IDLE_ROUNDS);
		return 0;
	}

	SRAM0_BEACON[3] = RESULT_PASS;
	printk("RESULT PASS: %u WFI sleeps entered + woken by SysTick; "
	       "uptime %lld->%lld ms (beacon=%u)\n",
	       IDLE_ROUNDS,
	       t_start,
	       t_now,
	       (uint32_t)SRAM0_BEACON[2]);

	/* Runs AFTER the WFI/SysTick proof + its RESULT line has already
	 * printed and the beacon is final -- not before it.  Once a real
	 * alif_aipm backend lands (#1812's "Proposed resolution"),
	 * alp_power_request_sleep(DEEP_SLEEP) succeeding here means the SE
	 * has actually rebooted the core, which would make everything
	 * below this call unreachable; probing first would have cost the
	 * WFI proof its own RESULT line. */
	power_probe();

	return 0;
}
```
