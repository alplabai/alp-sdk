/*
 * Copyright (c) 2026 Alp Lab AB
 * SPDX-License-Identifier: Apache-2.0
 *
 * aen-npu-inference-alif -- MATCHED-RUNTIME on-silicon FULL NPU inference on the
 * E1M-AEN801 (Ensemble E8, M55-HE).  A Vela-compiled int8 model (compiled with
 * the ALIF system-config Ethos_U85_SRAM_Only) runs through the Arm Apache-2.0
 * InferenceProcess wrapper (lib/ethosu_utils -- the SAME runtime Alif's
 * tflm_ethosu / executorch samples use), which drives TFLM's MicroInterpreter
 * with AddEthosU() so the fused subgraph dispatches onto the Ethos-U85
 * (256-MAC) via ethosu_invoke.
 *
 * WHY THIS RUNS WHERE aen-npu-inference RETURNED ethosu_invoke=1:
 *   The Arm Ethos-U core driver's weak ethosu_address_remap()/
 *   ethosu_config_select() defaults leave ITCM/DTCM addresses untranslated and
 *   route the command stream + regions to the EXT AXI port -- wrong for this
 *   board's all-in-SRAM0 layout (bus-aborts on the first NPU fetch).  The fix
 *   is alp-sdk's AEN Ethos-U backend (src/backends/inference/ethos_u_aen.cpp),
 *   which supplies the STRONG overrides; CONFIG_ALP_SDK_INFERENCE_BACKEND_
 *   ETHOS_U_AEN=y (prj.conf) links it in -- see that file for the full
 *   explanation of both overrides, moved there from this file's previous
 *   in-app copies (measured 2026-07-28: the Vela --memory-mode flag alone is
 *   NOT the fix -- a byte-identical command stream to this app's sibling still
 *   returned ethosu_invoke=1 without the address-remap/config-select overrides).
 *
 * WHAT THIS PROVES (and what it does NOT):
 *   It proves the full matched path: a Vela-compiled .tflite ->
 *   InferenceProcess::runJob -> tflite::GetModel() -> MicroMutableOpResolver
 *   with AddEthosU() -> MicroInterpreter::Invoke() -> ethosu_invoke -> the NPU.
 *   A runJob()==false (success) + a populated output tensor is the "real
 *   inference ran on the NPU" evidence.
 *
 *   It does NOT validate model *accuracy* -- the embedded model is the in-tree
 *   FIXTURE tiny_int8.tflite (Vela: 1 NPU op, 100% NPU, 8 MACs), chosen so the
 *   bench app is hermetic and small.  A real-model end-to-end is the documented
 *   follow-up: rebuild with -DAEN_NPU_MODEL=<real.tflite>; the RESULT contract
 *   is model-agnostic.
 *
 * HOW WE OBSERVE (mirrors the regcheck dual-path):
 *   1. main() prints one RESULT PASS/FAIL line to the RAM console (read
 *      'ram_console_buf' over J-Link mem8, ASCII-decode).
 *   2. The same evidence is latched into file-scope volatile globals so it is
 *      readable by symbol over SWD even if the console were not captured.
 *
 * DMA placement: the model + arena live in SRAM0 (global on-chip SRAM
 * @0x02000000), NOT the M55-HE DTCM, because the NPU DMA cannot reach DTCM.
 * Combined with CONFIG_DCACHE=n, the CPU and NPU share a coherent view.  See
 * the overlay + gen_model.py.
 */

#include <cstdint>
#include <cstring>
#include <string>
#include <vector>

#include <zephyr/kernel.h>
#include <zephyr/device.h>
#include <zephyr/devicetree.h>
#include <zephyr/sys/printk.h>

/* Arm Apache-2.0 InferenceProcess wrapper (vendored: ethosu_utils/). */
#include "inference_process.hpp"

/* Generated by gen_model.py: networkModelData[] (rodata), NETWORK_MODEL_LEN,
 * NETWORK_MODEL_NAME, TENSOR_ARENA_SIZE, and the SRAM0 placement macros. */
#include "model.h"

using namespace InferenceProcess;

/* The Ethos-U node added by boards/alp_e1m_aen801_m55_he_ae822fa0e5597ls0_rtss_he.overlay. */
#define NPU_NODE DT_NODELABEL(ethosu_npu)

/*
 * The strong ethosu_address_remap()/ethosu_config_select() overrides that
 * make ethosu_invoke succeed on this board (NPU AXI address translation +
 * SRAM-port MEM_ATTR routing) used to live here.  They are now owned by
 * alp-sdk's AEN Ethos-U backend -- see src/backends/inference/ethos_u_aen.cpp
 * for the full explanation (WEAK-default behaviour, why it is wrong for an
 * all-in-SRAM0 layout, the bench-confirmed fault signature) and
 * CONFIG_ALP_SDK_INFERENCE_BACKEND_ETHOS_U_AEN in this app's prj.conf for how
 * they get linked into a build that never calls <alp/inference.h>.
 */

/*
 * Tensor arena -- DMA-reachable SRAM0, 16-byte aligned (NPU access
 * granularity).  TENSOR_ARENA_ATTR = __aligned(16) section("SRAM0").  This is
 * the working memory the MicroInterpreter (inside InferenceProcess) hands to
 * both the CPU reference kernels and the Ethos-U op; it MUST be NPU-reachable.
 */
TENSOR_ARENA_ATTR static uint8_t tensor_arena[TENSOR_ARENA_SIZE];

/*
 * DMA-reachable copy of the model.  networkModelData[] is const rodata
 * (initialized, in ITCM/flash); the Ethos-U reads the fused command stream +
 * weights out of the model via its own AXI master, so the bytes it executes
 * MUST live in NPU-reachable SRAM0.  An *initialized* array placed directly in
 * the SRAM0 custom section is NOT init-copied by Zephyr -> garbage -> bus
 * fault.  So keep the model in rodata and memcpy it into this uninitialized
 * SRAM0 buffer at startup.
 */
static uint8_t model_sram[NETWORK_MODEL_LEN] __aligned(NPU_ALIGN) __attribute__((section("SRAM0")));

/* Output capture buffer (SRAM0 -- the NPU writes the output tensor via DMA). */
static uint8_t output_sram[256] __aligned(NPU_ALIGN) __attribute__((section("SRAM0")));

/*
 * Latched evidence, readable by symbol over SWD independent of the RAM-console
 * decode.  volatile so the stores are not optimised away.
 */
volatile int      g_runjob_failed = -1;    /* runJob() return (false == OK)    */
volatile uint32_t g_in_bytes      = 0;     /* input tensor size in bytes       */
volatile uint32_t g_out_bytes     = 0;     /* output tensor size in bytes      */
volatile uint8_t  g_out_first[16] = { 0 }; /* first output bytes (raw int8)    */
volatile int      g_argmax        = -1;    /* argmax over the output bytes     */

int main(void)
{
	printk("\n=== aen-npu-inference-alif (matched runtime) ===\n");
	printk("model      : %s (%u bytes)\n", NETWORK_MODEL_NAME, (unsigned)NETWORK_MODEL_LEN);
	printk(
	    "arena      : %u bytes @ SRAM0 (%p)\n", (unsigned)TENSOR_ARENA_SIZE, (void *)tensor_arena);

	/*
	 * The Arm Ethos-U core driver auto-instantiates the NPU device at
	 * POST_KERNEL (the arm,ethos-u node is status="okay").  Reaching main()
	 * with device_is_ready()==1 means ethosu_init() (incl. the NPU soft reset)
	 * completed -- a prerequisite for ethosu_invoke to succeed.
	 */
	const struct device *npu       = DEVICE_DT_GET(NPU_NODE);
	bool                 npu_ready = device_is_ready(npu);
	printk(
	    "npu ready  : %d (Ethos-U85 @0x%08x)\n", (int)npu_ready, (unsigned)DT_REG_ADDR(NPU_NODE));

	/* Stage the model into DMA-reachable SRAM0 (see model_sram comment). */
	memcpy(model_sram, networkModelData, NETWORK_MODEL_LEN);

	/*
	 * Build the inference job.  InferenceProcess::runJob strictly validates
	 * input DataPtr.size == the network's input-tensor byte count, so the input
	 * size must match the model exactly.  The hermetic fixture tiny_int8 is a
	 * FULLY_CONNECTED with input shape [1,4] int8 = 4 bytes (output [1,2] int8 =
	 * 2 bytes); AEN_NPU_INPUT_BYTES defaults to that.  When a larger real model
	 * is swapped in via -DAEN_NPU_MODEL, set -DAEN_NPU_INPUT_BYTES to its input
	 * size -- a mismatch surfaces as RESULT FAIL with the network's expected
	 * size printed by runJob, so the operator re-tunes in one shot.  We stage a
	 * 4 KiB zeroed SRAM0 input region (DMA-reachable) and hand runJob a DataPtr
	 * of the exact input size; the extra staging headroom is harmless.
	 */
	static uint8_t input_sram[4096] __aligned(NPU_ALIGN) __attribute__((section("SRAM0")));
	memset(input_sram, 0, sizeof(input_sram));

#ifndef AEN_NPU_INPUT_BYTES
#define AEN_NPU_INPUT_BYTES 4 /* tiny_int8 fixture: input [1,4] int8 */
#endif
	const size_t input_bytes = AEN_NPU_INPUT_BYTES;

	g_in_bytes = (uint32_t)input_bytes;
	printk("input      : %u bytes (zero-filled, SRAM0)\n", (unsigned)input_bytes);

	InferenceJob job(std::string(NETWORK_MODEL_NAME),
	                 DataPtr((void *)model_sram, NETWORK_MODEL_LEN),
	                 { DataPtr((void *)input_sram, input_bytes) },
	                 { DataPtr((void *)output_sram, sizeof(output_sram)) },
	                 {});

	/*
	 * Run inference via the matched Arm InferenceProcess.  Internally:
	 *   GetModel -> MicroMutableOpResolver<1>::AddEthosU ->
	 *   MicroInterpreter(arena) -> AllocateTensors -> copy input ->
	 *   Invoke() (the fused Ethos-U op -> ethosu_invoke -> NPU IRQ) ->
	 *   copyOutput into the output DataPtr.
	 * runJob returns FALSE on success, TRUE on any failure.
	 */
	InferenceProcess::InferenceProcess inference(tensor_arena, TENSOR_ARENA_SIZE);
	bool                               failed = inference.runJob(job);
	g_runjob_failed                           = (int)failed;

	if (failed) {
		printk("RESULT FAIL: runJob failed (schema/alloc/invoke/size) "
		       "npu_ready=%d -- see log above for the exact stage\n",
		       (int)npu_ready);
		return 0;
	}

	/*
	 * runJob updated job.output[0].size to the actual output byte count and
	 * copied the NPU's output into output_sram.  Latch the first bytes +
	 * argmax for the RESULT line and the SWD symbol read.
	 */
	uint32_t out_bytes = (uint32_t)job.output[0].size;
	g_out_bytes        = out_bytes;

	uint32_t n           = out_bytes < 16u ? out_bytes : 16u;
	int      best_i      = -1;
	int      best_v      = -128; /* int8 floor */
	bool     any_nonzero = false;
	for (uint32_t i = 0; i < out_bytes; i++) {
		int8_t v = (int8_t)output_sram[i];
		if (i < n) {
			g_out_first[i] = (uint8_t)v;
		}
		if (v != 0) {
			any_nonzero = true;
		}
		if (v > best_v) {
			best_v = v;
			best_i = (int)i;
		}
	}
	g_argmax = best_i;

	printk("output     : %u bytes, argmax=%d (val=%d), first[0..%u]=",
	       (unsigned)out_bytes,
	       best_i,
	       best_v,
	       (unsigned)(n ? n - 1 : 0));
	for (uint32_t i = 0; i < n; i++) {
		printk("%02x ", g_out_first[i]);
	}
	printk("\n");

	/*
	 * PASS = inference completed AND the NPU actually produced a result.
	 * any_nonzero guards the silent-failure case (an all-zero output despite a
	 * runJob success would mean the NPU did not really write the tensor).
	 */
	bool ok = (!failed) && (out_bytes > 0) && any_nonzero;
	if (ok) {
		printk("RESULT PASS: NPU inference complete -- model=%s runJob=OK "
		       "out_bytes=%u argmax=%d npu_ready=%d\n",
		       NETWORK_MODEL_NAME,
		       (unsigned)out_bytes,
		       best_i,
		       (int)npu_ready);
	} else {
		printk("RESULT FAIL: runJob_failed=%d out_bytes=%u nonzero=%d "
		       "npu_ready=%d -- output not populated\n",
		       (int)failed,
		       (unsigned)out_bytes,
		       (int)any_nonzero,
		       (int)npu_ready);
	}

	return 0;
}
