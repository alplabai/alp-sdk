## examples/aen/aen-secure-element-sign/testcase.yaml
```yaml
# SPDX-License-Identifier: Apache-2.0

sample:
  name: aen-secure-element-sign
  description: |
    Probe the OPTIGA Trust M secure element on the E1M-AEN
    (Alif Ensemble) SoM via the SoM-portable <alp/*> API, over
    the on-module BRD_I2C (SoC I2C0) wired in the M55-HE board file.
    The current driver exposes product-info/raw-APDU as NOSUPPORT stubs.

tests:
  alp_sdk.examples.aen.secure_element_sign.native_sim:
    platform_allow:
      - native_sim/native/64
    tags:
      - alp-sdk
      - example
      - aen
      - security
      - optiga
    build_only: true
```

## examples/aen/aen-trace-runner/hp_vision/boards/shields/tr_hp_csi_complete/Kconfig.shield
```kconfig
# Copyright (c) 2026 Alp Lab AB
# SPDX-License-Identifier: Apache-2.0
config SHIELD_TR_HP_CSI_COMPLETE
	def_bool $(shields_list_contains,tr_hp_csi_complete)
```

## examples/connectivity/firmware-update-log/testcase.yaml
```yaml
# SPDX-License-Identifier: Apache-2.0
sample:
  name: firmware-update-log
  description: |
    Portable tamper-evident firmware-update audit log via
    <alp/update_log.h>. Native_sim exercises the software tier; TF-M
    builds report HW_ENFORCED only when a secure owner is present.
tests:
  alp_sdk.examples.connectivity.firmware_update_log.native_sim:
    platform_allow:
      - native_sim/native/64
    tags:
      - alp-sdk
      - example
      - update_log
      - security
    harness: console
    harness_config:
      type: one_line
      regex:
        - "verify: OK"
  alp_sdk.examples.connectivity.firmware_update_log.require_hw.native_sim:
    platform_allow:
      - native_sim/native/64
    extra_configs:
      - CONFIG_ALP_SDK_UPDATE_LOG_REQUIRE_HW_ENFORCED=y
    tags:
      - alp-sdk
      - example
      - update_log
      - security
    harness: console
    harness_config:
      type: one_line
      regex:
        - "HW_ENFORCED required, but no secure owner/firewall-backed backend is active"

  alp_sdk.examples.connectivity.firmware_update_log.he_client.aen:
    platform_allow:
      - alp_e1m_aen801_m55_he/ae822fa0e5597ls0/rtss_he
    tags:
      - alp-sdk
      - example
      - aen
      - update_log
      - security
      - rtss-he
    build_only: true   # HW_ENFORCED needs the SE/device firewall; proven on the bench, not CI.

  alp_sdk.examples.connectivity.firmware_update_log.hp_owner.aen:
    platform_allow:
      - alp_e1m_aen801_m55_hp/ae822fa0e5597ls0/rtss_hp
    tags:
      - alp-sdk
      - example
      - aen
      - update_log
      - security
      - rtss-hp
    build_only: true   # HW_ENFORCED needs the SE/device firewall; proven on the bench, not CI.

  alp_sdk.examples.connectivity.firmware_update_log.he_client.firewall_probe.aen:
    platform_allow:
      - alp_e1m_aen801_m55_he/ae822fa0e5597ls0/rtss_he
    extra_args: EXTRA_CONF_FILE=boards/alp_e1m_aen801_m55_he_firewall_probe.conf
    tags:
      - alp-sdk
      - example
      - aen
      - update_log
      - security
      - rtss-he
    # scripts/bench/aen/flash-update-log-firewall-probe.sh requires this
    # exact profile (CONFIG_ALP_SDK_UPDATE_LOG_AEN_M55_FIREWALL_PROBE=y);
    # the he_client.aen scenario above never builds it, so a config-only
    # regression here was invisible to CI. Build-only: the probe itself is
    # a negative bench proof, not a CI-console assertion.
    build_only: true
```
