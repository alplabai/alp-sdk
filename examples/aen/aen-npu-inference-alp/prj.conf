## CMakeLists.txt
```
# Copyright (c) 2026 Alp Lab AB
# SPDX-License-Identifier: Apache-2.0
#
# aen-npu-inference-alp -- the real person_detect MobileNet on the E1M-AEN801
# (Ensemble E8) Ethos-U85, driven through the portable <alp/inference.h> API
# (alp_inference_open/invoke/get_output).  Unlike the sibling
# aen-npu-inference-person-mram (raw Arm InferenceProcess + in-app strong
# overrides), the app here writes ONLY the portable API: the AEN Ethos-U backend
# (src/backends/inference/ethos_u_aen.cpp) supplies the NPU AXI address-remap +
# SRAM-port config-select overrides.  ~263 KiB Vela model -> MRAM slot0, Flow D.
#
# LICENSING: a bench-matching Vela command stream needs Alif's PROPRIETARY
# ensemble_vela.ini (in alp-sdk-internal, NOT redistributed by alp-sdk); pass it
# with -DAEN_NPU_VELA_CONFIG=<internal>/ensemble_vela.ini.  Without it Vela uses
# its built-in system-config (a build-only check; the emitted command stream
# will NOT match the bench-validated E8 runtime).

cmake_minimum_required(VERSION 3.20.0)

find_package(Zephyr REQUIRED HINTS $ENV{ZEPHYR_BASE})
project(aen_npu_inference_alp LANGUAGES C CXX)

# --------------------------------------------------------------------------
# Model-gen: Vela-compile person_detect for the U85 (same as the raw sibling).
# --------------------------------------------------------------------------
set(AEN_NPU_VELA   "vela"
    CACHE FILEPATH "Vela compiler (on PATH, or override: -DAEN_NPU_VELA=<venv>/bin/vela)")
set(AEN_NPU_ACCEL  "ethos-u85-256"
    CACHE STRING   "Vela --accelerator-config (the AEN801 U85 is 256-MAC)")
set(AEN_NPU_MODEL  "${ZEPHYR_TFLITE_MICRO_MODULE_DIR}/tensorflow/lite/micro/models/person_detect.tflite"
    CACHE FILEPATH "Input int8 .tflite to Vela-compile")
set(AEN_NPU_MODEL_NAME "person_detect_u85"
    CACHE STRING   "Embedded model identity string")
set(AEN_NPU_VELA_CONFIG ""
    CACHE FILEPATH "Alif Vela config .ini (ALIF PROPRIETARY -- from alp-sdk-internal)")
if(NOT AEN_NPU_VELA_CONFIG)
	message(WARNING
		"aen-npu-inference-alp: AEN_NPU_VELA_CONFIG unset -- Vela will use its "
		"built-in system-config and the emitted command stream will NOT match the "
		"bench-validated E8 runtime.  Pass -DAEN_NPU_VELA_CONFIG=<alp-sdk-internal>/ensemble_vela.ini.")
endif()
set(AEN_NPU_SYSTEM_CONFIG "Ethos_U85_SRAM_Only" CACHE STRING "Vela --system-config")
set(AEN_NPU_MEMORY_MODE   "Sram_Only"           CACHE STRING "Vela --memory-mode")

set(AEN_NPU_GEN_DIR "${CMAKE_CURRENT_BINARY_DIR}/model-gen")
set(AEN_NPU_MODEL_H "${AEN_NPU_GEN_DIR}/model.h")

set(_gen_args
	--vela      ${AEN_NPU_VELA}
	--accel     ${AEN_NPU_ACCEL}
	--model     ${AEN_NPU_MODEL}
	--name      ${AEN_NPU_MODEL_NAME}
	--build-dir ${AEN_NPU_GEN_DIR}
	--out       ${AEN_NPU_MODEL_H}
)
if(AEN_NPU_VELA_CONFIG)
	list(APPEND _gen_args --config ${AEN_NPU_VELA_CONFIG}
	     --system-config ${AEN_NPU_SYSTEM_CONFIG} --memory-mode ${AEN_NPU_MEMORY_MODE})
endif()

add_custom_command(
	OUTPUT  ${AEN_NPU_MODEL_H}
	COMMAND ${CMAKE_COMMAND} -E make_directory ${AEN_NPU_GEN_DIR}
	COMMAND ${PYTHON_EXECUTABLE} ${CMAKE_CURRENT_SOURCE_DIR}/gen_model.py ${_gen_args}
	DEPENDS ${AEN_NPU_MODEL} ${CMAKE_CURRENT_SOURCE_DIR}/gen_model.py
	COMMENT "aen-npu-inference-alp: Vela-compiling ${AEN_NPU_MODEL} for ${AEN_NPU_ACCEL}"
	VERBATIM
)
if(NOT EXISTS ${AEN_NPU_MODEL_H})
	execute_process(
		COMMAND ${CMAKE_COMMAND} -E make_directory ${AEN_NPU_GEN_DIR}
		COMMAND ${PYTHON_EXECUTABLE} ${CMAKE_CURRENT_SOURCE_DIR}/gen_model.py ${_gen_args}
		RESULT_VARIABLE _gen_rc)
	if(NOT _gen_rc EQUAL 0)
		message(FATAL_ERROR "aen-npu-inference-alp: model-gen failed (rc=${_gen_rc})")
	endif()
endif()

add_custom_target(aen_npu_alp_model DEPENDS ${AEN_NPU_MODEL_H})
add_dependencies(app aen_npu_alp_model)

# Publish hal_alif's common/include on the global Zephyr include path so the AEN
# Ethos-U backend's strong ethosu_address_remap (src/backends/inference/
# ethos_u_aen.cpp) can #include <soc_memory_map.h> (local_to_global()).  Header
# only -- not CONFIG_RTSS_HE, which would also compile the TZ sources that
# hard-#error without a non-secure DTS node on this bench board.
zephyr_include_directories(${ZEPHYR_ALIF_MODULE_DIR}/common/include)

target_include_directories(app PRIVATE ${AEN_NPU_GEN_DIR})
target_sources(app PRIVATE src/main.c)
```

## prj.conf
```kconfig
# SPDX-License-Identifier: Apache-2.0
#
# aen-npu-inference-alp -- real person_detect NPU inference through
# <alp/inference.h> on the E1M-AEN801 (Ensemble E8, M55-HE), Ethos-U85.
# ~263 KiB Vela model -> MRAM slot0, Flow D boot.

# --- MRAM slot0 link --------------------------------------------------------
# Nothing to set: the board _defconfig sets CONFIG_USE_DT_CODE_PARTITION=y, so
# every image for this board links at the slot0 offset (0x80010000), not the
# MRAM base.  A Flow C ITCM RAM-run overrides it from the bench fragments
# (scripts/bench/aen/aen-flowc-itcm.conf + .overlay), never from an app.

# --- alp-sdk inference backend selection ------------------------------------
# The app calls alp_inference_open(); on E8 the AEN Ethos-U backend
# (priority 100, silicon_ref alif:ensemble:e8) serves it.  A board.yaml-driven
# app gets these from the orchestrator emit; this raw example sets them itself.
CONFIG_ALP_SDK=y
CONFIG_ALP_SDK_INFERENCE_BACKEND_TFLM=y
CONFIG_ALP_SDK_INFERENCE_BACKEND_ETHOS_U_AEN=y
CONFIG_ALP_SDK_INFERENCE_ETHOS_U_VARIANT_U85=y

# --- TFLM + Ethos-U driver stack (the silicon-proven config) ----------------
CONFIG_CPP=y
CONFIG_STD_CPP17=y
CONFIG_REQUIRES_FULL_LIBCPP=y
CONFIG_TENSORFLOW_LITE_MICRO=y
# CONFIG_ETHOS_U is also select-ed by BACKEND_ETHOS_U_AEN (the board declares
# the arm,ethos-u node); set explicitly to be self-describing.
CONFIG_ETHOS_U=y
# Correct-signature dcache hooks (ethos_u_common.c); NOT CONFIG_ARM_ETHOS_U
# (hal_alif's stale ethosu_callback.c -> duplicate-symbol clash).
CONFIG_ETHOS_U_DCACHE=y
# E8 NPU = Ethos-U85 256-MAC; matches gen_model.py --accel ethos-u85-256.
CONFIG_ETHOS_U85_256=y

# --- Heap / stack -----------------------------------------------------------
# The Ethos-U driver's mutex/semaphore (k_malloc) + TFLM glue need a heap.
CONFIG_HEAP_MEM_POOL_SIZE=65536
CONFIG_MAIN_STACK_SIZE=16384

# --- DMA coherence (the #1 bench risk) --------------------------------------
# The NPU DMA-reads the model + arena from SRAM0.  DCACHE=n gives CPU + NPU a
# coherent view with no maintenance dependency (the silicon-proven config).
CONFIG_DCACHE=n

# --- Console: RAM console (this bench's observable, read over SWD) -----------
CONFIG_CONSOLE=y
CONFIG_RAM_CONSOLE=y
CONFIG_RAM_CONSOLE_BUFFER_SIZE=2048
CONFIG_UART_CONSOLE=n
CONFIG_PRINTK=y
# Keep logging off so the RESULT line prints cleanly (the PASS gate reads that
# printk line).  Flip CONFIG_LOG=y + ETHOS_U_LOG_LEVEL_DBG to debug an invoke.
CONFIG_LOG=n
```

## boards/alp_e1m_aen801_m55_he_ae822fa0e5597ls0_rtss_he.overlay
```dts
/*
 * Copyright (c) 2026 Alp Lab AB
 * SPDX-License-Identifier: Apache-2.0
 *
 * aen-npu-inference-person-mram overlay for the E1M-AEN801 (Ensemble E8,
 * M55-HE) -- the MATCHED-RUNTIME NPU inference overlay, MRAM slot0 variant.  Adds:
 *   1. the Arm Ethos-U85 NPU node (base 0x49042000, IRQ 366);
 *   2. global_base on the ITCM/DTCM nodes (the missing piece for
 *      soc_memory_map.h local_to_global()).
 * Unlike the -alif fixture overlay it does NOT retarget ROM to ITCM: the image
 * keeps the board-default chosen (zephyr,flash=&mram_storage,
 * code-partition=&slot0_partition) and links into MRAM slot0 @0x80010000.
 *
 * =====================  THE #1 BENCH RISK: DMA PLACEMENT  ====================
 * The Ethos-U85 is a DMA bus master: it reads the Vela command stream + weights
 * (the embedded model) and the intermediate tensors (the TFLM arena) over its
 * own AXI master, and writes the output tensor back the same way.  Those buffers
 * MUST live in memory the NPU can reach, and at the address the NPU is PROGRAMMED
 * with -- which is where local_to_global() comes in.
 *
 * The generated M55-HE board sets `zephyr,sram = &dtcm`.  DTCM is private to the
 * CPU; the model + arena are therefore tagged into the "SRAM0" linker region
 * (global on-chip SRAM @0x02000000, declared by the SoC dtsi sram0 node).  SRAM0
 * is already a global system address, so local_to_global() returns it unchanged
 * -- but for any ITCM/DTCM-resident buffer the strong remap is what converts the
 * CPU-local pointer into the global address the NPU's AXI master needs.
 * Combined with CONFIG_DCACHE=n (prj.conf), the CPU and NPU share a coherent
 * view of SRAM0 with no cache-maintenance calls.
 * ============================================================================
 */

/*
 * MRAM slot0 link (no ITCM retarget): person_detect Vela'd is ~263 KiB and
 * overflows the 256 KiB ITCM region, so this image links + XIPs from the board-
 * default MRAM slot0 partition (zephyr,flash=&mram_storage,
 * zephyr,code-partition=&slot0_partition -> 0x80010000).  Flashed via Flow D
 * (J-Link direct MRAM); the SES boot ROM verifies + boots the signed ATOC.
 */

/*
 * global_base for local_to_global().
 *
 * hal_alif's soc_memory_map.h does DT_PROP(DT_NODELABEL(itcm), global_base) and
 * DT_PROP(DT_NODELABEL(dtcm), global_base).  The board's upstream itcm/dtcm
 * nodes are compatible "arm,itcm"/"arm,dtcm", whose binding has no global_base,
 * so the property is both undeclared and absent.  Re-`compatible` the nodes onto
 * the alp-sdk alif,itcm/alif,dtcm bindings (which declare global_base) and set
 * the E8 RTSS-HE global views, transcribed from the Apache-2.0 zephyr_alif fork
 * (dts/arm/alif/ensemble/common/ensemble_rtss_he.dtsi):
 *     ITCM global_base = 0x58000000, DTCM global_base = 0x58800000.
 * The zephyr,memory-region / reg are unchanged so the linker regions and the
 * RAM-run flash retarget above are unaffected.
 */
&itcm {
	compatible = "alif,itcm";
	global_base = <0x58000000>;
};

&dtcm {
	compatible = "alif,dtcm";
	global_base = <0x58800000>;
};

&soc {
	/*
	 * Arm Ethos-U85 NPU.  compatible "arm,ethos-u" (binding arm,ethos-u.yaml),
	 * driven by the Arm Ethos-U core driver's Zephyr frontend
	 * (drivers/misc/ethos_u/ethos_u_arm.c, DT_DRV_COMPAT arm_ethos_u).
	 * status="okay" makes DT_HAS_ARM_ETHOS_U_ENABLED true, which both builds
	 * the frontend and -- via CONFIG_ARM_ETHOS_U's `depends on` -- gates the
	 * NPU driver in.  ethosu_init() runs the NPU soft-reset before main(); the
	 * TFLM Ethos-U kernel later grabs this driver instance via
	 * ethosu_reserve_driver() inside Invoke().
	 *
	 * IRQ 366 + secure/privilege flags transcribed verbatim from the fork node
	 * (e4_e6_e8.dtsi ethosu1).  No `clocks` property: the fork's ethosu85 node
	 * carries none -- regcheck already confirmed the block is clocked
	 * (device_is_ready=1, ID=0x20007001).
	 */
	ethosu_npu: ethosu85@49042000 {
		compatible = "arm,ethos-u";
		reg = <0x49042000 0x1000>;
		interrupts = <366 3>;
		interrupt-parent = <&nvic>;
		secure-enable;
		privilege-enable;
		status = "okay";
	};
};
```

## boards/alp_e1m_aen803_m55_he_ae822fa0e5597ls0_rtss_he.overlay
```dts
/*
 * Copyright (c) 2026 Alp Lab AB
 * SPDX-License-Identifier: Apache-2.0
 *
 * aen-npu-inference-person-mram overlay for the E1M-AEN803 (Ensemble E8,
 * M55-HE) -- the MATCHED-RUNTIME NPU inference overlay, MRAM slot0 variant.  Adds:
 *   1. the Arm Ethos-U85 NPU node (base 0x49042000, IRQ 366);
 *   2. global_base on the ITCM/DTCM nodes (the missing piece for
 *      soc_memory_map.h local_to_global()).
 * Unlike the -alif fixture overlay it does NOT retarget ROM to ITCM: the image
 * keeps the board-default chosen (zephyr,flash=&mram_storage,
 * code-partition=&slot0_partition) and links into MRAM slot0 @0x80010000.
 *
 * =====================  THE #1 BENCH RISK: DMA PLACEMENT  ====================
 * The Ethos-U85 is a DMA bus master: it reads the Vela command stream + weights
 * (the embedded model) and the intermediate tensors (the TFLM arena) over its
 * own AXI master, and writes the output tensor back the same way.  Those buffers
 * MUST live in memory the NPU can reach, and at the address the NPU is PROGRAMMED
 * with -- which is where local_to_global() comes in.
 *
 * The generated M55-HE board sets `zephyr,sram = &dtcm`.  DTCM is private to the
 * CPU; the model + arena are therefore tagged into the "SRAM0" linker region
 * (global on-chip SRAM @0x02000000, declared by the SoC dtsi sram0 node).  SRAM0
 * is already a global system address, so local_to_global() returns it unchanged
 * -- but for any ITCM/DTCM-resident buffer the strong remap is what converts the
 * CPU-local pointer into the global address the NPU's AXI master needs.
 * Combined with CONFIG_DCACHE=n (prj.conf), the CPU and NPU share a coherent
 * view of SRAM0 with no cache-maintenance calls.
 * ============================================================================
 */

/*
 * MRAM slot0 link (no ITCM retarget): person_detect Vela'd is ~263 KiB and
 * overflows the 256 KiB ITCM region, so this image links + XIPs from the board-
 * default MRAM slot0 partition (zephyr,flash=&mram_storage,
 * zephyr,code-partition=&slot0_partition -> 0x80010000).  Flashed via Flow D
 * (J-Link direct MRAM); the SES boot ROM verifies + boots the signed ATOC.
 */

/*
 * global_base for local_to_global().
 *
 * hal_alif's soc_memory_map.h does DT_PROP(DT_NODELABEL(itcm), global_base) and
 * DT_PROP(DT_NODELABEL(dtcm), global_base).  The board's upstream itcm/dtcm
 * nodes are compatible "arm,itcm"/"arm,dtcm", whose binding has no global_base,
 * so the property is both undeclared and absent.  Re-`compatible` the nodes onto
 * the alp-sdk alif,itcm/alif,dtcm bindings (which declare global_base) and set
 * the E8 RTSS-HE global views, transcribed from the Apache-2.0 zephyr_alif fork
 * (dts/arm/alif/ensemble/common/ensemble_rtss_he.dtsi):
 *     ITCM global_base = 0x58000000, DTCM global_base = 0x58800000.
 * The zephyr,memory-region / reg are unchanged so the linker regions and the
 * RAM-run flash retarget above are unaffected.
 */
&itcm {
	compatible = "alif,itcm";
	global_base = <0x58000000>;
};

&dtcm {
	compatible = "alif,dtcm";
	global_base = <0x58800000>;
};

&soc {
	/*
	 * Arm Ethos-U85 NPU.  compatible "arm,ethos-u" (binding arm,ethos-u.yaml),
	 * driven by the Arm Ethos-U core driver's Zephyr frontend
	 * (drivers/misc/ethos_u/ethos_u_arm.c, DT_DRV_COMPAT arm_ethos_u).
	 * status="okay" makes DT_HAS_ARM_ETHOS_U_ENABLED true, which both builds
	 * the frontend and -- via CONFIG_ARM_ETHOS_U's `depends on` -- gates the
	 * NPU driver in.  ethosu_init() runs the NPU soft-reset before main(); the
	 * TFLM Ethos-U kernel later grabs this driver instance via
	 * ethosu_reserve_driver() inside Invoke().
	 *
	 * IRQ 366 + secure/privilege flags transcribed verbatim from the fork node
	 * (e4_e6_e8.dtsi ethosu1).  No `clocks` property: the fork's ethosu85 node
	 * carries none -- regcheck already confirmed the block is clocked
	 * (device_is_ready=1, ID=0x20007001).
	 */
	ethosu_npu: ethosu85@49042000 {
		compatible = "arm,ethos-u";
		reg = <0x49042000 0x1000>;
		interrupts = <366 3>;
		interrupt-parent = <&nvic>;
		secure-enable;
		privilege-enable;
		status = "okay";
	};
};
```

## src/main.c
```c
/*
 * Copyright 2026 Alp Lab AB
 * SPDX-License-Identifier: Apache-2.0
 *
 * aen-npu-inference-alp -- the REAL person_detect MobileNet running on the
 * E1M-AEN801 (Ensemble E8) Ethos-U85 NPU *through the portable
 * <alp/inference.h> API* -- the SDK-backed sibling of
 * aen-npu-inference-person-mram (which drives the NPU via the raw Arm
 * InferenceProcess wrapper).
 *
 * The whole point: a customer writes only alp_inference_open() / invoke() /
 * get_output().  The AEN Ethos-U backend (src/backends/inference/ethos_u_aen.cpp)
 * supplies the NPU AXI address-remap + SRAM-port config-select strong overrides;
 * the app does NOT hand-write them (contrast the raw sibling, which does).
 *
 * DMA placement (the #1 silicon rule): the Ethos-U is a DMA master that reads
 * the model + arena and writes the output over its own AXI master.  Those
 * buffers MUST live in NPU-reachable global SRAM0 (@0x02000000), NOT the
 * M55-local ITCM/DTCM.  So the model is memcpy'd from rodata into an SRAM0
 * buffer, and the tensor arena is placed in the "SRAM0" linker region; the
 * input/output tensors live inside that arena, so they are SRAM0-resident too.
 *
 * Model: person_detect_u85, Vela-compiled for ethos-u85-256 with the Alif
 * Ethos_U85_SRAM_Only system-config (see CMakeLists.txt / gen_model.py).  ~263
 * KiB -> overflows ITCM, so this image links into MRAM slot0 and boots via
 * Flow D.  RESULT PASS = alp_inference_invoke succeeded AND the NPU actually
 * wrote a non-zero output tensor.
 */

#include <stdbool.h>
#include <stdint.h>
#include <string.h>

#include <zephyr/kernel.h>
#include <zephyr/sys/printk.h>

#include "alp/inference.h"
#include "alp/peripheral.h" /* alp_status_name / alp_last_error */

/* gen_model.py output: networkModelData[], NETWORK_MODEL_LEN,
 * NETWORK_MODEL_NAME, TENSOR_ARENA_SIZE, NPU_ALIGN, TENSOR_ARENA_ATTR
 * (= __aligned(16) section("SRAM0")). */
#include "model.h"

/* Model staged into DMA-reachable SRAM0.  networkModelData[] is const rodata
 * (in MRAM/flash); the NPU reads the fused command stream + weights via its own
 * AXI master, so the executed bytes MUST be in NPU-reachable SRAM0.  An
 * *initialised* array in a custom section is NOT init-copied by Zephyr -> keep
 * the source in rodata and memcpy into this uninitialised SRAM0 buffer. */
static uint8_t model_sram[NETWORK_MODEL_LEN] __aligned(NPU_ALIGN) __attribute__((section("SRAM0")));

/* Tensor arena in SRAM0 (TENSOR_ARENA_ATTR = __aligned(16) section("SRAM0")).
 * The MicroInterpreter lays the input + output tensors inside this arena, so
 * they are NPU-reachable too. */
TENSOR_ARENA_ATTR static uint8_t tensor_arena[TENSOR_ARENA_SIZE];

/* Evidence latched for a SWD symbol read, independent of the console decode. */
volatile int      g_invoke_status = -99;
volatile uint32_t g_out_bytes     = 0;
volatile uint8_t  g_out_first[16] = { 0 };
volatile int      g_argmax        = -1;

int main(void)
{
	printk("\n=== aen-npu-inference-alp (alp_inference_open -> Ethos-U85) ===\n");
	printk("model      : %s (%u bytes)\n", NETWORK_MODEL_NAME, (unsigned)NETWORK_MODEL_LEN);
	printk(
	    "arena      : %u bytes @ SRAM0 (%p)\n", (unsigned)TENSOR_ARENA_SIZE, (void *)tensor_arena);

	/* Stage the Vela model into DMA-reachable SRAM0. */
	memcpy(model_sram, networkModelData, NETWORK_MODEL_LEN);

	/* Open the model through the portable API.  On E8 the AEN Ethos-U backend
	 * (priority 100, silicon_ref alif:ensemble:e8) wins over the portable CPU
	 * TFLM path and dispatches onto the NPU. */
	alp_inference_config_t cfg = {
		.model_data  = model_sram,
		.model_size  = NETWORK_MODEL_LEN,
		.format      = ALP_INFERENCE_MODEL_VELA,
		.backend     = ALP_INFERENCE_BACKEND_AUTO,
		.arena_bytes = TENSOR_ARENA_SIZE,
		.arena       = tensor_arena,
	};
	alp_inference_t *inf = alp_inference_open(&cfg);
	if (inf == NULL) {
		printk("RESULT FAIL: alp_inference_open -> NULL (%s)\n", alp_status_name(alp_last_error()));
		return 0;
	}

	/* Fill the input tensor (zero-filled; a real deployment memcpys a captured
	 * frame here).  The tensor's data lives in the SRAM0 arena. */
	alp_inference_tensor_t in = { 0 };
	alp_status_t           s  = alp_inference_get_input(inf, 0, &in);
	if (s == ALP_OK && in.data != NULL) {
		memset(in.data, 0, in.size_bytes);
	}
	printk(
	    "input      : %u bytes @ %p (%s)\n", (unsigned)in.size_bytes, in.data, alp_status_name(s));

	/* Clear the OUTPUT tensor before invoking.  The arena lives in SRAM0, which
	 * gets no load-copy and holds power-on garbage (or the previous run's result)
	 * at boot, so "output is non-zero" proves nothing unless the output starts at
	 * a known value.  The descriptor is valid before invoke; zero it here so any
	 * non-zero byte afterwards was written by the NPU during this invoke. */
	alp_inference_tensor_t out = { 0 };
	s                          = alp_inference_get_output(inf, 0, &out);
	if (s != ALP_OK || out.data == NULL) {
		printk("RESULT FAIL: alp_inference_get_output -> %s\n", alp_status_name(s));
		alp_inference_close(inf);
		return 0;
	}
	memset(out.data, 0, out.size_bytes);
	g_out_bytes = (uint32_t)out.size_bytes;

	/* Run inference -- the fused Ethos-U custom op dispatches onto the NPU. */
	s               = alp_inference_invoke(inf);
	g_invoke_status = (int)s;
	if (s != ALP_OK) {
		printk("RESULT FAIL: alp_inference_invoke -> %s\n", alp_status_name(s));
		alp_inference_close(inf);
		return 0;
	}

	/* Scan the output: PASS requires a non-zero tensor.  Because the output was
	 * zeroed before invoke, an all-zero result means the NPU never wrote it. */
	const uint8_t *ob          = (const uint8_t *)out.data;
	uint32_t       n           = out.size_bytes < 16u ? (uint32_t)out.size_bytes : 16u;
	bool           any_nonzero = false;
	int            best_i      = -1;
	int            best_v      = -128; /* int8 floor */
	for (uint32_t i = 0; i < out.size_bytes; i++) {
		int8_t v = (int8_t)ob[i];
		if (i < n) {
			g_out_first[i] = (uint8_t)v;
		}
		if (v != 0) {
			any_nonzero = true;
		}
		if (v > best_v) {
			best_v = v;
			best_i = (int)i;
		}
	}
	g_argmax = best_i;

	printk("output     : %u bytes, argmax=%d (val=%d), first=",
	       (unsigned)out.size_bytes,
	       best_i,
	       best_v);
	for (uint32_t i = 0; i < n; i++) {
		printk("%02x ", g_out_first[i]);
	}
	printk("\n");

	if ((out.size_bytes > 0) && any_nonzero) {
		printk("RESULT PASS: NPU inference via alp_inference_open -- model=%s "
		       "out_bytes=%u argmax=%d\n",
		       NETWORK_MODEL_NAME,
		       (unsigned)out.size_bytes,
		       best_i);
	} else {
		printk("RESULT FAIL: output not populated (out_bytes=%u nonzero=%d)\n",
		       (unsigned)out.size_bytes,
		       (int)any_nonzero);
	}

	alp_inference_close(inf);
	return 0;
}
```
