## CMakeLists.txt
```
# SPDX-License-Identifier: Apache-2.0
#
# On-silicon MRAM flash write/erase/readback validation for the E1M-AEN801
# (Alif Ensemble E8, M55-HE), exercising the alp-sdk Tier-2 flash driver
# zephyr/drivers/flash/flash_mram_alif.c ("alif,mram-flash-controller") through
# the PORTABLE Zephyr flash_* class API.
#
# Closes the #512 gap: MCUboot/app boot already prove MRAM read+execute, but the
# driver's erase -> program -> readback path had no dedicated bench PASS gate.
# This app drives that path at runtime against the SAFE `storage` partition
# (label "storage", MRAM 0x80560000, 128 KiB NVS/settings) -- NOT slot0/slot1 --
# so the canonical person_detect boot image is never touched.
#
# Bench flow D (MRAM slot0, SES-booted): the SES boots the resident slot0 image
# in preference to a Flow-C ITCM RAM-run, so this app is flashed into MRAM slot0
# (CONFIG_USE_DT_CODE_PARTITION=y -> reset vector 0x8001xxxx) and SE-booted.  At
# runtime it exercises the flash driver against the safe storage partition; the
# ONLY persistent bytes it mutates are inside that partition.  A RAM console
# carries the PASS/FAIL line; the human ALSO reads mem32 0x80560000 over J-Link
# to confirm the written pattern landed in silicon, independent of any printk.
# The canonical person_detect slot0 is restored after the run.
#
# Standalone Zephyr app (no alp_project.py board.yaml flow): build with
#   ZEPHYR_BASE=<zephyr-base> west build \
#     -b alp_e1m_aen801_m55_he/ae822fa0e5597ls0/rtss_he <this-dir> -- \
#     "-DEXTRA_ZEPHYR_MODULES=<alp-sdk>;<hal_alif>"
# then flash with scripts/bench/aen/flash-jlink-mramxip.sh.

cmake_minimum_required(VERSION 3.20)

find_package(Zephyr REQUIRED HINTS $ENV{ZEPHYR_BASE})
project(aen_mram_flash_validate LANGUAGES C)

target_sources(app PRIVATE src/main.c)
```

## prj.conf
```kconfig
# SPDX-License-Identifier: Apache-2.0
#
# Bench config for the MRAM flash erase/program/readback RAM-run on the
# E1M-AEN801 (Alif Ensemble E8, M55-HE).

# Console: the Alp UART console -- E1M edge UART0 (Alif UART5, P3_4/P3_5, 115200
# 8N1, NS16550), the E1M-AEN801 carrier console.  UART5 is USB-routed on the
# bench (the labgrid `console` resource, @115200), so the app's RESULT
# PASS/FAIL line streams live over the console as the SES boots the slot0
# image -- no SWD readback needed.  The board _defconfig already selects it;
# we set it explicitly so the example is self-describing.
CONFIG_SERIAL=y
CONFIG_CONSOLE=y
CONFIG_UART_CONSOLE=y
CONFIG_UART_INTERRUPT_DRIVEN=y
CONFIG_PRINTK=y

# --- slot0 link (Flow D, SES-booted) -----------------------------------------
# The SES boots the RESIDENT slot0 image in preference to a Flow-C ITCM
# RAM-run, so this bench app is flashed into MRAM slot0 and SE-booted.
# The board _defconfig's CONFIG_USE_DT_CODE_PARTITION=y links it at the slot0
# offset (FLASH_LOAD_OFFSET 0x10000 -> reset vector 0x8001xxxx) so app-gen-toc
# can sign it in place (mramAddress 0x80010000) -- see
# scripts/bench/aen/flash-jlink-mramxip.sh.  Nothing to set here.

# --- MRAM flash driver -------------------------------------------------------
# CONFIG_FLASH surfaces the Zephyr flash subsystem; the in-tree Tier-2
# flash_mram_alif driver binds the "alif,mram-flash-controller" node the board
# DTS declares and sets FLASH_HAS_DRIVER_ENABLED.  FLASH_MAP + FIXED_PARTITION
# give us the storage-partition offset/size without hard-coding 0x560000.
CONFIG_FLASH=y
CONFIG_FLASH_MAP=y
CONFIG_FLASH_PAGE_LAYOUT=y

# Do NOT set CONFIG_MPU_ALLOW_FLASH_WRITE: it widens the generic 2-region MPU
# table's whole-flash window to P_RW_U_RW (arm_mpu_v8.h:316-322), which makes
# ALL of MRAM -- including slot0 and MCUboot -- writable by UNPRIVILEGED code
# (see the MRAM MPU split comment in zephyr/dts/alif/ensemble_e8_peripherals.dtsi,
# the shared SoC overlay both the M55-HE and M55-HP board DTS include). The
# write access flash_mram_alif's direct memory-mapped stores need is supplied
# instead by that shared MRAM_DEVICE region (privileged-only, storage-partition
# + slot0-trailer..end), which covers this app's target (storage_partition) --
# main() runs privileged (no CONFIG_USERSPACE here), so it can write there
# without granting unprivileged write across the whole chip.

# Keep the image small + deterministic for a RAM-run; the driver's own LOG_ERR
# lines are not needed for the PASS gate (the app prints every rc explicitly).
CONFIG_LOG=n
```

## src/main.c
```c
/*
 * Copyright (c) 2026 Alp Lab AB
 * SPDX-License-Identifier: Apache-2.0
 *
 * On-silicon MRAM flash erase/program/readback validation for the E1M-AEN801
 * (Alif Ensemble E8) over the alp-sdk Tier-2 flash_mram_alif driver (ADR 0017
 * Tier-2, "alif,mram-flash-controller" -- a Zephyr flash-class driver vendored
 * from the Apache-2.0 zephyr_alif fork for the on-die MRAM at 0x80000000).
 *
 * What it proves (closes issue #512)
 * ----------------------------------
 * MCUboot and the app boot path already prove MRAM read+execute.  This app
 * proves the WRITE side of flash_mram_alif.c end-to-end through the PORTABLE
 * Zephyr flash_* class API:
 *
 *     flash_erase()  -> readback == erase_value (0x00)   (erase works)
 *     flash_write()  -> readback == written pattern      (program works)
 *     flash_read()   -> byte-exact verify                (read works)
 *     out-of-unit erase/write -> -EINVAL                 (range/align guard)
 *
 * two independent ways:
 *   1. in-firmware:  this app runs the sequence and prints every API return
 *      code + a single 'RESULT PASS:' / 'RESULT FAIL:' line.
 *   2. over J-Link:  the human reads mem32 0x80560000 (the storage partition,
 *      see below) after the program step -- the ground truth on silicon,
 *      independent of any printk.  The pattern's first word is 0xA5A5A5A5.
 *
 * Safe scratch target -- NOT slot0/slot1
 * --------------------------------------
 * The test writes ONLY the `storage` fixed-partition (label "storage", MRAM
 * offset 0x560000 = absolute 0x80560000, 96 KiB, the NVS/settings region),
 * and touches only its first ERASE_UNIT (1 KiB at 0x80560000).
 *
 * CORRECTION (#1289): an earlier revision of this comment claimed the region
 * "is empty on this bench and holds no boot code".  That was FALSE and it is
 * what made writing here look safe.  `storage` was then 128 KiB and ran to
 * 0x80580000 -- the top of the App MRAM window, which is exactly where Alif's
 * SETOOLS top-anchors the ATOC application table.  Measured on this bench
 * 2026-08-08: this app erased 0x80560000 while the live ATOC sat intact at
 * 0x8057EA50, magic `ckBS` (0x53426B63), INSIDE the same partition this app
 * held a writable handle to.  Nothing failed at build or run time; the part
 * would have failed on the FOLLOWING boot had the write reached that far.
 *
 * The top 32 KiB (0x80578000..0x80580000) is now a separate `atoc` partition
 * this app has no handle to, and scripts/check_atoc_reservation.py keeps it
 * that way.  `storage` is genuinely safe to write NOW -- because it is
 * bounded, not because it is empty.  The app also re-erases
 * the scratch block on exit so it is left clean.  This app is flashed into MRAM
 * slot0 and SE-booted (bench flow D -- the SES boots the resident slot0 image
 * in preference to a Flow-C ITCM RAM-run), so slot0 briefly holds THIS app
 * instead of person_detect; the canonical person_detect slot0 is RESTORED after
 * the run (byte-exact, reset vector 0x80013225 -- bench-measured 2026-07-28,
 * verified across three cold power cycles: 80010000 = 20004C60 80013225).
 * No other MRAM region is mutated by the test itself.
 *
 * Console is the Alp UART console (see prj.conf): E1M edge UART0 = Alif UART5
 * (P3_4/P3_5, 115200 8N1), USB-routed to the labgrid `console` resource
 * since 2026-07-03, so the RESULT PASS/FAIL line streams live as
 * the SES boots this slot0 image.  Independently, the human reads mem32
 * 0x80560000 over J-Link after the program step -- silicon ground truth for the
 * written pattern (first word 0xA5A5A5A5), independent of any printk.
 * BENCH-VALIDATION app -- not a customer teaching example.
 */

#include <errno.h>
#include <string.h>
#include <zephyr/kernel.h>
#include <zephyr/device.h>
#include <zephyr/drivers/flash.h>
#include <zephyr/storage/flash_map.h>

/* The safe scratch target: the `storage` fixed-partition under the MRAM
 * controller.  PARTITION_* resolve the offset/size from DT so nothing is
 * hard-coded, and PARTITION_DEVICE resolves the flash device the
 * flash_mram_alif driver bound (the "alif,mram-flash-controller" node). */
#define SCRATCH_PARTITION storage_partition

static const struct device *const flash_dev = PARTITION_DEVICE(SCRATCH_PARTITION);

#define SCRATCH_OFF  PARTITION_OFFSET(SCRATCH_PARTITION)
#define SCRATCH_SIZE PARTITION_SIZE(SCRATCH_PARTITION)

/* One erase block (1024 B, the node's erase-block-size) is enough to prove the
 * path; the written pattern is 256 B = 16 * 16-byte program units. */
#define ERASE_UNIT  1024U
#define PATTERN_LEN 256U

/* Never let main() return.  On this SoC an idle M55 -- the kernel idle thread's
 * low-power wait once main returns -- lets the SES gate the debug (SWD/DAP)
 * power domain OFF, which then wedges EVERY subsequent J-Link connect (a bare
 * "Failed to power up DAP"), including the person_detect slot0 restore, and
 * survives a cold power-cycle because the resident app re-idles on each boot.
 * Park in a BUSY heartbeat (k_busy_wait, never WFI) so the core stays active,
 * the DAP stays powerable, and the UART console keeps streaming the verdict --
 * just like the continuously-busy person_detect image that keeps the bench
 * probe alive between runs. */
static FUNC_NORETURN void park(void)
{
	for (;;) {
		k_busy_wait(1000U * 1000U); /* 1 s busy; never enter idle */
		printk("mram-flash-validate: parked (heartbeat)\n");
	}
}

int main(void)
{
	int      rc;
	uint8_t  wbuf[PATTERN_LEN];
	uint8_t  rbuf[PATTERN_LEN];
	uint32_t i;

	printk("\n=== AEN801 MRAM flash erase/program/readback bench "
	       "(flash_mram_alif / alif,mram-flash-controller) ===\n");

	/* 1. device readiness.  If the controller node did not instantiate a
	 *    device the build would fail at link, so reaching here means the
	 *    device object exists -- confirm it is ready. */
	if (!device_is_ready(flash_dev)) {
		printk("RESULT FAIL: MRAM flash device not ready\n");
		park();
	}
	printk("flash device ready: %s\n", flash_dev->name);
	printk("scratch = storage partition: off=0x%06lx size=%u B (abs 0x%08lx)\n",
	       (unsigned long)SCRATCH_OFF,
	       (unsigned)SCRATCH_SIZE,
	       (unsigned long)(0x80000000UL + SCRATCH_OFF));

	/* 2. static parameters: write_block_size (expect 16) + erase_value
	 *    (expect 0x00 -- flash_mram_alif erases to zero, not 0xFF). */
	const struct flash_parameters *fp = flash_get_parameters(flash_dev);

	if (fp == NULL) {
		printk("RESULT FAIL: flash_get_parameters returned NULL\n");
		park();
	}
	printk("write_block_size=%u erase_value=0x%02x\n",
	       (unsigned)fp->write_block_size,
	       fp->erase_value);

	/* 3. ERASE one unit at the scratch offset. */
	rc = flash_erase(flash_dev, SCRATCH_OFF, ERASE_UNIT);
	printk("flash_erase(0x%06lx, %u) rc=%d\n", (unsigned long)SCRATCH_OFF, ERASE_UNIT, rc);
	if (rc != 0) {
		printk("RESULT FAIL: flash_erase rc=%d\n", rc);
		park();
	}

	/* 4. readback the erased region and confirm every byte == erase_value. */
	memset(rbuf, 0xFF, sizeof(rbuf));
	rc = flash_read(flash_dev, SCRATCH_OFF, rbuf, PATTERN_LEN);
	printk("flash_read(post-erase) rc=%d\n", rc);
	if (rc != 0) {
		printk("RESULT FAIL: flash_read post-erase rc=%d\n", rc);
		park();
	}
	for (i = 0; i < PATTERN_LEN; i++) {
		if (rbuf[i] != fp->erase_value) {
			printk("RESULT FAIL: erase mismatch at +%u: 0x%02x != 0x%02x\n",
			       i,
			       rbuf[i],
			       fp->erase_value);
			park();
		}
	}
	printk("erase verify OK: %u bytes == 0x%02x\n", PATTERN_LEN, fp->erase_value);

	/* 5. PROGRAM a deterministic pattern (first word 0xA5A5A5A5 for the J-Link
	 *    readback; the rest is a counting ramp so a stuck/shorted byte shows). */
	for (i = 0; i < PATTERN_LEN; i++) {
		wbuf[i] = (i < 4) ? 0xA5 : (uint8_t)(i & 0xFF);
	}
	rc = flash_write(flash_dev, SCRATCH_OFF, wbuf, PATTERN_LEN);
	printk("flash_write(0x%06lx, %u) rc=%d\n", (unsigned long)SCRATCH_OFF, PATTERN_LEN, rc);
	if (rc != 0) {
		printk("RESULT FAIL: flash_write rc=%d\n", rc);
		park();
	}

	/* --- J-Link readback window: mem32 0x80560000 should read 0xA5A5A5A5 --- */

	/* 6. readback the programmed region and byte-exact verify. */
	memset(rbuf, 0x00, sizeof(rbuf));
	rc = flash_read(flash_dev, SCRATCH_OFF, rbuf, PATTERN_LEN);
	printk("flash_read(post-write) rc=%d\n", rc);
	if (rc != 0) {
		printk("RESULT FAIL: flash_read post-write rc=%d\n", rc);
		park();
	}
	if (memcmp(rbuf, wbuf, PATTERN_LEN) != 0) {
		for (i = 0; i < PATTERN_LEN; i++) {
			if (rbuf[i] != wbuf[i]) {
				printk("RESULT FAIL: program mismatch at +%u: "
				       "0x%02x != 0x%02x\n",
				       i,
				       rbuf[i],
				       wbuf[i]);
				break;
			}
		}
		park();
	}
	printk("program verify OK: %u bytes byte-exact\n", PATTERN_LEN);

	/* 7. negative path: an erase whose length is not a multiple of the erase
	 *    unit must be rejected with -EINVAL BEFORE any silicon write (proves
	 *    the driver's range/alignment guard, not just the happy path). */
	rc = flash_erase(flash_dev, SCRATCH_OFF, ERASE_UNIT - 16U);
	printk("flash_erase(unaligned len) rc=%d (expect %d)\n", rc, -EINVAL);
	if (rc != -EINVAL) {
		printk("RESULT FAIL: unaligned erase not rejected (rc=%d)\n", rc);
		park();
	}

	/* 8. leave the scratch block clean (erased) so the storage/NVS region is
	 *    not left holding our test pattern. */
	rc = flash_erase(flash_dev, SCRATCH_OFF, ERASE_UNIT);
	printk("flash_erase(cleanup) rc=%d\n", rc);
	if (rc != 0) {
		printk("RESULT FAIL: cleanup erase rc=%d\n", rc);
		park();
	}

	printk("RESULT PASS: MRAM erase/program/readback verified on the "
	       "storage partition (slot0 untouched)\n");
	park();
}
```
