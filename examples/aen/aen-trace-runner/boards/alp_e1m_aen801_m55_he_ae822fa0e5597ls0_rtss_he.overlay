/*
 * Copyright (c) 2026 Alp Lab AB
 * SPDX-License-Identifier: Apache-2.0
 *
 * aen-dsi-display overlay for the E1M-AEN801 (Ensemble E8, M55-HE) RAM-run.
 *
 * The display chain, the panel, the carrier expander and the framebuffer
 * region all come from the e1m_evk_rk055hdmipi4ma0 shield (CMakeLists.txt).
 * This overlay only retargets the image for the bench RAM-run: ROM to ITCM
 * (path-reference form &itcm; the phandle-array form makes FLASH_SIZE=0 and
 * overflows the link), with no MCUboot code partition.  The 720x1280 RGB565
 * framebuffer is not in ITCM -- it is the shield's region at the top of SRAM0,
 * used by address, so it adds nothing to the RAM-run .bin.
 */

#include <zephyr/dt-bindings/memory-attr/memory-attr-arm.h>

/ {
	chosen {
		zephyr,flash = &itcm;
		/delete-property/ zephyr,code-partition;
	};
};

/*
 * SRAM1 is shared with the A32 pair (mailbox at 0x02401000, later the camera
 * pool at 0x02480000): an MPU region makes it Normal non-cacheable for this
 * core, so the mailbox never goes stale even if a previous image left the
 * D-cache on (CONFIG_DCACHE=n does not switch it off). Zephyr's ARM MPU
 * programs this from zephyr,memory-attr (CONFIG_MEM_ATTR). Attribute only:
 * it does not power SRAM1.
 */
&sram1 {
	zephyr,memory-attr = <DT_MEM_ARM(ATTR_MPU_RAM_NOCACHE)>;
};

/*
 * The shared page 0x0237F000..0x0237FFFF -- the event ring (sound), the I2C1 handover flag, the HP
 * debug words, the camera view descriptor, the pose slot and the I2C2 + GPIO5 lease record
 * (src/ipc/tr_memmap.h, src/ipc/tr_bus2.h) -- is written by the other M55 and the A32. The whole
 * app relies on CONFIG_DCACHE=n for it, but CONFIG_DCACHE=n does not switch the cache off (Zephyr
 * only disables it at boot when CONFIG_DCACHE=y), so a warm RAM-run after an image that left
 * CCR.DC=1 would serve stale lines. This region makes the page Normal non-cacheable on this core
 * whatever the cache state. The same node sits in hp_vision's board overlay. It lies inside SRAM0
 * (0x02000000, 4 MiB), which has NO MPU region of its own in this build (the board's fixed table,
 * zephyr/soc-bridge/alif/mpu_regions_e8.c, covers MRAM, ITCM and DTCM only; SRAM0 is the default
 * map), and ends below &sram1 (0x02400000): PMSAv8-M regions may not overlap, and none does.
 */
/ {
	tr_shared_nc: sram@237f000 {
		compatible = "zephyr,memory-region", "mmio-sram";
		reg = <0x0237F000 0x1000>;
		zephyr,memory-region = "TR_SHARED_NC"; /* required by the binding; nothing is linked there */
		zephyr,memory-attr = <DT_MEM_ARM(ATTR_MPU_RAM_NOCACHE)>;
	};
};
