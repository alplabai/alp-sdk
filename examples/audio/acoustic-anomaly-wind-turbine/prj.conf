## CMakeLists.txt
```
# SPDX-License-Identifier: Apache-2.0
cmake_minimum_required(VERSION 3.20.0)

find_package(Zephyr REQUIRED HINTS $ENV{ZEPHYR_BASE})
project(acoustic_anomaly_wind_turbine LANGUAGES C)

target_compile_definitions(app PRIVATE _GNU_SOURCE)
target_sources(app PRIVATE
    src/main.c
    src/acoustic_features.c
    src/rotor_speed.c
    src/bpf_modulation.c
)
```

## prj.conf
```kconfig
# SPDX-License-Identifier: Apache-2.0
CONFIG_MAIN_STACK_SIZE=16384
CONFIG_HEAP_MEM_POOL_SIZE=131072

CONFIG_LOG=y
CONFIG_LOG_PRINTK=y
CONFIG_CBPRINTF_FP_SUPPORT=y

CONFIG_ALP_SDK_INFERENCE_BACKEND_TFLM=y

# <alp/dsp.h> chain (FFT/magnitude) for the spectral features in
# acoustic_features.c.  Its backend runs CMSIS-DSP arm_rfft_fast_f32 on
# the M55 and a portable-C radix-2 fallback under native_sim.
CONFIG_ALP_SDK_DSP=y
```

## src/main.c
```c
/*
 * Copyright 2026 Alp Lab AB
 * SPDX-License-Identifier: Apache-2.0
 *
 * acoustic-anomaly-wind-turbine
 * =============================
 *
 * Nacelle acoustic condition monitor.  Pipeline:
 *
 *   PDM mic (<alp/audio.h>, 16 kHz) --256-sample frame-->
 *     acoustic_features (FFT bands, flatness, centroid, kurtosis)
 *       --per-frame band energy--> bpf_modulation envelope ring
 *   tacho GPIO (or tacholess) --> rotor_speed --> rpm, BPF
 *     --order features--> <alp/inference.h> anomaly model
 *                         (deterministic fallback when no model)
 *     --> one WTAC record per report interval.
 *
 * Honest scope: detects drivetrain tonals + gross blade aero-anomalies
 * (TE-crack whistle, severe erosion, icing deviation, imbalance-at-BPF).
 * Early internal cracks / delamination are Acoustic-Emission (ultrasonic,
 * contact-piezo) and are OUT OF SCOPE for an airborne mic.
 *
 * The model is a stub; see models/README.md for the training recipe.  With
 * no model the deterministic baseline-deviation fallback runs so the demo
 * still produces real anomaly scores.
 *
 * API reconciliation notes (checked against real alp API headers):
 *   - No BOARD_GPIO_TACHO alias exists in <alp/board.h> routes headers.
 *     Using ALP_E1M_GPIO_IO0 (IO0, E1M pad L2) as the tacho input pin.
 *     A customer wiring a tacho pulse to a different IO should change
 *     this to the matching ALP_E1M_GPIO_IO<N> constant from <alp/e1m_pinout.h>.
 *   - alp_gpio_open() takes a uint32_t pin_id; signature confirmed.
 *   - alp_gpio_configure() signature: (pin, alp_gpio_dir_t, alp_gpio_pull_t).
 *     ALP_GPIO_PULL_NONE confirmed in peripheral.h.
 *   - alp_audio_in_open() / alp_audio_config_t fields: peripheral_id,
 *     sample_rate_hz, channels, format, frames_per_block -- all confirmed.
 *   - alp_inference_open() / alp_inference_config_t fields confirmed.
 *     With a 1-byte stub alp_inference_open() returns NULL (bad magic);
 *     the AI path guards on c.inf != NULL and falls back to
 *     aco_anomaly_fallback().
 */
#include <string.h>
#include <math.h>
#include <zephyr/kernel.h>
#include <zephyr/logging/log.h>

#include "alp/audio.h"
#include "alp/e1m_pinout.h"
#include "alp/inference.h"
#include "alp/peripheral.h"

#include "acoustic_features.h"
#include "bpf_modulation.h"
#include "rotor_speed.h"

#ifndef M_PI
#define M_PI 3.14159265358979323846
#endif

LOG_MODULE_REGISTER(wtac, LOG_LEVEL_INF);

#define N_BLADES          3
#define FRAMES_PER_REPORT BPF_ENV_N /* one record per full envelope window */
#define N_REPORTS         8         /* bounded demo run */
#define ANOMALY_INPUT_DIM (ACO_FEATURE_DIM + BPF_FEATURE_DIM + 1)
/* Gear-mesh band index in band_energy[]: the log-spaced band the synthetic
 * ~600 Hz drivetrain tone lands in (bin ~10 of 128 -> band 5). */
#define GEARMESH_BAND 5

/*
 * E1M GPIO IO0 (pad L2) used as tacho input.  No BOARD_GPIO_TACHO alias
 * exists in the E1M-EVK routes header; IO0 is a representative choice.
 * Rewire to the ALP_E1M_GPIO_IO<N> that matches your carrier's tacho wire.
 */
#define WTAC_TACHO_GPIO ALP_E1M_GPIO_IO0

/* 1-byte stub so alp_inference_open's non-NULL model_data contract is met;
 * bad magic bytes cause the backend to return NULL, which forces the
 * deterministic fallback.  Drop in a real .tflite + see models/README.md. */
static const uint8_t s_model[] = { 0x00 };

/* Canned variable-RPM track for native_sim (rpm per report interval). */
static const float s_canned_rpm[N_REPORTS] = { 14.0f, 15.0f, 16.0f, 17.0f,
	                                           18.0f, 17.0f, 16.0f, 15.0f };

/* Healthy baseline matching the synthetic "healthy hum" (low broadband):
 * mean ~ uniform small band energy, flatness high, centroid mid, low rms.
 * Customer replaces with a baseline learned at commissioning. */
static struct aco_baseline s_baseline;

/* Populate s_baseline once at startup.  inv_var (1/sigma^2) is the weight
 * aco_anomaly_fallback() gives each feature when computing a Mahalanobis-
 * style distance: leaving most entries at 1.0f (init to 1.0f by the loop
 * below) is a placeholder equal-weighting, while the two explicit
 * inv_var overrides down-weight centroid_hz and kurtosis specifically
 * because their raw numeric ranges (hundreds to thousands of Hz; unbounded
 * moment) would otherwise swamp the [0,1]-ish band-energy terms in the
 * distance sum. */
static void baseline_init(void)
{
	for (int i = 0; i < ACO_FEATURE_DIM; i++) {
		s_baseline.mean[i]    = 0.0f;
		s_baseline.inv_var[i] = 1.0f;
	}
	/* Band energies ~ 1/N each for flat broadband. */
	for (int b = 0; b < ACO_N_BANDS; b++) {
		s_baseline.mean[b] = 1.0f / (float)ACO_N_BANDS;
	}
	s_baseline.mean[ACO_N_BANDS + 0] = 0.7f;    /* spectral_flatness (broadband) */
	s_baseline.mean[ACO_N_BANDS + 1] = 4000.0f; /* centroid Hz */
	s_baseline.mean[ACO_N_BANDS + 2] = 3.0f;    /* kurtosis */
	s_baseline.mean[ACO_N_BANDS + 3] = 0.05f;   /* total_rms */
	/* Down-weight the wide-range raw features so they don't dominate distance. */
	s_baseline.inv_var[ACO_N_BANDS + 1] = 1.0f / (500.0f * 500.0f); /* centroid */
	s_baseline.inv_var[ACO_N_BANDS + 2] = 1.0f / (2.0f * 2.0f);     /* kurtosis */
}

/* Synthetic acoustic frame for native_sim: healthy hum, plus per-report
 * injected anomalies so the demo emits a mix of verdicts. */
static float synth_sample(int report, int frame, int i)
{
	float hum = 0.02f * (sinf((float)i * 1.7f) + sinf((float)i * 0.37f));
	switch (report % 3) {
	case 0: /* healthy */
		return hum;
	case 1: { /* blade imbalance: hum amplitude-modulated at BPF */
		float t  = (float)frame / ACO_FRAME_RATE_HZ;
		float am = 1.0f + 0.6f * sinf(2.0f * (float)M_PI * 0.75f * t);
		return hum * am;
	}
	default: /* drivetrain tonal: a ~600 Hz gear-mesh tone in the mech band */
		return hum + 0.5f * sinf(2.0f * (float)M_PI * 600.0f * (float)i / ACO_SR_HZ);
	}
}

/* All per-run peripheral handles, bundled so main() can pass one pointer
 * instead of three; NULL fields (mic/tacho absent) are the normal
 * native_sim state, not an error condition -- each caller downstream
 * checks the specific field it needs. */
struct wtac_ctx {
	alp_audio_in_t  *mic;
	alp_gpio_t      *tacho;
	alp_inference_t *inf;
};

/* Advisory subsystem label attached to the printk record; a heuristic hint
 * for a technician, not a claim the AI/fallback score itself makes -- see
 * the subsystem/flags block near the end of main() for how it is derived. */
static const char *subsystem_name(int s)
{
	switch (s) {
	case 0:
		return "BLADE_BPF";
	case 1:
		return "DRIVETRAIN_TONAL";
	default:
		return "BROADBAND";
	}
}

int main(void)
{
	static struct wtac_ctx        c;
	static struct aco_frame_state frame;
	static struct bpf_env_state   envst;

	memset(&c, 0, sizeof(c));
	baseline_init();

	/* PDM mic -- tolerate absence on native_sim (-> synthetic audio). */
	c.mic = alp_audio_in_open(&(alp_audio_config_t){
	    .peripheral_id    = ALP_E1M_PDM0,
	    .sample_rate_hz   = 16000,
	    .channels         = 1,
	    .format           = ALP_AUDIO_FMT_S16_LE,
	    .frames_per_block = ACO_FRAME_N,
	});
	if (c.mic != NULL) {
		alp_audio_in_start(c.mic);
	} else {
		LOG_WRN("PDM mic unavailable; using synthetic acoustics");
	}

	/* Tacho GPIO input (E1M IO0 = WTAC_TACHO_GPIO) -- tolerate absence. */
	c.tacho = alp_gpio_open(WTAC_TACHO_GPIO);
	if (c.tacho != NULL) {
		alp_gpio_configure(c.tacho, ALP_GPIO_INPUT, ALP_GPIO_PULL_NONE);
	} else {
		LOG_WRN("tacho GPIO unavailable; using tacholess RPM estimation");
	}

	/* Anomaly model -- NULL/stub-tolerant; fallback runs if absent. */
	c.inf = alp_inference_open(&(alp_inference_config_t){
	    .backend    = ALP_INFERENCE_BACKEND_AUTO,
	    .format     = ALP_INFERENCE_MODEL_TFLITE,
	    .model_data = s_model,
	    .model_size = sizeof(s_model),
	});

	printk("# WTAC,t_s,rpm,bpf_hz,anomaly_score,dominant_subsystem,top_band_hz,flags,rpm_src\n");

	int16_t pcm[ACO_FRAME_N];

	/* Outer loop: one WTAC report per BPF_ENV_N-frame envelope window (~4 s
	 * of audio at 62.5 fps) -- long enough to span several blade-pass
	 * periods (a few rpm to tens of rpm) so bpf_modulation_extract() below
	 * has a real modulation cycle to measure, not just a fraction of one. */
	for (int r = 0; r < N_REPORTS; r++) {
		bpf_env_reset(&envst);
		float acc[ACO_FEATURE_DIM];
		memset(acc, 0, sizeof(acc));

		/* Inner loop: one 256-sample PDM frame (16 ms at 16 kHz) at a time;
		 * acc accumulates the per-frame feature vectors so they can be
		 * averaged into one representative vector per report below. */
		for (int fidx = 0; fidx < FRAMES_PER_REPORT; fidx++) {
			aco_frame_reset(&frame);
			size_t got = 0;
			bool   have_pcm =
			    (c.mic != NULL && alp_audio_in_read(c.mic, pcm, ACO_FRAME_N, &got, 50) == ALP_OK &&
			     got > 0);
			for (int i = 0; i < ACO_FRAME_N; i++) {
				/* have_pcm may return fewer than ACO_FRAME_N samples (got);
				 * wrap with %got so the frame is still fully populated
				 * rather than left zero-padded past what the mic returned. */
				float s =
				    have_pcm ? ((float)pcm[i % (int)got] / 32768.0f) : synth_sample(r, fidx, i);
				aco_frame_push(&frame, s);
			}

			struct aco_features f;
			aco_feat_extract(&frame, ACO_SR_HZ, &f);

			/* Envelope sample = absolute frame energy (total_rms).  NOTE: do NOT
			 * use sum(band_energy) -- those are normalised to sum 1, so their sum
			 * is always 1.0 and carries no blade-pass modulation. */
			bpf_env_push(&envst, f.total_rms);

			float v[ACO_FEATURE_DIM];
			aco_feat_pack(&f, v, ACO_FEATURE_DIM);
			for (int i = 0; i < ACO_FEATURE_DIM; i++) {
				acc[i] += v[i];
			}
		}

		/* Mean feature vector over the report interval: smooths per-frame
		 * noise and gives the AI/fallback path (below) one representative
		 * vector instead of FRAMES_PER_REPORT separate ones. */
		for (int i = 0; i < ACO_FEATURE_DIM; i++) {
			acc[i] /= (float)FRAMES_PER_REPORT;
		}

		/* Rotor speed: tacholess from the envelope (the demo has no live tacho);
		 * a real node uses rotor_tacho_rpm() from GPIO pulse intervals. */
		float       rpm = rotor_tacholess_rpm(envst.env, envst.count, ACO_FRAME_RATE_HZ, N_BLADES);
		const char *rpm_src = "ESTIMATED";
		if (!rotor_rpm_valid(rpm)) {
			/* rotor_rpm_valid()'s 3..30 rpm plausibility gate catches both
			 * a genuinely stopped/near-stopped rotor and an unreliable
			 * autocorrelation estimate (see rotor_tacholess_rpm()'s
			 * detectable-RPM-floor note in rotor_speed.h); either way, the
			 * canned track keeps rpm_src visibly distinct in the log so a
			 * downstream reader can tell an estimate from a substitution. */
			rpm     = s_canned_rpm[r]; /* fall back to the canned track */
			rpm_src = "CANNED";
		}
		float bpf = rotor_bpf_hz(rpm, N_BLADES);

		struct bpf_modulation mod;
		bpf_modulation_extract(&envst, bpf, ACO_FRAME_RATE_HZ, &mod);

		/* Anomaly score: AI if available, else deterministic fallback over the
		 * mean per-frame feature vector, boosted by blade-order modulation.
		 * With the 1-byte stub alp_inference_open() returned NULL, so the
		 * else branch always runs in the demo. */
		float score;
		if (c.inf != NULL) {
			/* AI path: fill the ANOMALY_INPUT_DIM-float input tensor
			 * [acc | bpf-modulation pack | rpm] and invoke. */
			alp_inference_tensor_t in_t;
			bool                   ai_ok = (alp_inference_get_input(c.inf, 0, &in_t) == ALP_OK) &&
			                               (in_t.data != NULL) &&
			                               (in_t.size_bytes >= ANOMALY_INPUT_DIM * sizeof(float)) &&
			                               (in_t.dtype == ALP_INFERENCE_DTYPE_F32);
			if (ai_ok) {
				float *inp = (float *)in_t.data;
				float  bpf_vec[BPF_FEATURE_DIM];

				memcpy(inp, acc, ACO_FEATURE_DIM * sizeof(float));
				bpf_modulation_pack(&mod, bpf_vec, BPF_FEATURE_DIM);
				memcpy(inp + ACO_FEATURE_DIM, bpf_vec, BPF_FEATURE_DIM * sizeof(float));
				inp[ACO_FEATURE_DIM + BPF_FEATURE_DIM] = rpm;
				ai_ok                                  = (alp_inference_invoke(c.inf) == ALP_OK);
			}
			if (ai_ok) {
				alp_inference_tensor_t out_t;
				ai_ok = (alp_inference_get_output(c.inf, 0, &out_t) == ALP_OK) &&
				        (out_t.data != NULL) && (out_t.size_bytes >= sizeof(float)) &&
				        (out_t.dtype == ALP_INFERENCE_DTYPE_F32);
				if (ai_ok) {
					score = *(const float *)out_t.data;
				}
			}
			if (!ai_ok) {
				score = aco_anomaly_fallback(acc, ACO_FEATURE_DIM, &s_baseline);
			}
		} else {
			score = aco_anomaly_fallback(acc, ACO_FEATURE_DIM, &s_baseline);
		}

		/* Blade-pass AM strength (already 0..1) raises the score; do NOT use the
		 * raw blade_order_energy, which is not a probability. */
		float blade = mod.modulation_depth;
		if (blade > score) {
			score = blade;
		}
		if (score > 1.0f) {
			score = 1.0f;
		}

		/*
		 * Heuristic subsystem + flags (advisory; AI/fallback gives the
		 * score above -- this block only labels WHERE a problem likely is,
		 * checked in priority order so the first, most specific match wins:
		 *
		 *  1. BLADE_BPF/IMBALANCE  -- strong once-per-revolution amplitude
		 *     modulation (fundamental blade-order energy > 0.2 of AC energy
		 *     AND overall modulation_depth > 0.3) is the fingerprint of an
		 *     unbalanced or damaged blade beating the hum at 1x BPF.
		 *  2. DRIVETRAIN_TONAL/GEARMESH -- checked only if (1) did not match;
		 *     energy concentrated in GEARMESH_BAND (the log-band the
		 *     synthetic ~600 Hz gear-mesh tone lands in) flags a tonal
		 *     component from the gearbox rather than the blades.
		 *  3. BLADE_BPF/TE_WHISTLE -- low spectral flatness (tonal, not
		 *     broadband) with neither of the above is the fallback guess
		 *     for a trailing-edge whistle; still labelled BLADE_BPF since
		 *     TE erosion is a blade-surface defect.
		 *  4. BROADBAND/NONE (the initial subsystem/flags values) -- no
		 *     narrowband signature found; broadband aero noise/erosion.
		 */
		int   subsystem = 2; /* BROADBAND */
		char  flags[32] = "NONE";
		float gearmesh  = acc[GEARMESH_BAND];
		if (mod.modulation_depth > 0.3f && mod.blade_order_energy[0] > 0.2f) {
			subsystem = 0; /* BLADE_BPF */
			strcpy(flags, "IMBALANCE");
		} else if (gearmesh > 0.3f) {
			subsystem = 1; /* DRIVETRAIN_TONAL */
			strcpy(flags, "GEARMESH");
		} else if (acc[ACO_N_BANDS + 0] < 0.3f) { /* low flatness -> tonal */
			subsystem = 0;
			strcpy(flags, "TE_WHISTLE");
		}

		float top_band_hz = (float)GEARMESH_BAND * (ACO_SR_HZ / 2.0f) / (float)ACO_N_BANDS;
		printk("WTAC,%.1f,%.1f,%.2f,%.2f,%s,%.1f,%s,%s\n",
		       (double)(r * 4.0f),
		       (double)rpm,
		       (double)bpf,
		       (double)score,
		       subsystem_name(subsystem),
		       (double)top_band_hz,
		       flags,
		       rpm_src);
	}

	if (c.inf != NULL) {
		alp_inference_close(c.inf);
	}
	if (c.mic != NULL) {
		alp_audio_in_stop(c.mic);
		alp_audio_in_close(c.mic);
	}
	if (c.tacho != NULL) {
		alp_gpio_close(c.tacho);
	}
	printk("[wtac] done\n");
	return 0;
}
```

## src/acoustic_features.c
```c
/*
 * Copyright 2026 Alp Lab AB
 * SPDX-License-Identifier: Apache-2.0
 *
 * acoustic_features implementation -- see acoustic_features.h.
 */
#include "acoustic_features.h"

#include <math.h>
#include <string.h>

/*
 * SPECTRAL + STATISTICAL MATH -- via <alp/dsp.h>, not hand-rolled.
 * ---------------------------------------------------------------
 * This example does NOT re-derive an FFT or the time-domain moment
 * statistics by hand, and it does NOT call CMSIS-DSP arm_* directly.
 * Both go through the portable <alp/dsp.h> surface, so the SAME source
 * builds for native_sim and the Cortex-M55 alike and the SDK -- not the
 * app -- owns the CMSIS-vs-portable choice:
 *
 *   1. FFT -> alp_dsp_chain (ALP_DSP_STAGE_FFT).  The backend runs
 *      CMSIS-DSP arm_rfft_fast_f32 (Helium-vectorised) on the M55, a
 *      hardware DSP block where the SoM has one, and a portable-C radix-2
 *      fallback under native_sim -- selected by the backend registry.
 *
 *   2. Scalar window statistics (mean, RMS, abs-peak) -> alp_dsp_stats_f32,
 *      which the SDK backs with CMSIS-DSP arm_mean/rms/absmax_f32 on
 *      Cortex-M and a portable-C pass elsewhere.  Keeping both on
 *      <alp/dsp> lets the identical source run on the V2N (A55 + DRP-AI)
 *      path, which has no CMSIS-M.
 *
 * Only kurtosis stays a hand-written loop -- it is a 4th standardised
 * moment with no CMSIS (or alp_dsp) kernel.
 */
#include <alp/dsp.h>

/* ---------------------------------------------------------------------------
 * Frame accumulator helpers.
 *
 * Samples arrive one at a time from the codec DMA callback.  The ring of
 * ACO_FRAME_N samples is filled linearly (count tracks how many are valid);
 * when count reaches ACO_FRAME_N the caller may extract features and then
 * call aco_frame_reset() to start the next frame.
 * ---------------------------------------------------------------------------
 */
void aco_frame_reset(struct aco_frame_state *st)
{
	st->count = 0;
}

void aco_frame_push(struct aco_frame_state *st, float sample)
{
	if (st->count < ACO_FRAME_N) {
		st->samples[st->count++] = sample;
	}
}

bool aco_frame_full(const struct aco_frame_state *st)
{
	return st->count >= ACO_FRAME_N;
}

/* ---------------------------------------------------------------------------
 * aco_feat_extract -- extract all per-frame features from a filled frame.
 *
 * Three sequential sub-passes over the samples:
 *
 *   Sub-pass A (time domain): DC removal, AC variance, kurtosis.
 *   Sub-pass B (frequency domain): FFT, spectral centroid, spectral flatness.
 *   Sub-pass C (band energy): log-spaced band accumulation, normalisation.
 *
 * All outputs are zeroed first; any early-exit on a silent frame leaves them
 * at zero, which is a safe sentinel the anomaly scorer can detect.
 * ---------------------------------------------------------------------------
 */
void aco_feat_extract(const struct aco_frame_state *st, float sr_hz, struct aco_features *out)
{
	const int n = (st->count < ACO_FRAME_N) ? st->count : ACO_FRAME_N;

	memset(out, 0, sizeof(*out));
	if (n <= 0) {
		return;
	}

	/* ----- Sub-pass A: time-domain statistics --------------------------------
	 *
	 * Step A1 -- DC removal.
	 *   Remove the sample mean before computing any feature.  This eliminates
	 *   microphone offset and slow ambient-pressure drift so that RMS and
	 *   kurtosis reflect only the AC (vibration) content.
	 *
	 * Step A2 -- Variance and RMS.
	 *   var = (1/n) * sum( (x_i - mu)^2 )
	 *   total_rms = sqrt(var)
	 *   RMS is the most direct proxy for vibration amplitude; a healthy
	 *   turbine has a narrow operating band; sustained elevation flags overload.
	 *
	 * Step A3 -- Kurtosis (4th standardised central moment).
	 *   kurtosis = E[(x-mu)^4] / (E[(x-mu)^2])^2  =  (sum4/n) / var^2
	 *   For a Gaussian signal kurtosis ≈ 3.  Impulsive fault signatures such
	 *   as rolling-element bearing spall impacts push kurtosis well above 10.
	 *   Division is guarded by a near-zero variance threshold to avoid NaN.
	 * --------------------------------------------------------------------------
	 */
	/*
	 * xc[] holds the DC-removed window shared by the time-domain stats AND
	 * the FFT below; the tail [n, ACO_FRAME_N) is zero-padded so a short
	 * frame can still feed the fixed-size FFT.  static: aco_feat_extract is
	 * not re-entrant (single codec path), keeps a 1 kB buffer off the stack.
	 *
	 * One alp_dsp_stats_f32 pass over the raw window yields the mean
	 * (Step A1); a second over the mean-centred buffer yields the AC RMS
	 * and abs-peak (Step A2, plus the peak used to scale the FFT feed
	 * below) with the DC bias removed in one shot.  The SDK backs these
	 * with CMSIS-DSP arm_mean/rms/absmax_f32 on the M55 and a portable-C
	 * pass under native_sim -- no arm_* here.
	 */
	static float xc[ACO_FRAME_N];

	alp_dsp_stats_t raw;
	alp_dsp_stats_f32(st->samples, (size_t)n, &raw);
	const float mean = raw.mean;

	for (int i = 0; i < n; i++) {
		xc[i] = st->samples[i] - mean;
	}
	for (int i = n; i < ACO_FRAME_N; i++) {
		xc[i] = 0.0f; /* zero-pad the FFT tail on a short frame */
	}

	alp_dsp_stats_t ac;
	alp_dsp_stats_f32(xc, (size_t)n, &ac);
	float peak     = ac.abs_max;  /* peak |xc|                       */
	float var      = ac.variance; /* == mean(xc^2) since mean(xc)~=0 */
	out->total_rms = ac.rms;      /* AC RMS = sqrt(mean(xc^2))       */

	/*
	 * Kurtosis (4th standardised central moment): CMSIS-DSP ships no
	 * 4th-moment kernel, so the sum-of-4th-powers stays a portable loop
	 * over xc -- alp_dsp_stats_f32 covers mean/RMS/abs-peak/variance above,
	 * not this.
	 *   kurtosis = E[(x-mu)^4] / (E[(x-mu)^2])^2 = (sum4/n) / var^2
	 *   Gaussian noise gives kurtosis ~= 3; impulsive fault signatures
	 *   such as rolling-element bearing spall impacts push it above 10.
	 */
	float sum4 = 0.0f;
	for (int i = 0; i < n; i++) {
		float x2 = xc[i] * xc[i];
		sum4 += x2 * x2;
	}
	out->kurtosis = (var > 1e-12f) ? ((sum4 / (float)n) / (var * var)) : 0.0f;

	/*
	 * ----- Sub-pass B: frequency-domain statistics via the portable
	 * <alp/dsp.h> chain (NOT a hand-rolled FFT). ---------------------------
	 *
	 * A single ALP_DSP_STAGE_FFT (rectangular, no window) transforms the
	 * DC-removed frame to magnitude bins.  The backend runs CMSIS-DSP
	 * arm_rfft_fast_f32 on the M55 and a portable-C radix-2 FFT under
	 * native_sim -- the example source is identical either way.
	 *
	 * The chain consumes int16 samples (the codec's native PCM format).
	 * We scale the float frame to fill the int16 range before feeding it:
	 * the absolute scale is irrelevant here because every downstream
	 * spectral feature below (centroid, flatness, band energies) is
	 * ratio-based and therefore scale-invariant.
	 *
	 * The FFT of ACO_FRAME_N (= 256) points gives 128 positive-frequency
	 * bins; bin k corresponds to frequency f_k = k * sr_hz / ACO_FRAME_N.
	 * Bin 0 (DC) is discarded; only bins 1..half-1 are used.
	 *
	 * Spectral centroid:
	 *   f_c = sum_k(f_k * |X_k|) / sum_k(|X_k|)
	 *   The magnitude-weighted mean frequency rises when energy shifts to higher
	 *   harmonics, e.g. under gear-mesh wear or bearing defects.
	 *
	 * Spectral flatness (Wiener entropy):
	 *   SF = geometric_mean(|X|) / arithmetic_mean(|X|)
	 *      = exp( mean(log(|X_k| + eps)) ) / mean(|X_k| + eps)
	 *   SF ≈ 1 for broadband / white-noise excitation; SF → 0 as the spectrum
	 *   concentrates on a pure tone.  A turbine with broken blade develops a
	 *   strong tonal signature, pulling SF below the healthy baseline.
	 *   A small epsilon (1e-9) floors each magnitude to avoid log(0).
	 * --------------------------------------------------------------------------
	 */
	static int16_t samp_q15[ACO_FRAME_N];
	float          scale = (peak > 1e-9f) ? (30000.0f / peak) : 0.0f;
	for (int i = 0; i < ACO_FRAME_N; i++) {
		samp_q15[i] = (int16_t)lrintf(xc[i] * scale);
	}

	static float    mag[ACO_FRAME_N];
	alp_dsp_stage_t stages[] = {
		{ .kind  = ALP_DSP_STAGE_FFT,
		  .u.fft = { .n_points = ACO_FRAME_N, .output_format = ALP_DSP_FFT_OUTPUT_MAGNITUDE } },
	};
	alp_dsp_chain_t *chain = alp_dsp_chain_open(stages, 1u);
	size_t           got   = 0;
	memset(mag, 0, sizeof(mag));
	if (chain != NULL) {
		(void)alp_dsp_chain_apply_bins(chain, samp_q15, ACO_FRAME_N, mag, ACO_FRAME_N, &got);
		alp_dsp_chain_close(chain);
	}

	/* half = N/2 = 128: positive-frequency bin count; mag[] (from the
	 * chain above) stores the single-sided magnitudes used by both the
	 * spectral stats and band C.  mag_total/centroid_num: centroid
	 * denominator and numerator respectively.  log_sum/lin_sum: per-bin
	 * log and linear accumulations for flatness. */
	const int half      = ACO_FRAME_N / 2;
	float     mag_total = 0.0f, centroid_num = 0.0f;
	float     log_sum = 0.0f, lin_sum = 0.0f;
	int       active = 0;
	for (int k = 1; k < half; k++) {
		float m = mag[k];
		float f = (float)k * sr_hz / (float)ACO_FRAME_N;
		mag_total += m;
		centroid_num += f * m;
		/* Spectral flatness on a small-epsilon floored magnitude. */
		float me = m + 1e-9f;
		log_sum += logf(me);
		lin_sum += me;
		active++;
	}
	/* Derive centroid and flatness from the per-bin accumulators computed above. */
	out->spectral_centroid_hz = (mag_total > 1e-12f) ? (centroid_num / mag_total) : 0.0f;
	if (active > 0 && lin_sum > 1e-12f) {
		float geo              = expf(log_sum / (float)active);
		float arith            = lin_sum / (float)active;
		out->spectral_flatness = geo / arith;
	} else {
		out->spectral_flatness = 0.0f;
	}

	/* ----- Sub-pass C: log-spaced band energies ------------------------------
	 *
	 * Human hearing -- and turbine fault signatures -- scale logarithmically in
	 * frequency.  Each FFT bin k (1..half-1) is mapped to a band index via:
	 *
	 *     band = floor( log(k) / log(half) * ACO_N_BANDS )
	 *
	 * This distributes the 127 positive bins into ACO_N_BANDS (12) equal-ratio
	 * bands.  Bin k=1 always maps to band 0; bin k=half-1 ≈ band 11.
	 *
	 * Energy is accumulated as |X_k|^2 (power spectrum), consistent with
	 * Parseval's theorem.  The band sums are then divided by the total spectral
	 * power so that band_energy[] sums to 1.0 regardless of signal level,
	 * making the feature invariant to microphone gain and rotor distance.
	 *
	 * A near-zero total (silent / clipped frame) returns early; all outputs
	 * remain at the zeroed-by-memset sentinel.
	 * --------------------------------------------------------------------------
	 */
	/* Accumulate total spectral power; used as the normalisation divisor. */
	float mag2_total = 0.0f;
	for (int k = 1; k < half; k++) {
		mag2_total += mag[k] * mag[k];
	}
	if (mag2_total < 1e-20f) {
		return;
	}
	for (int k = 1; k < half; k++) {
		/* pos in [0,1) maps linearly to band index on the log-frequency axis. */
		float pos = logf((float)k) / logf((float)half);
		int   b   = (int)(pos * (float)ACO_N_BANDS);
		if (b < 0) {
			b = 0;
		}
		if (b >= ACO_N_BANDS) {
			b = ACO_N_BANDS - 1;
		}
		out->band_energy[b] += mag[k] * mag[k];
	}
	/* Normalise each band by total power -> unit-sum energy fraction. */
	for (int b = 0; b < ACO_N_BANDS; b++) {
		out->band_energy[b] /= mag2_total;
	}
}

/* Pack all features into a flat float vector in the order expected by the
 * downstream model (or aco_anomaly_fallback): band_energy[0..11], then
 * spectral_flatness, spectral_centroid_hz, kurtosis, total_rms.
 * Returns the number of elements written (== ACO_FEATURE_DIM) or 0 if cap
 * is too small. */
size_t aco_feat_pack(const struct aco_features *f, float *vec, size_t cap)
{
	if (cap < (size_t)ACO_FEATURE_DIM) {
		return 0;
	}
	size_t i = 0;
	for (int b = 0; b < ACO_N_BANDS; b++) {
		vec[i++] = f->band_energy[b];
	}
	/* Scalar features appended in the order the downstream model expects them. */
	vec[i++] = f->spectral_flatness;
	vec[i++] = f->spectral_centroid_hz;
	vec[i++] = f->kurtosis;
	vec[i++] = f->total_rms;
	return i; /* == ACO_FEATURE_DIM */
}

/* ---------------------------------------------------------------------------
 * aco_anomaly_fallback -- diagonal Mahalanobis anomaly score.
 *
 * This is the CPU-only fallback used when no trained NPU model is loaded.
 * It compares the current feature vector against a stored healthy-operation
 * baseline (per-feature mean and inverse variance) and returns a bounded
 * anomaly score.
 *
 * Step 1 -- Squared diagonal Mahalanobis distance:
 *
 *     d^2 = sum_i [ (x_i - mu_i)^2 * inv_var_i ]
 *
 *   The diagonal approximation treats features as independent.  inv_var_i =
 *   1/sigma_i^2 scales each dimension by its variability in normal operation,
 *   so features with tight healthy distributions contribute more to the score.
 *
 * Step 2 -- Squash to [0, 1):
 *
 *     score = 1 - exp(-d^2 / ACO_FEATURE_DIM)
 *
 *   Dividing by ACO_FEATURE_DIM normalises the exponent to a per-feature
 *   average Mahalanobis deviation, making the curve independent of vector
 *   length.  score → 0 when d^2 ≈ 0 (healthy match); score → 1 as
 *   deviation grows large.  The hard clamp [0,1] handles any float edge cases.
 * ---------------------------------------------------------------------------
 */
float aco_anomaly_fallback(const float *vec, size_t n, const struct aco_baseline *base)
{
	float d2 = 0.0f;
	for (size_t i = 0; i < n; i++) {
		float dx = vec[i] - base->mean[i];
		d2 += dx * dx * base->inv_var[i];
	}
	/* Squash to [0,1): grows with normalised distance, saturates smoothly. */
	float score = 1.0f - expf(-d2 / (float)ACO_FEATURE_DIM);
	if (score < 0.0f) {
		score = 0.0f;
	}
	if (score > 1.0f) {
		score = 1.0f;
	}
	return score;
}
```

## src/acoustic_features.h
```c
/*
 * Copyright 2026 Alp Lab AB
 * SPDX-License-Identifier: Apache-2.0
 *
 * acoustic_features -- pure-C per-frame DSP feature extraction for the
 * wind-turbine acoustic anomaly monitor.  Arch-neutral (stdint/math only):
 * builds for native_sim and the Cortex-M55 alike; host-unit-tested.
 */
#ifndef ACOUSTIC_FEATURES_H
#define ACOUSTIC_FEATURES_H

#include <stdbool.h>
#include <stddef.h>
#include <stdint.h>

#ifdef __cplusplus
extern "C" {
#endif

/** FFT and frame-buffer length; must be a power of two for the radix-2 FFT. */
#define ACO_FRAME_N 256
/** Number of logarithmically-spaced spectral bands in the feature vector. */
#define ACO_N_BANDS 12
/** Default codec sample rate; determines the Hz-per-bin mapping in aco_feat_extract(). */
#define ACO_SR_HZ 16000.0f
/** 12 band energies + flatness + centroid + kurtosis + total_rms. */
#define ACO_FEATURE_DIM (ACO_N_BANDS + 4)

/** Per-frame sample accumulator; filled one sample at a time by aco_frame_push(). */
struct aco_frame_state {
	float    samples[ACO_FRAME_N]; /**< Raw audio samples (pre-DC-removal). */
	uint16_t count;                /**< Number of valid samples in [0, ACO_FRAME_N]. */
};

struct aco_features {
	float band_energy[ACO_N_BANDS]; /**< normalised log-band energy (sum 1). */
	float spectral_flatness;        /**< geo-mean/arith-mean: ~1 broadband, ~0 tonal. */
	float spectral_centroid_hz;     /**< magnitude-weighted mean frequency. */
	float kurtosis;                 /**< time-domain 4th moment (impulsiveness). */
	float total_rms;                /**< AC RMS (DC removed). */
};

/**
 * @brief Reset a frame state, discarding any accumulated samples.
 * @param st Frame state to clear; count is set to zero.
 */
void aco_frame_reset(struct aco_frame_state *st);

/**
 * @brief Append one sample to the frame buffer (no-op when the frame is full).
 * @param st     Frame state to update.
 * @param sample Raw audio sample (float, any scale).
 */
void aco_frame_push(struct aco_frame_state *st, float sample);

/**
 * @brief Return true when ACO_FRAME_N samples have been accumulated.
 * @param st Frame state to query.
 */
bool aco_frame_full(const struct aco_frame_state *st);

/**
 * @brief Compute all acoustic features from a filled (or partial) frame.
 *
 * Performs DC removal, time-domain statistics (RMS, kurtosis), an in-place
 * radix-2 FFT, spectral statistics (centroid, flatness) and log-spaced band
 * energies.  All features are written to @p out; @p out is zeroed first so a
 * silent/short frame returns a safe all-zero result.
 *
 * @param st     Frame buffer (should be full; partial frames are zero-padded).
 * @param sr_hz  Codec sample rate in Hz; use ACO_SR_HZ for the default codec.
 * @param out    Output struct; overwritten on every call.
 */
void aco_feat_extract(const struct aco_frame_state *st, float sr_hz, struct aco_features *out);

/**
 * @brief Flatten an aco_features struct into a contiguous float vector.
 *
 * Layout: band_energy[0..ACO_N_BANDS-1], spectral_flatness,
 * spectral_centroid_hz, kurtosis, total_rms (== ACO_FEATURE_DIM elements).
 *
 * @param f   Source features from aco_feat_extract().
 * @param vec Destination buffer; must hold at least ACO_FEATURE_DIM floats.
 * @param cap Capacity of @p vec in elements.
 * @return Number of elements written (== ACO_FEATURE_DIM), or 0 if cap too small.
 */
size_t aco_feat_pack(const struct aco_features *f, float *vec, size_t cap);

/** Healthy-baseline template: per-feature mean + inverse variance. */
struct aco_baseline {
	float mean[ACO_FEATURE_DIM];    /**< Per-feature mean of the healthy distribution. */
	float inv_var[ACO_FEATURE_DIM]; /**< Per-feature 1/sigma^2 of the healthy distribution. */
};

/**
 * Deterministic anomaly score in [0,1]: Mahalanobis-style deviation of @p vec
 * from the healthy @p base, squashed by `1 - exp(-d/ACO_FEATURE_DIM)`.  Runs when
 * no AI model is loaded so the demo still produces a real score.
 */
float aco_anomaly_fallback(const float *vec, size_t n, const struct aco_baseline *base);

#ifdef __cplusplus
}
#endif

#endif /* ACOUSTIC_FEATURES_H */
```

## src/bpf_modulation.c
```c
/*
 * Copyright 2026 Alp Lab AB
 * SPDX-License-Identifier: Apache-2.0
 *
 * bpf_modulation implementation -- see bpf_modulation.h.
 */
#include "bpf_modulation.h"

#include <math.h>
#include <string.h>

#ifndef M_PI
#define M_PI 3.14159265358979323846
#endif

/* ---------------------------------------------------------------------------
 * Envelope ring buffer helpers.
 *
 * The ring stores BPF_ENV_N per-frame energy summaries (e.g. total_rms from
 * the acoustic feature extractor).  At 62.5 fps this covers ~4 seconds --
 * long enough to resolve blade-pass periodicities down to ~0.25 Hz (15 rpm
 * with 1 blade), while staying within a modest static allocation.
 *
 * The ring is written with a power-of-two-safe modulo head pointer.  'count'
 * saturates at BPF_ENV_N; until it reaches BPF_ENV_N the buffer is not yet
 * full and the valid region is env[0..count-1] starting at index 0.
 * ---------------------------------------------------------------------------
 */
void bpf_env_reset(struct bpf_env_state *st)
{
	st->head  = 0;
	st->count = 0;
}

void bpf_env_push(struct bpf_env_state *st, float frame_energy)
{
	/* Write the new value at 'head' and advance head with wrap-around. */
	st->env[st->head] = frame_energy;
	st->head          = (uint16_t)((st->head + 1) % BPF_ENV_N);
	/* count saturates at BPF_ENV_N once the buffer is full. */
	if (st->count < BPF_ENV_N) {
		st->count++;
	}
}

/* ---------------------------------------------------------------------------
 * goertzel_power -- |X(f)|^2 at an arbitrary target frequency via Goertzel.
 *
 * WHY THIS STAYS HAND-ROLLED (not swapped for an FFT / CMSIS-DSP call):
 *   acoustic_features.c moved its full-spectrum FFT onto the portable
 *   <alp/dsp.h> chain (CMSIS-DSP arm_rfft_fast_f32 backend) because it
 *   needs every bin.  This file needs exactly ONE bin -- the live
 *   blade-pass harmonic k*bpf_hz, which shifts every call with the
 *   current RPM estimate and therefore never lands on a fixed FFT bin
 *   boundary.  An N-point FFT computes O(N log N) work to produce N
 *   bins and then discards all but one; the O(N) single-bin Goertzel
 *   recurrence below computes only the bin actually needed, at an
 *   arbitrary (non-bin-aligned) frequency.  CMSIS-DSP ships no Goertzel
 *   kernel to call instead, so this stays a portable loop -- it is the
 *   textbook-correct, cheaper tool for this job, not a gap.
 *
 * The Goertzel algorithm evaluates a single DFT bin without computing the full
 * FFT.  For a sequence x[0..n-1] and a target frequency target_hz at sample
 * rate fs, the normalised digital frequency is:
 *
 *     omega = 2*pi * target_hz / fs
 *     coeff = 2 * cos(omega)
 *
 * The algorithm runs the second-order IIR recurrence:
 *
 *     s0[i] = x[i] + coeff * s1[i-1] - s2[i-2]   (s[-1] = s[-2] = 0)
 *
 * After n samples the squared magnitude is:
 *
 *     |X|^2 = s1^2 + s2^2 - coeff * s1 * s2
 *
 * where s1 and s2 are the last two state values.  This form avoids computing
 * sin/cos a second time for the final output; it holds exactly because:
 *
 *     |X|^2 = |s1 - W^(-1) * s2|^2,  W = exp(j*omega)
 *
 * expanded with W^(-1) = cos(omega) - j*sin(omega) and sin^2 + cos^2 = 1.
 *
 * KEY PROPERTY: the target frequency is passed in as the *current* bpf_hz,
 * which is re-computed every extraction call from the live RPM estimate.
 * This makes the feature RPM-invariant: we always evaluate at the blade-pass
 * harmonic of the current shaft speed, not at a fixed Hz bin.
 * ---------------------------------------------------------------------------
 */
static float goertzel_power(const float *x, int n, float target_hz, float fs)
{
	if (target_hz <= 0.0f || fs <= 0.0f) {
		return 0.0f;
	}
	float w     = 2.0f * (float)M_PI * target_hz / fs;
	float coeff = 2.0f * cosf(w);
	/* Second-order IIR state; s1 is the most recent, s2 is one step older. */
	float s1 = 0.0f, s2 = 0.0f;
	for (int i = 0; i < n; i++) {
		float s0 = x[i] + coeff * s1 - s2;
		s2       = s1;
		s1       = s0;
	}
	/* |X|^2 = s1^2 + s2^2 - coeff*s1*s2  (real-only Goertzel output power). */
	return s1 * s1 + s2 * s2 - coeff * s1 * s2;
}

/* ---------------------------------------------------------------------------
 * bpf_modulation_extract -- extract blade-order energies and modulation depth.
 *
 * The function operates on the seconds-long envelope ring (bpf_env_state) and
 * extracts two classes of feature:
 *
 *   1. Blade-order energies (BPF_N_HARMONICS = 4 values):
 *      The Goertzel algorithm evaluates the envelope's AC energy at each
 *      harmonic k * bpf_hz (k = 1..4).  A healthy blade produces a clean 1x
 *      BPF signal; an aerodynamic fault or pitch imbalance raises higher
 *      harmonics disproportionately.
 *
 *   2. Modulation depth:
 *      modulation_depth = (max - min) / (max + min)
 *      This is the traditional AM depth metric applied to the energy envelope.
 *      It captures slow amplitude modulation independent of BPF frequency and
 *      is complementary to the Goertzel features.
 *
 * NORMALISATION of blade-order energies:
 *   By Parseval's theorem, sum_k |X_k|^2 = n * sum_i x[i]^2.  The raw
 *   Goertzel output |X(k*bpf)|^2 therefore scales with both n and the AC
 *   envelope power.  Dividing by (n * total) -- where total = sum x[i]^2 --
 *   maps each output to a bounded fraction in roughly [0, 1] that is
 *   independent of window length and signal amplitude, making it comparable
 *   across frames.
 *
 * RING LINEARISATION:
 *   When the ring is full (count == BPF_ENV_N) the oldest sample is at
 *   index 'head' (the next write position); the newest is one position before
 *   'head' in the wrapped sense.  The linearisation loop reads
 *   env[(start + i) % BPF_ENV_N] for i = 0..n-1, writing oldest→newest into
 *   the temporary buf[].  When the ring is not yet full (count < BPF_ENV_N)
 *   the data runs from index 0 without wrapping, so start = 0.
 * ---------------------------------------------------------------------------
 */
void bpf_modulation_extract(const struct bpf_env_state *st,
                            float                       bpf_hz,
                            float                       frame_rate_hz,
                            struct bpf_modulation      *out)
{
	memset(out, 0, sizeof(*out));
	const int n = (st->count < BPF_ENV_N) ? st->count : BPF_ENV_N;
	if (n < 8) {
		return;
	}

	/* Linearise the ring (oldest..newest) into buf[], mean-removing in place.
	 * When the ring is full, start = head (oldest slot); otherwise start = 0. */
	static float buf[BPF_ENV_N];
	float        mean  = 0.0f;
	int          start = (st->count < BPF_ENV_N) ? 0 : st->head;
	for (int i = 0; i < n; i++) {
		buf[i] = st->env[(start + i) % BPF_ENV_N];
		mean += buf[i];
	}
	mean /= (float)n;

	/* Scan for peak and valley before subtracting the mean.
	 * emin/emax are used for modulation_depth on the original (non-mean-removed)
	 * envelope; buf[] is then mean-removed for the Goertzel passes. */
	float emin = buf[0], emax = buf[0];
	for (int i = 0; i < n; i++) {
		if (buf[i] < emin) {
			emin = buf[i];
		}
		if (buf[i] > emax) {
			emax = buf[i];
		}
		buf[i] -= mean;
	}

	/* Total AC (mean-removed) envelope power for Goertzel normalisation.
	 * After mean removal, sum x[i]^2 is the AC signal energy. */
	float total = 0.0f;
	for (int i = 0; i < n; i++) {
		total += buf[i] * buf[i];
	}
	/* |X(k)|^2 sums to n*Sigma|x|^2 (Parseval); divide by (n*total) so each
	 * blade-order energy is a bounded fraction of the envelope AC energy. */
	float norm = (total > 1e-12f) ? (1.0f / ((float)n * total)) : 0.0f;

	/* Evaluate Goertzel at each BPF harmonic k*bpf_hz (k=1..BPF_N_HARMONICS).
	 * Passing the live bpf_hz (derived from current RPM) keeps each feature
	 * pinned to the blade-pass harmonic regardless of shaft speed variation. */
	for (int k = 1; k <= BPF_N_HARMONICS; k++) {
		float p                        = goertzel_power(buf, n, (float)k * bpf_hz, frame_rate_hz);
		out->blade_order_energy[k - 1] = p * norm;
	}
	/* Modulation depth: (peak - trough) / (peak + trough).
	 * Guard against a near-zero denominator (constant / silent envelope). */
	out->modulation_depth = (emax + emin > 1e-9f) ? ((emax - emin) / (emax + emin)) : 0.0f;
}

/* Pack blade-order energies and modulation_depth into a flat float vector for
 * the downstream model.  Layout: blade_order_energy[0..3], modulation_depth.
 * Returns the number of elements written (== BPF_FEATURE_DIM) or 0 if cap
 * is too small. */
size_t bpf_modulation_pack(const struct bpf_modulation *m, float *vec, size_t cap)
{
	if (cap < (size_t)BPF_FEATURE_DIM) {
		return 0;
	}
	size_t i = 0;
	for (int k = 0; k < BPF_N_HARMONICS; k++) {
		vec[i++] = m->blade_order_energy[k];
	}
	vec[i++] = m->modulation_depth;
	return i; /* == BPF_FEATURE_DIM */
}
```

## src/bpf_modulation.h
```c
/*
 * Copyright 2026 Alp Lab AB
 * SPDX-License-Identifier: Apache-2.0
 *
 * bpf_modulation -- pure-C blade-order analysis of the band-energy envelope.
 * Blade faults modulate audible-band energy at the blade-pass frequency (BPF);
 * a Goertzel evaluated at the *current* BPF makes the feature RPM-invariant.
 * Drivetrain gear-mesh tones are per-frame spectral (in acoustic_features), not
 * here.  Arch-neutral; host-unit-tested.
 */
#ifndef BPF_MODULATION_H
#define BPF_MODULATION_H

#include <stddef.h>
#include <stdint.h>

#ifdef __cplusplus
extern "C" {
#endif

/** Ring-buffer depth: ~4 s of per-frame energy at 62.5 fps. */
#define BPF_ENV_N 256
/** Number of BPF harmonics evaluated by the Goertzel filter (1x..4x BPF). */
#define BPF_N_HARMONICS 4
/** Feature vector length: BPF_N_HARMONICS blade-order energies + modulation_depth. */
#define BPF_FEATURE_DIM (BPF_N_HARMONICS + 1)

/**
 * Seconds-long ring buffer of per-frame energy summaries.
 * head points to the next write slot; count saturates at BPF_ENV_N.
 */
struct bpf_env_state {
	float    env[BPF_ENV_N]; /**< Per-frame energy ring (absolute amplitude, not normalised). */
	uint16_t head;           /**< Next write position (oldest slot when ring is full). */
	uint16_t count;          /**< Valid entries in [0, BPF_ENV_N]. */
};

struct bpf_modulation {
	float blade_order_energy
	    [BPF_N_HARMONICS];  /**< fraction of envelope AC energy at k*BPF (0..~1). */
	float modulation_depth; /**< (max-min)/(max+min) of the envelope. */
};

/**
 * @brief Reset the envelope ring buffer to the empty state.
 * @param st Ring buffer to clear.
 */
void bpf_env_reset(struct bpf_env_state *st);

/** Append one per-frame energy summary (e.g. the frame's total RMS -- an
 *  ABSOLUTE energy that carries the blade-pass amplitude modulation; do not
 *  pass normalised band energies, whose sum is constant). */
void bpf_env_push(struct bpf_env_state *st, float frame_energy);

/**
 * @brief Extract blade-order energies and modulation depth from the envelope ring.
 *
 * Evaluates a generalised Goertzel at each harmonic k*bpf_hz (k=1..BPF_N_HARMONICS)
 * and computes the peak-to-trough modulation depth of the energy envelope.
 * Passing the live bpf_hz (derived from the current RPM estimate) keeps the
 * Goertzel bins aligned with the rotor regardless of speed variation.
 *
 * @param st           Envelope ring buffer (should hold at least 8 frames).
 * @param bpf_hz       Blade-pass frequency at the current shaft speed (Hz).
 * @param frame_rate_hz Sample rate of the envelope ring (ACO_FRAME_RATE_HZ).
 * @param out          Output; zeroed before filling.
 */
void bpf_modulation_extract(const struct bpf_env_state *st,
                            float                       bpf_hz,
                            float                       frame_rate_hz,
                            struct bpf_modulation      *out);

/**
 * @brief Flatten bpf_modulation into a contiguous float vector.
 *
 * Layout: blade_order_energy[0..BPF_N_HARMONICS-1], modulation_depth.
 *
 * @param m   Source modulation features.
 * @param vec Destination buffer; must hold at least BPF_FEATURE_DIM floats.
 * @param cap Capacity of @p vec in elements.
 * @return Number of elements written (== BPF_FEATURE_DIM), or 0 if cap too small.
 */
size_t bpf_modulation_pack(const struct bpf_modulation *m, float *vec, size_t cap);

#ifdef __cplusplus
}
#endif

#endif /* BPF_MODULATION_H */
```

## src/rotor_speed.h
```c
/*
 * Copyright 2026 Alp Lab AB
 * SPDX-License-Identifier: Apache-2.0
 *
 * rotor_speed -- pure-C rotor RPM estimation (tacho pulse-interval and
 * tacholess from the band-energy envelope) + blade-pass frequency.
 * Arch-neutral; host-unit-tested.
 */
#ifndef ROTOR_SPEED_H
#define ROTOR_SPEED_H

#include <stdbool.h>
#include <stddef.h>
#include <stdint.h>

#ifdef __cplusplus
extern "C" {
#endif

/** Per-frame rate of the acoustic front end (ACO_SR_HZ / ACO_FRAME_N). */
#define ACO_FRAME_RATE_HZ 62.5f

/**
 * @brief Compute the blade-pass frequency from shaft speed.
 *
 * BPF = n_blades * rpm / 60.  This is the rotor-order fundamental that
 * indexes all blade-pass harmonic analysis (see bpf_modulation.h).
 *
 * @param rpm      Shaft speed in revolutions per minute.
 * @param n_blades Number of rotor blades (typically 3 for utility-scale turbines).
 * @return Blade-pass frequency in Hz.
 */
float rotor_bpf_hz(float rpm, uint8_t n_blades);

/**
 * @brief Plausibility gate for a wind-turbine rotor (3..30 rpm).
 * @param rpm RPM estimate to validate.
 * @return true if rpm is within the operational range; false otherwise.
 */
bool rotor_rpm_valid(float rpm);

/**
 * @brief RPM from a tacho pulse interval (us) and pulses-per-revolution.
 *
 * rev_period_us = pulse_interval_us * pulses_per_rev;
 * rpm = 60e6 / rev_period_us.
 *
 * @param pulse_interval_us Time between consecutive tachometer pulses in microseconds.
 * @param pulses_per_rev    Number of pulses the tachometer emits per shaft revolution.
 * @return Shaft speed in RPM, or 0.0f if either argument is zero.
 */
float rotor_tacho_rpm(uint32_t pulse_interval_us, uint16_t pulses_per_rev);

/**
 * Estimate RPM from the band-energy envelope's blade-pass modulation:
 * autocorrelation peak over the plausible lag range -> BPF -> RPM.
 * The mic-only fallback when no tacho is present.
 *
 * NOTE: the detectable RPM floor is ~ 60 * frame_rate_hz / (n_blades * (n/2));
 * for n=256 at 62.5 fps with 3 blades that is ~10 rpm -- below it the estimate
 * is unreliable even though rotor_rpm_valid() accepts down to 3 rpm.  A real node
 * prefers the tacho path (rotor_tacho_rpm) at low speed.
 */
float rotor_tacholess_rpm(const float *env, size_t n, float frame_rate_hz, uint8_t n_blades);

#ifdef __cplusplus
}
#endif

#endif /* ROTOR_SPEED_H */
```
