## CMakeLists.txt
```
# SPDX-License-Identifier: Apache-2.0
cmake_minimum_required(VERSION 3.20.0)

find_package(Zephyr REQUIRED HINTS $ENV{ZEPHYR_BASE})
project(audio_noise_suppression LANGUAGES C)

target_sources(app PRIVATE
    src/main.c
)
```

## prj.conf
```kconfig
# SPDX-License-Identifier: Apache-2.0

CONFIG_MAIN_STACK_SIZE=8192
CONFIG_HEAP_MEM_POOL_SIZE=131072

CONFIG_LOG=y
CONFIG_LOG_PRINTK=y

CONFIG_CBPRINTF_FP_SUPPORT=y

CONFIG_THREAD_NAME=y

CONFIG_ALP_SDK_INFERENCE_BACKEND_TFLM=y

# alp_dsp_chain_* (<alp/dsp.h>) for the FFT + magnitude pipeline.
# Gated separately so apps that don't use the DSP surface don't pay
# the libm + CMSIS-DSP link cost.
CONFIG_ALP_SDK_DSP=y
```

## native_sim.conf
```kconfig
# SPDX-License-Identifier: Apache-2.0
#
# native_sim-only overlay for audio-noise-suppression.
#
# The generated alp.conf (from board.yaml) turns on the real-silicon
# audio + DSP stack: CONFIG_I2S=y for the TAS2563 codec link,
# CONFIG_CMSIS_DSP / CONFIG_ALP_SDK_DSP for the FFT chain, and the
# TFLM inference backend.  native_sim has no I2S controller and no
# NPU, so this overlay keeps the build host-only:
#
#   - The DSP chain runs the portable C / CMSIS-DSP fallback (the
#     example explicitly relies on this path under native_sim), so we
#     KEEP CONFIG_ALP_SDK_DSP / CONFIG_CMSIS_DSP on.
#   - There is no I2S device to bind; alp_audio_in/out_open() return
#     NULL and the loop tolerates it.  Drop the I2S subsystem so the
#     native_sim build doesn't pull a controller binding it can't
#     satisfy.
#
# This file is wired via testcase.yaml `extra_args:
# EXTRA_CONF_FILE=native_sim.conf` so it only applies to the
# native_sim variant -- the real-silicon (v2n) build keeps I2S on.
CONFIG_I2S=n
CONFIG_AUDIO=n
CONFIG_AUDIO_DMIC=n
```

## src/main.c
```c
/*
 * Copyright 2026 Alp Lab AB
 * SPDX-License-Identifier: Apache-2.0
 *
 * audio-noise-suppression
 * =======================
 *
 * Real-time noise suppression for the headset / hearable /
 * conferencing market.  Mic -> DSP preprocess -> small AI
 * denoiser -> speaker, end-to-end ~10 ms.
 *
 *   ┌─────────────────────┐  I2S0 RX  ┌──────────────────────────┐
 *   │ TAS2563 codec       │ ◀────────│ <alp/audio.h>            │
 *   │ (mic-in path)       │  240 fr   │  alp_audio_in_read       │
 *   └─────────────────────┘  block    │  -> 10 ms @ 24 kHz S16   │
 *                                      └────────────┬─────────────┘
 *                                                   │
 *                                                   ▼
 *   ┌──────────────────────────────────────────────────────────────┐
 *   │ <alp/dsp.h>  Hann window + 256-pt FFT (magnitude bins)       │
 *   │   - on V2N M33  the chain offloads to the GD32G553 bridge's  │
 *   │     FFT/FAC blocks (no native math accelerator on RZ/V2N --  │
 *   │     see project memory `v2n_no_dedicated_math_accelerator`)  │
 *   │   - on A55 / native_sim  CMSIS-DSP runs in-host on Neon /    │
 *   │     reference C                                              │
 *   │ Output: per-bin magnitudes feed the noise-floor estimator.   │
 *   └────────────────────────────┬─────────────────────────────────┘
 *                                │
 *                                ▼
 *   ┌──────────────────────────────────────────────────────────────┐
 *   │ <alp/inference.h>  RNNoise-style denoiser (gain mask per     │
 *   │ bin)                                                          │
 *   │   - AUTO: CPU TFLM kernels on this M33 slice (V2N, V2N-M1). │
 *   │   - ~50k params, int8 quantised, fits in 96 KiB arena.       │
 *   │ Output: per-bin gain mask -> applied to FFT bins -> inverse  │
 *   │ FFT (still stubbed) -> clean PCM block.                      │
 *   └────────────────────────────┬─────────────────────────────────┘
 *                                │
 *                                ▼ I2S0 TX
 *                       ┌─────────────────┐
 *                       │ TAS2563 codec   │
 *                       │ (speaker-out)   │
 *                       └─────────────────┘
 *
 *
 * ── Why this demo matters ─────────────────────────────────────
 *
 *   1. "Can we ship a USB-C headset / earbud with cloud-grade
 *      noise suppression at <10 ms latency?"  Yes -- the V2N's
 *      M33 + GD32 bridge FFT path keeps the spectral work on
 *      silicon close to the codec, and the gain-mask model runs
 *      on that same M33 slice (CPU TFLM kernels), inside the
 *      human-perceivable glass-to-glass threshold.
 *   2. "Same source for the desktop / conferencing rig?"  Yes --
 *      flipping `som.sku` to a V2N-M1 keeps CPU TFLM on
 *      this M33 slice; only an A55/Yocto app reaches the DX-M1.
 *   3. "Where does the SW fallback live?"  CMSIS-DSP on the host
 *      CPU.  On native_sim that's the reference C kernels; on an
 *      A55/Yocto build (a separate project) it is the Neon path.  The portable
 *      <alp/dsp.h> chain swap-in costs the customer zero lines.
 *
 *
 * ── Latency budget @ 24 kHz, 240-frame blocks (10 ms each) ────
 *
 *     Mic -> I2S RX DMA:        ~2.0 ms   (one block worth)
 *     <alp/dsp.h> FFT pipe:     ~1.5 ms   (GD32 bridge offload)
 *     <alp/inference.h> invoke: ~3.0 ms   (TFLM; unmeasured estimate)
 *     Mask apply + IFFT:        ~1.5 ms   (still stubbed)
 *     I2S TX DMA push:          ~2.0 ms
 *     ────────────────────────────────
 *     Total:                    ~10.0 ms  (one block period)
 *
 * The block period IS the latency budget -- we ping-pong DMA
 * such that each step touches the previous block while the I2S
 * peripheral grabs the next one.  Missing the budget shows up
 * as DMA underrun (audible glitch); the loop's read/write
 * timeouts (100 ms) are wider than the budget so a HiL test can
 * still report what happened instead of silently stalling.
 *
 *
 * ── What's stubbed in v0.5 ────────────────────────────────────
 *
 * - The real RNNoise-style model isn't checked in -- s_model[]
 *   holds a 1-byte placeholder.  TODO(v0.6) drops a TFLite
 *   noise-suppression model into models/ and #includes the
 *   generated header.
 * - DSP-chain weights / FFT bin-count / hop length / mask-apply
 *   weights are all TODO(v0.6).  The framing path here uses a
 *   Hann window + 256-pt FFT to validate the chain shape only.
 * - The IFFT + overlap-add stage that turns the bin-mask back
 *   into PCM is TODO(v0.6) -- v0.5 ships the bin-magnitudes ->
 *   denoiser dispatch direction.  v0.5 writes the mic block to
 *   the speaker (passthrough) so HiL can still hear the loop.
 * - Native_sim has neither codec nor inference NPU.  Every
 *   *_open returns NULL with NOSUPPORT and the loop tolerates
 *   it -- "[ns] done" still fires for twister.
 */

#include <stdio.h>
#include <stdint.h>
#include <string.h>

#include <zephyr/kernel.h>
#include <zephyr/logging/log.h>

#include "alp/audio.h"
#include "alp/dsp.h"
/* BOARD_I2S_AUDIO is a portable alias that resolves to the on-board
 * audio codec I2S bus on whichever EVK is being targeted:
 *   E1M EVK  (AEN)  → ALP_E1M_I2S0  (TAS2563 amps via 74LVC157 mux)
 *   E1M-X EVK (V2N) → ALP_E1M_X_I2S0 (TAS2563 smart-amp I2S)
 * Include via <alp/board.h>; ALP_BOARD_* is emitted by the build
 * system from the board.yaml preset. */
#include "alp/board.h"
#include "alp/inference.h"
#include "alp/peripheral.h"

LOG_MODULE_REGISTER(noise_suppress, LOG_LEVEL_INF);

/* ── Audio block geometry ──────────────────────────────────────
 *
 * 24 kHz mono S16 is the headset / conferencing standard for
 * speech-band denoisers (Nyquist at 12 kHz comfortably covers
 * the speech band; trades aliasing risk for lower data rate
 * versus 48 kHz music-grade).  240 frames per block = 10 ms,
 * which sets BOTH the DMA cadence and the perceived latency
 * budget.  See the header comment for the per-step breakdown.
 */
#define SR_HZ        24000
#define CHANNELS     1
#define BLOCK_FRAMES 240
#define BLOCK_MS     10
#define FFT_POINTS   256
#define DEMO_BLOCKS  50 /* ~500 ms of audio for HiL audibility. */

/* ── Placeholder denoiser model ────────────────────────────────
 *
 * TODO(v0.6): replace with the TFLite-compiled RNNoise-style
 * model
 *     #include "models/rnnoise_v06_int8.h"
 * The 1-byte stub is enough for the v0.5 framing path -- on
 * native_sim alp_inference_open returns NULL anyway.
 */
static const uint8_t s_model[] = { 0x00 };

/* Tensor arena -- 96 KiB matches board.yaml's default_arena_kib.
 * Sized for a ~50k-param int8 CNN with two-frame context (current
 * + previous block's bin magnitudes). */
static uint8_t s_arena[96 * 1024] __aligned(16);

/* PCM block buffers.  Two of them so the DSP / inference path can
 * touch the previous block while the I2S DMA grabs the next one
 * (ping-pong, see the latency budget table). */
static int16_t s_pcm_in[BLOCK_FRAMES * CHANNELS];
static int16_t s_pcm_out[BLOCK_FRAMES * CHANNELS];

/* FFT magnitude bins -- 256-pt FFT with MAGNITUDE output emits
 * `n_points` floats (not 2*n; that's the COMPLEX path).  See
 * <alp/dsp.h> for the contract. */
static float s_bin_mag[FFT_POINTS];

/* FFT input staging buffer.  alp_dsp_chain_apply_bins() consumes
 * EXACTLY FFT_POINTS (256) samples and returns ALP_ERR_OUT_OF_RANGE
 * if handed fewer.  A mic block is only BLOCK_FRAMES (240) samples,
 * so we accumulate consecutive blocks here until we have a full
 * 256-sample frame, then run the FFT once and carry the remainder
 * forward.  (A production denoiser uses 50%-overlap framing; this is
 * the simplest contiguous-fill scheme that keeps the FFT size and
 * the input length in agreement.) */
static int16_t s_fft_in[FFT_POINTS];
static size_t  s_fft_fill; /* samples currently staged in s_fft_in */

/* ── DSP chain: Hann window + 256-pt FFT ───────────────────────
 *
 * Two stages:
 *   1. WINDOW  -- Hann shape, length implied by the next FFT.
 *   2. FFT     -- 256 points, magnitude output (per-bin scalars).
 *
 * On V2N M33 the §D.lib loader routes the chain through the
 * GD32G553 bridge's FFT block (the M33 itself has no math
 * accelerator -- see project memory).  On A55 Yocto + native_sim
 * the chain runs in CMSIS-DSP on the host CPU.
 *
 * TODO(v0.6): tune n_points + window shape to whatever the
 * trained denoiser model expects on its bin input.  Most
 * RNNoise-derivatives use 480-sample frames + 50% overlap; we
 * use 256-pt here as a power-of-two starting point that the
 * <alp/dsp.h> validator accepts today.
 */
static const alp_dsp_stage_t s_dsp_stages[] = {
    {
        .kind = ALP_DSP_STAGE_WINDOW,
        .u.window = { .shape = ALP_DSP_WINDOW_HANN },
    },
    {
        .kind = ALP_DSP_STAGE_FFT,
        .u.fft = {
            .n_points      = FFT_POINTS,
            .output_format = ALP_DSP_FFT_OUTPUT_MAGNITUDE,
        },
    },
};

/* ── Shared state ──────────────────────────────────────────────
 *
 * Compact bag of handles so the loop function doesn't need a long
 * argument list.  Booleans track which backends actually opened
 * so the loop can degrade gracefully on native_sim (no codec, no
 * NPU) and still produce a "[ns] done" sentinel for twister.
 */
static struct {
	alp_audio_in_t  *mic;
	alp_audio_out_t *spk;
	alp_dsp_chain_t *dsp;
	alp_inference_t *inf;
	bool             mic_ok;
	bool             spk_ok;
	bool             dsp_ok;
	bool             inf_ok;
	uint32_t         blocks_run;
} g_state;

/* ── Push bin magnitudes into the model's input tensor ─────────
 *
 * RNNoise-style denoisers take the current frame's spectrum as
 * the per-frame input.  We dequantise on the float -> int8 hop
 * via the tensor descriptor's scale + zero_point (the loader
 * fills those from the model's quantisation table).
 *
 * Falls through silently on a stub backend that emits rank-0
 * tensors so the framing path keeps running.
 *
 * TODO(v0.6): the real model likely wants a log-mel projection
 * of the bins, not the raw magnitudes.  That preprocess lands as
 * a third DSP stage (mel filterbank) once <alp/dsp.h>'s stage
 * vocabulary grows.
 */
static void push_bins_into_model(alp_inference_t *inf, const float *bins, size_t n)
{
	alp_inference_tensor_t in = { 0 };
	if (alp_inference_get_input(inf, 0, &in) != ALP_OK) {
		return;
	}
	if (in.data == NULL || in.size_bytes == 0) {
		return; /* Stub backend; nothing to fill. */
	}
	if (in.dtype == ALP_INFERENCE_DTYPE_F32) {
		size_t bytes = n * sizeof(float);
		if (bytes > in.size_bytes) bytes = in.size_bytes;
		memcpy(in.data, bins, bytes);
	} else if (in.dtype == ALP_INFERENCE_DTYPE_INT8) {
		int8_t *q   = (int8_t *)in.data;
		size_t  cap = (in.size_bytes < n) ? in.size_bytes : n;
		for (size_t i = 0; i < cap; i++) {
			float   v  = bins[i] / (in.scale > 0.0f ? in.scale : 1.0f);
			int32_t qv = (int32_t)(v + 0.5f) + in.zero_point;
			if (qv > 127) qv = 127;
			if (qv < -128) qv = -128;
			q[i] = (int8_t)qv;
		}
	}
	/* TODO(v0.6): handle UINT8 / INT16 quantisation flavours
     * once the v0.6 quantisation matrix is locked. */
}

/* ── One block of the audio loop ───────────────────────────────
 *
 * Sequenced left-to-right per the latency-budget diagram:
 *   1. Read a 10 ms PCM block from the mic.
 *   2. Run the DSP chain to get 256 magnitude bins.
 *   3. Push bins into the denoiser, invoke.
 *   4. (TODO v0.6) apply the per-bin gain mask + IFFT.
 *   5. Write a 10 ms PCM block to the speaker.
 *
 * Step 4 is stubbed in v0.5 -- we passthrough s_pcm_in -> s_pcm_out
 * so HiL still hears the loop.  Once the inverse-FFT + overlap-add
 * stage lands in <alp/dsp.h> v0.6, that becomes a third chain
 * (synthesis chain) and the masking step slides between the two.
 */
static void process_one_block(void)
{
	/* 1. Mic-in. */
	if (g_state.mic_ok) {
		size_t got = 0;
		(void)alp_audio_in_read(g_state.mic, s_pcm_in, BLOCK_FRAMES, &got, /*timeout_ms=*/100);
	} else {
		memset(s_pcm_in, 0, sizeof(s_pcm_in));
	}

	/* 2. DSP preprocess (window + FFT -> magnitude bins).
     *
     * Stage the mic block into the FFT input buffer.  The FFT needs a
     * full FFT_POINTS (256) frame; one mic block is only BLOCK_FRAMES
     * (240).  Append, and only run the chain once we have >= 256
     * staged samples -- otherwise apply_bins() would return
     * ALP_ERR_OUT_OF_RANGE on every short block. */
	bool fft_ran = false;
	if (g_state.dsp_ok) {
		size_t take = BLOCK_FRAMES;
		if (s_fft_fill + take > FFT_POINTS) {
			take = FFT_POINTS - s_fft_fill;
		}
		memcpy(&s_fft_in[s_fft_fill], s_pcm_in, take * sizeof(int16_t));
		s_fft_fill += take;

		if (s_fft_fill >= FFT_POINTS) {
			size_t       got = 0;
			alp_status_t st  = alp_dsp_chain_apply_bins(
			    g_state.dsp, s_fft_in, FFT_POINTS, s_bin_mag, FFT_POINTS, &got);
			if (st != ALP_OK) {
				LOG_WRN("dsp apply_bins failed: st=%d (block %u)",
				        (int)st,
				        (unsigned)g_state.blocks_run);
			} else {
				fft_ran = true;
			}
			/* Carry the leftover tail of this block (the samples that
             * didn't fit before the FFT fired) to the front of the
             * next frame. */
			size_t leftover = BLOCK_FRAMES - take;
			if (leftover > FFT_POINTS) leftover = FFT_POINTS;
			memmove(s_fft_in, &s_pcm_in[take], leftover * sizeof(int16_t));
			s_fft_fill = leftover;
		}
	}

	/* 3. Inference (per-bin gain mask).  The output tensor is the
     *    mask itself in the trained model; v0.5 just invokes for
     *    framing-path correctness.  Only run when a fresh spectrum
     *    was produced this block. */
	if (g_state.inf_ok && fft_ran) {
		push_bins_into_model(g_state.inf, s_bin_mag, FFT_POINTS);
		(void)alp_inference_invoke(g_state.inf);
		/* TODO(v0.6): alp_inference_get_output() -> gain mask ->
         * multiply against the FFT bins (we'd keep the COMPLEX
         * output format then so phase survives) -> IFFT -> OLA. */
	}

	/* 4. v0.5 passthrough -- TODO(v0.6) replace with the
     *    masked + IFFT + overlap-add synthesis path. */
	memcpy(s_pcm_out, s_pcm_in, sizeof(s_pcm_out));

	/* 5. Speaker-out. */
	if (g_state.spk_ok) {
		size_t pushed = 0;
		(void)alp_audio_out_write(g_state.spk,
		                          s_pcm_out,
		                          BLOCK_FRAMES,
		                          &pushed,
		                          /*timeout_ms=*/100);
	}

	g_state.blocks_run++;
}

int main(void)
{
	printf("[ns] audio-noise-suppression v0.5 -- mic -> DSP -> AI -> speaker\n");
	printf("[ns]   block=%d frames @ %d Hz mono = %d ms latency target\n",
	       BLOCK_FRAMES,
	       SR_HZ,
	       BLOCK_MS);

	/* ── Open mic + speaker on the same I2S link ───────────
     *
     * The TAS2563 codec on both EVKs exposes both directions on
     * their respective I2S bus (the codec handles the PDM-to-I2S
     * conversion on its own pins).  BOARD_I2S_AUDIO resolves to
     * the audio codec I2S bus on whichever EVK is targeted
     * (ALP_E1M_I2S0 on AEN, ALP_E1M_X_I2S0 on V2N).  On native_sim
     * neither open() succeeds; the loop tolerates that. */
	alp_audio_config_t cfg = {
		.peripheral_id    = BOARD_I2S_AUDIO, /* E1M EVK: ALP_E1M_I2S0; E1M-X EVK: ALP_E1M_X_I2S0 */
		.sample_rate_hz   = SR_HZ,
		.channels         = CHANNELS,
		.format           = ALP_AUDIO_FMT_S16_LE,
		.frames_per_block = BLOCK_FRAMES,
	};
	g_state.mic    = alp_audio_in_open(&cfg);
	g_state.mic_ok = (g_state.mic != NULL);
	if (g_state.mic_ok) {
		printf("[ns]   alp_audio_in_open(I2S0)         ok\n");
		(void)alp_audio_in_start(g_state.mic);
	} else {
		printf("[ns]   alp_audio_in_open(I2S0)         skip (last_err=%d)\n",
		       (int)alp_last_error());
	}

	g_state.spk    = alp_audio_out_open(&cfg);
	g_state.spk_ok = (g_state.spk != NULL);
	if (g_state.spk_ok) {
		printf("[ns]   alp_audio_out_open(I2S0)        ok\n");
		(void)alp_audio_out_set_volume(g_state.spk, 0xA0);
		(void)alp_audio_out_start(g_state.spk);
	} else {
		printf("[ns]   alp_audio_out_open(I2S0)        skip (last_err=%d)\n",
		       (int)alp_last_error());
	}

	/* ── Open the DSP chain (window + FFT) ─────────────────
     *
     * The chain validator (see <alp/dsp.h>) enforces that
     * WINDOW immediately precedes FFT and that FFT is the
     * terminal stage.  Our two-stage descriptor satisfies
     * both.  Open should succeed even on native_sim (the chain
     * implementation is the portable C/CMSIS-DSP fallback). */
	g_state.dsp = alp_dsp_chain_open(s_dsp_stages, sizeof(s_dsp_stages) / sizeof(s_dsp_stages[0]));
	g_state.dsp_ok = (g_state.dsp != NULL);
	if (g_state.dsp_ok) {
		printf("[ns]   alp_dsp_chain_open(hann+fft256) ok\n");
	} else {
		printf("[ns]   alp_dsp_chain_open(hann+fft256) skip (last_err=%d)\n",
		       (int)alp_last_error());
	}

	/* ── Open the inference backend ────────────────────────
     *
     * AUTO routes to whatever the §D.lib loader resolved from
     * the SoM preset for THIS slice.  This project is M33-only,
     * so on V2N and V2N-M1 alike that is CPU TFLM: DRP-AI3 and
     * DEEPX DX-M1 are A55/Yocto-side and unreachable from here.
     * App source doesn't change. */
	alp_inference_config_t inf_cfg = {
		.backend     = ALP_INFERENCE_BACKEND_AUTO,
		.format      = ALP_INFERENCE_MODEL_TFLITE,
		.model_data  = s_model,
		.model_size  = sizeof(s_model),
		.arena       = s_arena,
		.arena_bytes = sizeof(s_arena),
	};
	g_state.inf    = alp_inference_open(&inf_cfg);
	g_state.inf_ok = (g_state.inf != NULL);
	if (g_state.inf_ok) {
		printf("[ns]   alp_inference_open(AUTO)        ok\n");
	} else {
		printf("[ns]   alp_inference_open(AUTO)        skip (last_err=%d)\n",
		       (int)alp_last_error());
	}

	/* ── Steady-state loop ─────────────────────────────────
     *
     * On HiL we loop DEMO_BLOCKS * 10 ms = ~500 ms of audio --
     * enough for a customer to hear "the noise dropped" on a
     * real bench.  On native_sim every backend is NULL, the
     * loop is effectively a memcpy chain, and we exit fast so
     * twister's console harness sees [ns] done within the
     * build timeout.
     *
     * A production deployment runs this forever in a dedicated
     * thread (priority just above the idle thread) -- the M33
     * supervisor sits in WFI between DMA-ready IRQs so the
     * average power is dominated by the codec + DMA engines,
     * not the CPU. */
	printf("[ns]   streaming %d blocks (%d ms total) ...\n", DEMO_BLOCKS, DEMO_BLOCKS * BLOCK_MS);
	for (int b = 0; b < DEMO_BLOCKS; ++b) {
		process_one_block();
#ifdef CONFIG_BOARD_NATIVE_SIM
		/* One iteration is enough for native_sim framing. */
		if (b == 0) break;
#endif
	}

	/* ── Teardown ──────────────────────────────────────────
     *
     * All close() calls tolerate NULL so we don't need per-handle
     * guards.  Order: speaker first (so any in-flight DMA drains
     * cleanly), then mic, then DSP chain, then inference. */
	if (g_state.spk_ok) (void)alp_audio_out_stop(g_state.spk);
	if (g_state.mic_ok) (void)alp_audio_in_stop(g_state.mic);
	alp_audio_out_close(g_state.spk);
	alp_audio_in_close(g_state.mic);
	alp_dsp_chain_close(g_state.dsp);
	alp_inference_close(g_state.inf);

	printf("[ns]   ran %u blocks\n", (unsigned)g_state.blocks_run);
	printf("[ns] done\n");
	return 0;
}
```
