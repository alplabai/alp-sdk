## CMakeLists.txt
```
# SPDX-License-Identifier: Apache-2.0
#
# CMakeLists for the Cortex-M33-SM / Zephyr slice of the rpmsg-v2n
# example.
#
# This is the build entry point Zephyr's machinery picks up when the
# orchestrator dispatches the M33 slice (board target
# `alp_e1m_v2n101_m33_sm`).  alp_project.py renders this slice's
# `cores.m33_sm.*` block from ../board.yaml into a Kconfig fragment
# that gets layered over prj.conf via OVERLAY_CONFIG.

cmake_minimum_required(VERSION 3.20)

# ---------------------------------------------------------------------
# 1. Resolve the ALP SDK root.
# ALP_SDK_ROOT lets a customer point this example at an out-of-tree
# SDK checkout; the fallback walks up three levels (examples/<name>/<core>
# -> examples/<name> -> examples -> repo root) so an in-tree
# `west build` Just Works.
# ---------------------------------------------------------------------
if(DEFINED ENV{ALP_SDK_ROOT})
    set(ALP_SDK_ROOT $ENV{ALP_SDK_ROOT})
else()
    get_filename_component(ALP_SDK_ROOT ${CMAKE_CURRENT_SOURCE_DIR}/../../.. ABSOLUTE)
endif()

# ---------------------------------------------------------------------
# 2. Python3 BEFORE Zephyr -- alp_project.py renders this slice's
# board.yaml view into a Kconfig fragment that Zephyr then layers
# over prj.conf via OVERLAY_CONFIG.  find_package(Python3 ...) MUST
# run before find_package(Zephyr ...) because Zephyr's CMake
# machinery pins a Python interpreter the moment it imports.
# ---------------------------------------------------------------------
find_package(Python3 REQUIRED COMPONENTS Interpreter)

set(_alp_generated ${CMAKE_BINARY_DIR}/generated/alp.conf)
execute_process(
    COMMAND ${Python3_EXECUTABLE} ${ALP_SDK_ROOT}/scripts/alp_project.py
            --input ${CMAKE_CURRENT_SOURCE_DIR}/../board.yaml
            --emit zephyr-conf --core m33_sm
            --output ${_alp_generated}
    RESULT_VARIABLE _alp_rv
    OUTPUT_VARIABLE _alp_stdout
    ERROR_VARIABLE  _alp_stderr
)
if(NOT _alp_rv EQUAL 0)
    message(FATAL_ERROR
        "alp_project.py failed (rv=${_alp_rv}); "
        "check ${CMAKE_CURRENT_SOURCE_DIR}/../board.yaml.\n"
        "stderr: ${_alp_stderr}")
endif()

list(APPEND OVERLAY_CONFIG ${_alp_generated})

# Generate <alp/system_ipc.h> from the board.yaml `ipc:` block.  The
# producer (src/main.c) opens RPC channels via the auto-emitted macros
# (ALP_IPC_<NAME>_NAME, _ADDR, _SIZE, ...), so the header must be on
# the include path before any source compiles.
set(_alp_ipc_header ${CMAKE_BINARY_DIR}/generated/alp/system_ipc.h)
execute_process(
    COMMAND ${Python3_EXECUTABLE} ${ALP_SDK_ROOT}/scripts/alp_project.py
            --input ${CMAKE_CURRENT_SOURCE_DIR}/../board.yaml
            --emit ipc-contract-h
            --output ${_alp_ipc_header}
    RESULT_VARIABLE _alp_ipc_rv
    OUTPUT_VARIABLE _alp_ipc_stdout
    ERROR_VARIABLE  _alp_ipc_stderr
)
if(NOT _alp_ipc_rv EQUAL 0)
    message(FATAL_ERROR
        "alp_project.py --emit ipc-contract-h failed "
        "(rv=${_alp_ipc_rv}); stderr: ${_alp_ipc_stderr}")
endif()

# ---------------------------------------------------------------------
# 3. Zephyr.
# ---------------------------------------------------------------------
find_package(Zephyr REQUIRED HINTS $ENV{ZEPHYR_BASE})
project(rpmsg_v2n_m33_sm LANGUAGES C)

# Expose the orchestrator's generated/ directory so the
# `#include <alp/system_ipc.h>` in src/main.c resolves.
zephyr_include_directories(${CMAKE_BINARY_DIR}/generated)

target_sources(app PRIVATE src/main.c)
```

## prj.conf
```kconfig
# SPDX-License-Identifier: Apache-2.0
#
# Empty by design.  The build's effective Kconfig is
# build/generated/alp.conf -- emitted from this app's board.yaml
# by scripts/alp_project.py and layered over this file via
# OVERLAY_CONFIG (see CMakeLists.txt).
#
# The M33-SM slice pulls in CONFIG_ALP_SDK_RPC=y via testcase.yaml's
# `extra_args` for native_sim builds.
```

## src/main.c
```c
/*
 * Copyright 2026 ALP Lab AB
 * SPDX-License-Identifier: Apache-2.0
 *
 * rpmsg-v2n -- Cortex-M33 / Zephyr producer.
 *
 * Sister to ../../linux/src/main.c on the same V2N silicon.  Both
 * slices come from one board.yaml and share the auto-generated
 * <alp/system_ipc.h> contract: same channel name, same endpoint
 * ids, same mailbox channel.  No address or id is typed by hand.
 *
 *   1. Open the framed RPC channel using the generated macros.
 *   2. Sample a sensor once per second via the portable <alp/peripheral.h>
 *      surface (placeholder synthetic counter under native_sim so the
 *      twister harness can latch the test).
 *   3. Send each sample as a `temperature` event to the A55 peer
 *      using alp_rpc_send().
 *
 * Under native_sim there is no real RPMsg device -- alp_rpc_open
 * returns NULL with ALP_ERR_NOT_READY and we exit with the harness
 * marker so the build-only test latches.
 */

#include <stdio.h>
#include <string.h>

#include <zephyr/kernel.h>

#include <alp/peripheral.h>
#include <alp/rpc.h>
#include <alp/system_ipc.h> /* generated by alp_orchestrate.py */

/* Capped burst keeps the native_sim run inside twister's timeout. */
#define SAMPLE_BURST 4u

int main(void)
{
    printf("[m33] rpmsg-v2n producer coming up\n");

    /* Spec §6.6 canonical open.  Every value here comes from the
     * generated header; the orchestrator computed them from the
     * project's `ipc:` block deterministically. */
    const alp_rpc_config_t cfg = {
        .name    = ALP_IPC_ALP_DEFAULT_RPMSG_NAME,
        .src_ept = ALP_IPC_ALP_DEFAULT_RPMSG_SRC_EPT,
        .dst_ept = ALP_IPC_ALP_DEFAULT_RPMSG_DST_EPT,
        .mbox_ch = ALP_IPC_ALP_DEFAULT_RPMSG_MBOX_CH,
    };
    alp_rpc_channel_t *ch = alp_rpc_open(&cfg);
    if (ch == NULL) {
        printf("[m33]   alp_rpc_open failed: last_err=%d\n", (int)alp_last_error());
        goto done;
    }

    /* Producer loop.  Synthetic counter on native_sim; on real
     * V2N silicon this would read alp_adc_read() / alp_i2c_xfer()
     * / alp_sensor_read() against the board's on-board sensor. */
    for (uint32_t i = 0; i < SAMPLE_BURST; ++i) {
        const float        sample = 22.5f + (float)i * 0.1f;
        const alp_status_t rv     = alp_rpc_send(ch, "temperature", &sample, sizeof(sample));
        if (rv != ALP_OK) {
            printf("[m33]   alp_rpc_send rv=%d at i=%u\n", (int)rv, (unsigned)i);
            break;
        }
        printf("[m33] sent temperature[%u]=%.1f\n", (unsigned)i, (double)sample);

#ifndef CONFIG_BOARD_NATIVE_SIM
        /* 1 Hz cadence on real silicon. */
        k_msleep(1000);
#endif
    }

    alp_rpc_close(ch);

done:
    printf("[rpmsg-v2n] done\n");
    return 0;
}
```
