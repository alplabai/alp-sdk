## CMakeLists.txt
```
# SPDX-License-Identifier: Apache-2.0

cmake_minimum_required(VERSION 3.20)

# Resolve the alp-sdk root.  In-tree the SDK is the example's
# grandparent directory; out-of-tree customers point ALP_SDK_ROOT
# at their checkout.
if(DEFINED ENV{ALP_SDK_ROOT})
    set(ALP_SDK_ROOT $ENV{ALP_SDK_ROOT})
else()
    get_filename_component(ALP_SDK_ROOT ${CMAKE_CURRENT_SOURCE_DIR}/../.. ABSOLUTE)
endif()

find_package(Python3 REQUIRED COMPONENTS Interpreter)

set(_alp_generated ${CMAKE_BINARY_DIR}/generated/alp.conf)
execute_process(
    COMMAND ${Python3_EXECUTABLE} ${ALP_SDK_ROOT}/scripts/alp_project.py
            --input ${CMAKE_CURRENT_SOURCE_DIR}/board.yaml
            --emit zephyr-conf
            --output ${_alp_generated}
    RESULT_VARIABLE _alp_rv
    OUTPUT_VARIABLE _alp_stdout
    ERROR_VARIABLE  _alp_stderr
)
if(NOT _alp_rv EQUAL 0)
    message(FATAL_ERROR
        "alp_project.py failed (rv=${_alp_rv}); "
        "check ${CMAKE_CURRENT_SOURCE_DIR}/board.yaml.\n"
        "stderr: ${_alp_stderr}")
endif()

# Layer generated CONFIG_* over prj.conf via OVERLAY_CONFIG.
list(APPEND OVERLAY_CONFIG ${_alp_generated})

find_package(Zephyr REQUIRED HINTS $ENV{ZEPHYR_BASE})
project(i2c_scanner LANGUAGES C)

target_sources(app PRIVATE src/main.c)
```

## prj.conf
```kconfig
# SPDX-License-Identifier: Apache-2.0

CONFIG_ALP_SDK=y
CONFIG_I2C=y
CONFIG_EMUL=y
CONFIG_I2C_EMUL=y
CONFIG_LOG=y
CONFIG_PRINTK=y
CONFIG_THREAD_LOCAL_STORAGE=y
```

## boards/native_sim_native_64.overlay
```dts
/*
 * Copyright 2026 ALP Lab AB
 * SPDX-License-Identifier: Apache-2.0
 *
 * One emulated I²C bus exposed via the alp-i2c0 alias.  No emul
 * targets are attached so every scan returns "no response" — but
 * the scanner runs end-to-end and exercises the open / write /
 * close path.
 */

#include <zephyr/dt-bindings/i2c/i2c.h>

/ {
    aliases {
        alp-i2c0 = &i2c0_emul;
    };

    soc {
        i2c0_emul: i2c@100 {
            compatible = "zephyr,i2c-emul-controller";
            status = "okay";
            reg = <0 0x100 4>;
            #address-cells = <1>;
            #size-cells = <0>;
            clock-frequency = <I2C_BITRATE_STANDARD>;
        };
    };
};
```

## src/main.c
```c
/*
 * Copyright 2026 ALP Lab AB
 * SPDX-License-Identifier: Apache-2.0
 *
 * i2c-scanner — open E1M_I2C0 and probe every 7-bit address.
 * The canonical "any device on this bus?" pattern.
 */

#include <stdio.h>

#include "alp/peripheral.h"
#include "alp/e1m_pinout.h"

int main(void) {
    printf("[i2c] open E1M_I2C0 @ 100 kHz\n");

    alp_i2c_t *bus = alp_i2c_open(&(alp_i2c_config_t){
        .bus_id     = E1M_I2C0,
        .bitrate_hz = 100000,
    });
    if (bus == NULL) {
        printf("[i2c] open failed: alp_last_error=%d\n",
               (int)alp_last_error());
        printf("[i2c] done\n");
        return 0;
    }

    int responders = 0;
    for (uint8_t addr = 0x08; addr < 0x78; addr++) {
        /* Zero-length write — the chip ACKs its address byte if
         * present, NACKs otherwise. */
        alp_status_t s = alp_i2c_write(bus, addr, NULL, 0);
        if (s == ALP_OK) {
            printf("[i2c] addr 0x%02x acked\n", addr);
            responders++;
        }
    }
    printf("[i2c] scan complete, %d responder(s)\n", responders);

    alp_i2c_close(bus);
    printf("[i2c] done\n");
    return 0;
}
```
