/*
 * Copyright 2026 ALP Lab AB
 * SPDX-License-Identifier: Apache-2.0
 *
 * rpmsg-imx93 -- Cortex-M33 / Zephyr producer.
 *
 * Same shape as the rpmsg-v2n m33_sm slice but targeting the
 * iMX93's M33 core.  Publishes one `temperature` event per second
 * to the A55 cluster's consumer.
 */

#include <stdio.h>
#include <string.h>

#include <zephyr/kernel.h>

#include <alp/rpc.h>
#include <alp/system_ipc.h>   /* generated by alp_orchestrate.py */

#define SAMPLE_BURST   4u

int main(void)
{
    printf("[m33] rpmsg-imx93 producer coming up\n");

    const alp_rpc_config_t cfg = {
        .name    = ALP_IPC_ALP_DEFAULT_RPMSG_NAME,
        .src_ept = ALP_IPC_ALP_DEFAULT_RPMSG_SRC_EPT,
        .dst_ept = ALP_IPC_ALP_DEFAULT_RPMSG_DST_EPT,
        .mbox_ch = ALP_IPC_ALP_DEFAULT_RPMSG_MBOX_CH,
    };
    alp_rpc_channel_t *ch = alp_rpc_open(&cfg);
    if (ch == NULL) {
        printf("[m33]   alp_rpc_open failed: last_err=%d\n",
               (int)alp_last_error());
        goto done;
    }

    for (uint32_t i = 0; i < SAMPLE_BURST; ++i) {
        const float sample = 23.0f + (float)i * 0.1f;
        const alp_status_t rv = alp_rpc_send(ch, "temperature",
                                             &sample, sizeof(sample));
        if (rv != ALP_OK) {
            printf("[m33]   alp_rpc_send rv=%d at i=%u\n",
                   (int)rv, (unsigned)i);
            break;
        }
        printf("[m33] sent temperature[%u]=%.1f\n",
               (unsigned)i, (double)sample);

#ifndef CONFIG_BOARD_NATIVE_SIM
        k_msleep(1000);
#endif
    }

    alp_rpc_close(ch);

done:
    printf("[rpmsg-imx93] done\n");
    return 0;
}
