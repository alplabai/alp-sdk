## CMakeLists.txt
```
# SPDX-License-Identifier: Apache-2.0
#
# CMakeLists for the Cortex-M33 / Zephyr slice of rpmsg-imx93.

cmake_minimum_required(VERSION 3.20)

if(DEFINED ENV{ALP_SDK_ROOT})
    set(ALP_SDK_ROOT $ENV{ALP_SDK_ROOT})
else()
    get_filename_component(ALP_SDK_ROOT ${CMAKE_CURRENT_SOURCE_DIR}/../../../.. ABSOLUTE)
endif()

find_package(Python3 REQUIRED COMPONENTS Interpreter)

# Generate <alp/system_ipc.h> from the board.yaml `ipc:` block.  The
# producer (src/main.c) opens RPC channels via the auto-emitted macros
# (ALP_IPC_<NAME>_NAME, _ADDR, _SIZE, ...), so the header must be on
# the include path before any source compiles.
set(_alp_ipc_header ${CMAKE_BINARY_DIR}/generated/alp/system_ipc.h)
execute_process(
    COMMAND ${Python3_EXECUTABLE} ${ALP_SDK_ROOT}/scripts/alp_project.py
            --input ${CMAKE_CURRENT_SOURCE_DIR}/../board.yaml
            --emit ipc-contract-h
            --output ${_alp_ipc_header}
    RESULT_VARIABLE _alp_ipc_rv
    OUTPUT_VARIABLE _alp_ipc_stdout
    ERROR_VARIABLE  _alp_ipc_stderr
)
if(NOT _alp_ipc_rv EQUAL 0)
    message(FATAL_ERROR
        "alp_project.py --emit ipc-contract-h failed "
        "(rv=${_alp_ipc_rv}); stderr: ${_alp_ipc_stderr}")
endif()

find_package(Zephyr REQUIRED HINTS $ENV{ZEPHYR_BASE})
project(rpmsg_imx93_m33 LANGUAGES C)

# Expose the orchestrator's generated/ directory so the
# `#include <alp/system_ipc.h>` in src/main.c resolves.
zephyr_include_directories(${CMAKE_BINARY_DIR}/generated)

target_sources(app PRIVATE src/main.c)
```

## prj.conf
```kconfig
# SPDX-License-Identifier: Apache-2.0
#
# Empty by design.  Effective Kconfig is build/generated/alp.conf.
```

## src/main.c
```c
/*
 * Copyright 2026 Alp Lab AB
 * SPDX-License-Identifier: Apache-2.0
 *
 * rpmsg-imx93 -- Cortex-M33 / Zephyr producer.
 *
 * Sister slice to ../../linux/src/main.c on the same i.MX93 silicon.
 * Both halves are generated from one board.yaml and share the
 * auto-generated <alp/system_ipc.h> contract: same channel name,
 * same endpoint ids, same mailbox channel.  No address or id is
 * ever typed by hand -- the orchestrator computes everything from
 * the project's `ipc:` block deterministically, which is how the
 * Cortex-M33 producer and the Cortex-A55 consumer stay in sync
 * across rebuilds.
 *
 * Same shape as the rpmsg-v2n m33_sm slice but targeting the
 * i.MX93's M33 core.  Publishes a short burst of `temperature`
 * events at 1 Hz to the A55 cluster's consumer.
 *
 * Flow:
 *
 *   1. Open the framed RPC channel using the generated macros.
 *   2. Emit SAMPLE_BURST `temperature` events via alp_rpc_send().
 *   3. Close the channel and exit cleanly.
 *
 * Under native_sim there is no real RPMsg device -- alp_rpc_open
 * returns NULL with ALP_ERR_NOT_READY and we exit with the harness
 * marker so the build-only twister test latches the example.
 */

#include <stdio.h>
#include <string.h>

#include <alp/peripheral.h>

#include <alp/rpc.h>
#include <alp/system_ipc.h> /* generated by alp_orchestrate/ */

/* Capped burst keeps the native_sim run inside twister's timeout
 * (4 samples * 1 s cadence on real silicon, instant under sim). */
#define SAMPLE_BURST 4u

int main(void)
{
	printf("[m33] rpmsg-imx93 producer coming up\n");

	/* ----- Channel setup ---------------------------------------- */
	/* Spec §6.6 canonical open.  Every value here comes from the
     * generated header; if a customer renames the `alp_default`
     * channel in their board.yaml `ipc:` block, this struct picks
     * up the new identifiers automatically on the next build with
     * zero source edits on either side of the link. */
	const alp_rpc_config_t cfg = {
		.name    = ALP_IPC_ALP_DEFAULT_RPMSG_NAME,
		.src_ept = ALP_IPC_ALP_DEFAULT_RPMSG_SRC_EPT,
		.dst_ept = ALP_IPC_ALP_DEFAULT_RPMSG_DST_EPT,
		.mbox_ch = ALP_IPC_ALP_DEFAULT_RPMSG_MBOX_CH,
	};

	/* Acquire the RPC channel handle.  On i.MX93 silicon this binds
     * to the OpenAMP RPMsg device that the M33-side Zephyr driver
     * publishes; the underlying virtio rings live in the shared SRAM
     * carve-out the linker reserved.  On native_sim there is no such
     * device so we get NULL back -- treated as a clean early exit
     * rather than a hard failure so twister still passes the build. */
	alp_rpc_channel_t *ch = alp_rpc_open(&cfg);
	if (ch == NULL) {
		/* Common causes: orchestrator hasn't run yet (header out of
         * date), peer A55 firmware not loaded, or the host kernel
         * remoteproc node still in OFFLINE state. */
		printf("[m33]   alp_rpc_open failed: last_err=%d\n", (int)alp_last_error());
		goto done;
	}

	/* ----- Producer loop ---------------------------------------- */
	/* Synthetic counter so the example is hardware-free; on real
     * i.MX93 boards this would read alp_adc_read() / alp_i2c_xfer()
     * / alp_sensor_read() against whatever sensor the customer wired
     * onto the board.  The point of the demo is the link, not the
     * source of the bytes. */
	for (uint32_t i = 0; i < SAMPLE_BURST; ++i) {
		/* Fake a slowly-rising temperature in °C so the consumer
         * side can prove it received different payloads frame by
         * frame and isn't just echoing a cached value. */
		const float sample = 23.0f + (float)i * 0.1f;

		/* Framed RPC send: header + payload pushed into the virtio
         * TX ring, mailbox doorbell rung, A55 consumer is woken on
         * the matching dst_ept.  Returns ALP_OK on success or an
         * ALP_ERR_* code if the ring is full / peer disconnected. */
		const alp_status_t rv = alp_rpc_send(ch, "temperature", &sample, sizeof(sample));
		if (rv != ALP_OK) {
			/* Most common runtime failure: peer A55 hasn't claimed
             * its endpoint yet, so the ring drains slower than we
             * fill it.  Bail rather than spin -- the loop will be
             * retried on the next demo run. */
			printf("[m33]   alp_rpc_send rv=%d at i=%u\n", (int)rv, (unsigned)i);
			break;
		}
		printf("[m33] sent temperature[%u]=%.1f\n", (unsigned)i, (double)sample);

#ifndef CONFIG_BOARD_NATIVE_SIM
		/* 1 Hz cadence on real silicon -- under native_sim we skip
         * the sleep so the twister harness completes in milliseconds
         * instead of seconds.  Production firmware would either keep
         * this 1-second tick or wire the cadence to a real sensor
         * data-ready GPIO. */
		alp_delay_ms(1000);
#endif
	}

	/* ----- Teardown --------------------------------------------- */
	/* Symmetric with alp_rpc_open(): releases the endpoint, tears
     * down the virtio ring binding, and lets the peer's send() see
     * the channel as closed on its next attempt. */
	alp_rpc_close(ch);

done:
	/* Marker line consumed by the twister regex -- keep the literal
     * `[rpmsg-imx93] done` string stable so test logic doesn't drift. */
	printf("[rpmsg-imx93] done\n");
	return 0;
}
```
