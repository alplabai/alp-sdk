/*
 * Copyright 2026 Alp Lab AB
 * SPDX-License-Identifier: Apache-2.0
 *
 * rpmsg-aen -- Cortex-M55-HP / Zephyr producer (E1M-AEN801 / Alif Ensemble E8).
 *
 * PRODUCER half of a dual-core demo. This Zephyr firmware runs on the M55-HP
 * core; the A32 cluster's Yocto-Linux CONSUMER (../../linux/src/main.c)
 * subscribes to what we publish. We read the board's on-board LSM6DSO IMU +
 * BMP581 barometer through the portable <alp/chips/...> surfaces and publish one
 * `imu_sample` event per second over the framed RPC channel.
 *
 * What it teaches:
 *   - One portable <alp/rpc.h> surface drives this Zephyr producer and the
 *     Linux consumer alike; neither side hand-codes RPMsg/OpenAMP details.
 *   - Channel name, endpoint ids and mailbox channel come from the generated
 *     <alp/system_ipc.h> (alp_orchestrate.py emits it from board.yaml's `ipc:`
 *     block), so producer and consumer cannot drift apart across rebuilds.
 *   - Both sides agree on the wire shape: a fixed-size packed struct (5 floats
 *     + a uint32 sequence number) memcpy'd into the RPMsg payload. There is no
 *     field-by-field serialisation; the v0.6 framing carries an opaque payload
 *     per spec §6.3.
 */

#include <stdio.h>
#include <string.h>

#include <zephyr/kernel.h>

#include <alp/peripheral.h>
#include <alp/rpc.h>
#include <alp/system_ipc.h> /* generated by alp_orchestrate.py */

/* Shared wire format -- must stay byte-identical to the consumer's copy in
 * ../../linux/src/main.c. packed: no compiler padding for the two cores to
 * disagree about across the M55/A32 ABI boundary. */
typedef struct {
	uint32_t seq;
	float    accel_g[3];
	float    pressure_pa;
	float    temperature_c;
} __attribute__((packed)) imu_sample_t;

/* Publish a short, bounded burst so the native_sim build-only test finishes
 * fast and the Linux consumer's DRAIN_COUNT wait latches. */
#define SAMPLE_BURST 4u

int main(void)
{
	printf("[m55-hp] rpmsg-aen producer coming up\n");

	/* Canonical open (spec §6.6). Every identifier is a generated macro; the
	 * producer takes the SRC->DST orientation and the consumer mirrors it (its
	 * src/dst are swapped). Rename the channel in board.yaml and both slices
	 * pick up the new ids on the next build with no source edits. */
	const alp_rpc_config_t cfg = {
		.name      = ALP_IPC_ALP_DEFAULT_RPMSG_NAME,
		.src_ept   = ALP_IPC_ALP_DEFAULT_RPMSG_SRC_EPT,
		.dst_ept   = ALP_IPC_ALP_DEFAULT_RPMSG_DST_EPT,
		.mbox_ch   = ALP_IPC_ALP_DEFAULT_RPMSG_MBOX_CH,
		.cacheable = true, /* AEN MRAM is cacheable (spec §6.8). */
	};
	alp_rpc_channel_t *ch = alp_rpc_open(&cfg);
	if (ch == NULL) {
		/* No channel: under native_sim there is no rpmsg device; on hardware the
		 * A32 peer / remoteproc binding isn't up yet. Skip to the marker line so
		 * the build-only twister test still latches. */
		printf("[m55-hp]   alp_rpc_open failed: last_err=%d\n", (int)alp_last_error());
		goto done;
	}

	/* Producer loop.  On real silicon this reads alp_i2c_xfer()
     * against the LSM6DSO + BMP581 chip drivers; under native_sim
     * the sensors aren't wired so we publish synthetic data so the
     * harness can latch. */
	for (uint32_t i = 0; i < SAMPLE_BURST; ++i) {
		imu_sample_t s = {
			.seq           = i,
			.accel_g       = { 0.0f, 0.0f, 1.0f },
			.pressure_pa   = 101325.0f - (float)i * 12.0f,
			.temperature_c = 22.5f + (float)i * 0.1f,
		};

		const alp_status_t rv = alp_rpc_send(ch, "imu_sample", &s, sizeof s);
		if (rv != ALP_OK) {
			/* Ring full or peer not yet subscribed -- stop the burst rather than
			 * spin; the next demo run retries from a clean state. */
			printf("[m55-hp]   alp_rpc_send rv=%d at i=%u\n", (int)rv, (unsigned)i);
			break;
		}
		printf(
		    "[m55-hp] published imu_sample seq=%u T=%.1f\n", (unsigned)i, (double)s.temperature_c);

#ifndef CONFIG_BOARD_NATIVE_SIM
		k_msleep(1000); /* 1 Hz on real silicon; skipped under sim for speed */
#endif
	}

	alp_rpc_close(ch);

done:
	/* Stable marker consumed by the twister regex -- keep the literal string. */
	printf("[rpmsg-aen] done\n");
	return 0;
}
