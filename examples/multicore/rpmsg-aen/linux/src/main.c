/*
 * Copyright 2026 Alp Lab AB
 * SPDX-License-Identifier: Apache-2.0
 *
 * rpmsg-aen -- Cortex-A32 / Yocto-Linux consumer.
 *
 * Subscribes to the `imu_sample` method published by the M55-HP
 * producer (see ../../m55_hp/src/main.c) and prints each sample
 * to stdout.  The wire format is a fixed-size struct memcpy'd
 * into the RPMsg payload; both sides agree on it via the shared
 * declaration below.
 */

#include <stdio.h>
#include <stdatomic.h>
#include <stdint.h>
#include <string.h>
#include <unistd.h>

#include <alp/rpc.h>
#include <alp/system_ipc.h> /* generated by alp_orchestrate/ */

/* Mirror of m55_hp/src/main.c's struct.  Linux and Zephyr are two separate
 * compilation units with no shared header across the A32/M55 boundary, so
 * this layout has to be kept in sync by hand; __attribute__((packed)) pins
 * it to the same byte layout the producer memcpy's onto the wire. */
typedef struct {
	uint32_t seq;
	float    accel_g[3];
	float    pressure_pa;
	float    temperature_c;
} __attribute__((packed)) imu_sample_t;

/* Matches the producer's SAMPLE_BURST -- how many samples we expect before
 * giving up and exiting, so the demo (and the twister harness) terminates
 * instead of blocking forever if the producer side never comes up. */
#define DRAIN_COUNT 4u

/* Written from on_imu_sample() (the SDK's RX worker thread) and read from
 * main()'s poll loop below; atomic because those are two different threads
 * of control with no other synchronisation between them. */
static atomic_uint g_received;

static void on_imu_sample(const void *payload, size_t len, void *user)
{
	(void)user;
	/* Defensive: the wire format isn't enforced by a shared header, so a
	 * producer/consumer struct mismatch would otherwise be read as
	 * garbage instead of failing loudly. */
	if (len != sizeof(imu_sample_t)) {
		printf("[a32]   short imu_sample (%zu)\n", len);
		return;
	}
	imu_sample_t s;
	memcpy(&s, payload, sizeof s);
	printf("[a32] imu_sample seq=%u T=%.1f P=%.1f Az=%.2fg\n",
	       (unsigned)s.seq,
	       (double)s.temperature_c,
	       (double)s.pressure_pa,
	       (double)s.accel_g[2]);
	atomic_fetch_add(&g_received, 1u);
}

int main(void)
{
	printf("[a32] rpmsg-aen consumer coming up\n");

	/* Endpoints are mirrored relative to the producer's config: this
	 * side's src is the producer's dst and vice versa, so both ends
	 * converge on the same pair of RPMsg endpoint ids. cacheable must
	 * match the producer and the board.yaml `ipc:` block -- the AEN
	 * carve-out lives in MRAM, which is cacheable on this SoM (spec
	 * §6.8) because the M55 cores run with caches enabled. */
	const alp_rpc_config_t cfg = {
		.name      = ALP_IPC_ALP_DEFAULT_RPMSG_NAME,
		.src_ept   = ALP_IPC_ALP_DEFAULT_RPMSG_DST_EPT,
		.dst_ept   = ALP_IPC_ALP_DEFAULT_RPMSG_SRC_EPT,
		.mbox_ch   = ALP_IPC_ALP_DEFAULT_RPMSG_MBOX_CH,
		.cacheable = true,
	};
	alp_rpc_channel_t *ch = alp_rpc_open(&cfg);
	if (ch == NULL) {
		/* Common cause: the M55-HP producer hasn't reached its
		 * alp_rpc_open() yet, so the name-service handshake this call
		 * retries internally never completes within its timeout. */
		printf("[a32]   alp_rpc_open failed: last_err=%d\n", (int)alp_last_error());
		return 1;
	}

	if (alp_rpc_subscribe(ch, "imu_sample", on_imu_sample, NULL) != ALP_OK) {
		printf("[a32]   alp_rpc_subscribe failed: last_err=%d\n", (int)alp_last_error());
		alp_rpc_close(ch);
		return 1;
	}

	/* Poll instead of block: on_imu_sample() runs on the SDK's own RX
	 * worker, so main() just waits for DRAIN_COUNT samples to land or
	 * for the 10 s bound (100 * 100 ms) to expire, whichever is first. */
	for (int i = 0; i < 100 && atomic_load(&g_received) < DRAIN_COUNT; ++i) {
		usleep(100 * 1000);
	}

	alp_rpc_close(ch);
	printf("[rpmsg-aen] done\n");
	return 0;
}
