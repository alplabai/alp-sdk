/*
 * Copyright 2026 Alp Lab AB
 * SPDX-License-Identifier: Apache-2.0
 *
 * rpmsg-v2n -- Cortex-A55 / Yocto-Linux consumer.
 *
 * Counterpart to ../../m33_sm/src/main.c on the same V2N silicon.
 * The M33 side is a raw-OpenAMP echo responder that "deliberately
 * bypasses <alp/rpc.h>" for this phase (see that file's header) --
 * it publishes no named method, it just mirrors back whatever bytes
 * land on its fixed rpmsg endpoint (M33_RPMSG_EPT_ADDR below).  This
 * file used to assume a `temperature` push the M33 never sends,
 * which meant the two slices never actually talked (see git history
 * / alp-sdk #1167).  It's fixed here on the LINUX side, not the M33
 * side: the M33 firmware is bench-proven on real silicon (#683/#697)
 * and its echo behaviour is deliberate ("keeping the echo... gives
 * the Linux side a live, verifiable peer" -- m33_sm/src/main.c);
 * inventing a `temperature` publish on that firmware would mean
 * fabricating a sensor reading with no silicon backing.  Instead
 * this side is rewritten to actually be that live, verifiable peer:
 * it round-trips a request through <alp/rpc.h>'s `alp_rpc_call` and
 * checks the exact bytes come back, which is precisely what the echo
 * firmware supports.
 *
 * Two things had to change vs. a routine <alp/rpc.h> consumer:
 *
 *   1. Endpoint addressing.  `src/backends/rpc/yocto_uio_drv.c` --
 *      the alp_rpc backend that actually attaches to this M33 image
 *      on V2N (registered for `silicon_ref = "renesas:rzv2n:n44"`) --
 *      documents that the M33 always listens/replies on the fixed
 *      address M33_RPMSG_EPT_ADDR below (`APP_EPT_ADDR` in
 *      m33_sm/src/main.c), not the address the orchestrator's
 *      fnv1a-derived `<alp/system_ipc.h>` convention would compute
 *      for the `alp_default_rpmsg` channel.  `dst_ept` is set to
 *      that fixed address explicitly; `src_ept` is left at 0 so the
 *      backend uses `RPMSG_ADDR_ANY` (the M33 learns our address
 *      from the first frame -- see that backend's `y_open()` comment).
 *   2. Framing.  There is no `temperature` method to subscribe to;
 *      instead every request/response uses the `echo_test` method
 *      name the M33 file already documents as its normal (non-
 *      "slow"-prefixed) case, and the payload is verified byte-for-
 *      byte against what was sent.
 *
 * Build: this file is plain CMake (no Zephyr); meta-alp-sdk's
 * recipe under the alp-image-edge image drives the build inside
 * the bitbake image.  Standalone the binary builds against the
 * Yocto SDK's sysroot via:
 *
 *   source /opt/alp-sdk/.../environment-setup-cortexa55-...
 *   cmake -S linux -B build-linux
 *   cmake --build build-linux
 */

#include <stdio.h>
#include <stdint.h>
#include <string.h>

#include <alp/rpc.h>
#include <alp/system_ipc.h> /* generated by alp_orchestrate/ -- name only, see header */

/* The M33 echo responder's fixed rpmsg endpoint address -- mirrors
 * `APP_EPT_ADDR` in ../../m33_sm/src/main.c.  Not generated: the M33
 * side intentionally does not follow the <alp/system_ipc.h> endpoint
 * convention (see that file's header). */
#define M33_RPMSG_EPT_ADDR 1024u

/* Round-trip budget -- exit cleanly once DRAIN_COUNT echoes have
 * verified so the systemd unit / CI smoke test can latch and shut
 * down. */
#define DRAIN_COUNT 4u

int main(void)
{
	printf("[a55] rpmsg-v2n consumer coming up\n");

	const alp_rpc_config_t cfg = {
		.name    = ALP_IPC_ALP_DEFAULT_RPMSG_NAME,
		.src_ept = 0u,                 /* RPMSG_ADDR_ANY; M33 learns it from frame 1 */
		.dst_ept = M33_RPMSG_EPT_ADDR, /* the M33 echo responder's fixed address */
		.mbox_ch = ALP_IPC_ALP_DEFAULT_RPMSG_MBOX_CH,
	};
	alp_rpc_channel_t *ch = alp_rpc_open(&cfg);
	if (ch == NULL) {
		printf("[a55]   alp_rpc_open failed: last_err=%d\n", (int)alp_last_error());
		return 1;
	}

	unsigned verified = 0u;
	for (unsigned i = 0u; i < DRAIN_COUNT; ++i) {
		char   req[16];
		char   resp[16];
		size_t resp_len = sizeof resp;
		int    req_len  = snprintf(req, sizeof req, "ping-%u", i);

		alp_status_t st =
		    alp_rpc_call(ch, "echo_test", req, (size_t)req_len, resp, &resp_len, 2000u);
		if (st != ALP_OK) {
			printf("[a55]   echo_test[%u] failed: status=%d last_err=%d\n",
			       i,
			       (int)st,
			       (int)alp_last_error());
			continue;
		}
		if (resp_len != (size_t)req_len || memcmp(req, resp, resp_len) != 0) {
			printf("[a55]   echo_test[%u] MISMATCH (sent %d bytes, got %zu back)\n",
			       i,
			       req_len,
			       resp_len);
			continue;
		}
		printf("[a55] recv echo_test[%u]=\"%.*s\" (verified)\n", i, (int)resp_len, resp);
		++verified;
	}

	alp_rpc_close(ch);
	printf("[rpmsg-v2n] done (%u/%u round trips verified)\n", verified, DRAIN_COUNT);
	return verified == DRAIN_COUNT ? 0 : 1;
}
