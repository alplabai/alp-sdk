## CMakeLists.txt
```
# SPDX-License-Identifier: Apache-2.0
#
# CMakeLists for the Cortex-M33-SM / Zephyr slice of the rpmsg-v2n
# example.
#
# This is the build entry point Zephyr's machinery picks up when the
# orchestrator dispatches the M33 slice (board target
# `alp_e1m_v2n101_m33_sm`).  The slice's `cores.m33_sm.*` block of
# ../board.yaml is rendered into a Kconfig fragment (generated/alp.conf)
# by the build plan / scripts/gen_example_alp_conf.py, not by this file.

cmake_minimum_required(VERSION 3.20)

# ---------------------------------------------------------------------
# 1. Resolve the Alp SDK root.
# ALP_SDK_ROOT lets a customer point this example at an out-of-tree
# SDK checkout; the fallback walks up four levels
# (examples/multicore/<name>/<core> -> examples/multicore/<name>
# -> examples/multicore -> examples -> repo root) so an in-tree
# `west build` Just Works.
# ---------------------------------------------------------------------
if(DEFINED ENV{ALP_SDK_ROOT})
    set(ALP_SDK_ROOT $ENV{ALP_SDK_ROOT})
else()
    get_filename_component(ALP_SDK_ROOT ${CMAKE_CURRENT_SOURCE_DIR}/../../../.. ABSOLUTE)
endif()

# ---------------------------------------------------------------------
# 2. Python3 BEFORE Zephyr -- alp_project.py renders the IPC contract
# header below.  find_package(Python3 ...) MUST run before
# find_package(Zephyr ...) because Zephyr's CMake machinery pins a
# Python interpreter the moment it imports.
# ---------------------------------------------------------------------
find_package(Python3 REQUIRED COMPONENTS Interpreter)

# Generate <alp/system_ipc.h> from the board.yaml `ipc:` block.  The
# producer (src/main.c) opens RPC channels via the auto-emitted macros
# (ALP_IPC_<NAME>_NAME, _ADDR, _SIZE, ...), so the header must be on
# the include path before any source compiles.
set(_alp_ipc_header ${CMAKE_BINARY_DIR}/generated/alp/system_ipc.h)
execute_process(
    COMMAND ${Python3_EXECUTABLE} ${ALP_SDK_ROOT}/scripts/alp_project.py
            --input ${CMAKE_CURRENT_SOURCE_DIR}/../board.yaml
            --emit ipc-contract-h
            --output ${_alp_ipc_header}
    RESULT_VARIABLE _alp_ipc_rv
    OUTPUT_VARIABLE _alp_ipc_stdout
    ERROR_VARIABLE  _alp_ipc_stderr
)
if(NOT _alp_ipc_rv EQUAL 0)
    message(FATAL_ERROR
        "alp_project.py --emit ipc-contract-h failed "
        "(rv=${_alp_ipc_rv}); stderr: ${_alp_ipc_stderr}")
endif()

# ---------------------------------------------------------------------
# 3. Zephyr.
# ---------------------------------------------------------------------
find_package(Zephyr REQUIRED HINTS $ENV{ZEPHYR_BASE})
project(rpmsg_v2n_m33_sm LANGUAGES C)

# Expose the orchestrator's generated/ directory (still emitted above for
# the other slices' tooling; src/main.c itself no longer includes
# <alp/system_ipc.h> -- see its file header, alp-sdk #683 Phase 1).
zephyr_include_directories(${CMAKE_BINARY_DIR}/generated)

# METAL_MAX_DEVICE_REGIONS -- number of memory regions shared between
# cores.  Default is 1 (the vrings/rpmsg buffers); this app's
# platform_init() registers a SECOND region for the resource table, so it
# must be redefined here (matches upstream's openamp_linux_zephyr sample).
zephyr_compile_definitions(METAL_MAX_DEVICE_REGIONS=2)

target_include_directories(app PRIVATE ${LIBMETAL_INCLUDE_DIR} ${OPENAMP_INCLUDE_DIR}
                            ${PLATFORM_DIR})
target_include_directories(app PRIVATE src)

# The vendor-shaped resource table, the liveness beacon and the reverse
# doorbell are shared with the <alp/rpc.h> ipc_service backend (V2N/V2M CM33).
set(_alp_v2n_ipc ${ALP_SDK_ROOT}/zephyr/drivers/ipc)
target_include_directories(app PRIVATE ${_alp_v2n_ipc})
target_sources(app PRIVATE src/main.c ${_alp_v2n_ipc}/resource_table.c
                           ${_alp_v2n_ipc}/alp_v2n_beacon.c)
```

## prj.conf
```kconfig
# SPDX-License-Identifier: Apache-2.0
#
# The rest of this app's Kconfig comes from generated/alp.conf --
# emitted from ../board.yaml by `tan build` and layered over
# this file via EXTRA_CONF_FILE (see scripts/gen_example_alp_conf.py).
#
# alp-sdk #683 "Path B, Phase 1": src/main.c is now a real raw-OpenAMP
# rpmsg slave (see its file header for why it bypasses <alp/rpc.h> in this
# phase), so this file carries the Kconfig that firmware needs on real
# RZ/V2N hardware -- matching upstream's openamp_linux_zephyr sample
# prj.conf line for line.
CONFIG_ALP_SDK=y
CONFIG_MBOX=y
CONFIG_HEAP_MEM_POOL_SIZE=16384
CONFIG_OPENAMP=y
# Ship our OWN resource table (src/resource_table.c) instead of Zephyr's
# generated one -- the A55 side's Renesas Multi-OS Package tooling expects
# the vendor-shaped table, not a generic one (see main.c's file header).
CONFIG_OPENAMP_RSC_TABLE=n

# This firmware drives the link with raw OpenAMP itself (src/); the board.yaml
# ipc: rpmsg entry must not also pull in the <alp/rpc.h> ipc_service backend.
CONFIG_IPC_SERVICE_BACKEND_ALP_V2N_RPMSG=n
```

## src/main.c
```c
/*
 * Copyright 2026 Alp Lab AB
 * SPDX-License-Identifier: Apache-2.0
 *
 * rpmsg-v2n / m33_sm -- Cortex-M33 OpenAMP rpmsg SLAVE endpoint.
 *
 * alp-sdk #683 "Path B": this is a from-scratch firmware, NOT the native_sim
 * placeholder this file used to be.  It proves the RAW OpenAMP transport --
 * resource table, vrings, mailbox doorbell, rpmsg endpoint -- against REAL
 * RZ/V2N devicetree + the Renesas MHU mailbox driver, so the A55/Linux side
 * (an OpenAMP `rpmsg_sample_client` over UIO) has a live peer to attach to.
 * BENCH-PROVEN on E1M-X V2N-M1 silicon (#697): attach + echo round-trip
 * (1/4/16/64 B) + the GHSA-xhm8 external concurrent-close all pass end-to-end.
 * The doorbell is asymmetric -- forward A55->M33 via R_MHU_NS5.MSG (M33 NVIC
 * IRQ 293), reverse M33->A55 via a CA55-routed MHU-B SWINT unit (12 -> GIC_SPI
 * 404) or, with CONFIG_ALP_V2N_DOORBELL_RSP_CH8, Renesas' rsp_ch8_ns (GIC_SPI
 * 385, bench-pending); see mailbox_notify() below and
 * <alp/protocol/v2n_mhu_doorbell.h> for the register map.
 *
 * Adapted near-verbatim from Renesas's own sample --
 * zephyr/samples/boards/renesas/openamp_linux_zephyr/src/main_remote.c --
 * which is itself the reference the RZ/V2L port of this exact link ships.
 * Nothing here reimplements OpenAMP/libmetal/the FSP MHU driver; it only
 * wires the CM33-side half of the protocol those libraries already
 * implement (`applying-the-alp-sdk-c-house-style` + the "ride over vendor,
 * don't rewrite vendor drivers" rule) to this board's devicetree.
 *
 * Deliberately bypasses <alp/rpc.h> (the SDK's portable framed-RPC-over-
 * OpenAMP surface, src/backends/rpc/zephyr_drv.c) for this phase: that
 * backend rides on Zephyr's `subsys/ipc/ipc_service` and its OWN generated
 * resource table, whereas the A55 side here is the Renesas Multi-OS
 * Package's `rpmsg_sample_client` + `platform_info.c` (license-gated, not
 * an alp-sdk component) -- fixed, vendor userspace tooling that dials a
 * resource table shaped EXACTLY like zephyr/drivers/ipc/resource_table.c, not
 * whatever `ipc_service` would generate.  Reconciling the two -- most
 * likely a v2n-specific `<alp/rpc.h>` backend once this raw transport is
 * bench-proven -- is follow-up, not this phase.
 *
 * That follow-up backend has since landed: `src/backends/rpc/
 * yocto_uio_drv.c` (silicon_ref "renesas:rzv2n:n44") attaches
 * `alp_rpc_open()` directly to THIS firmware's raw endpoint (fixed
 * address APP_EPT_ADDR below, RPMSG_ADDR_ANY-learned peer) -- see
 * ../../linux/src/main.c, which now drives it as the real Linux
 * counterpart (alp-sdk #1167).  This file's own transport code is
 * unchanged: it is still the bench-proven half.
 *
 * Echo behaviour kept from the vendor sample on purpose: the A55 side's
 * `rpmsg_sample_client` sends a growing message and checks the SAME bytes
 * come back, so keeping the echo (rather than trimming it to
 * temperature-sample style) gives the Linux side a live, verifiable peer.
 */

#include <string.h>

#include <zephyr/device.h>
#include <zephyr/drivers/mbox.h>
#include <zephyr/kernel.h>
#include <zephyr/logging/log.h>
#include <zephyr/sys/atomic.h>

#include <metal/device.h>
#include <openamp/open_amp.h>

#include "alp_v2n_beacon.h"
#include "resource_table.h"

LOG_MODULE_REGISTER(rpmsg_v2n_m33_sm, LOG_LEVEL_INF);

#define SHM_DEVICE_NAME "shm"

#if !DT_HAS_CHOSEN(zephyr_ipc_shm)
#error "rpmsg-v2n/m33_sm requires `chosen { zephyr,ipc_shm = ...; }` -- see the board overlay"
#endif

/* Endpoint address the A55 side's rpmsg_sample_client dials; matches the
 * vendor sample -- this is NOT the alp_rpc_config_t src_ept convention, see
 * the file header. */
#define APP_EPT_ADDR (1024)

/* Shared-memory geometry, read straight from the board overlay's
 * `chosen { zephyr,ipc_shm = &vring_shm0; }` -- see zephyr/drivers/ipc/resource_table.h for
 * why the vring TX/RX addresses come from a DIFFERENT pair of nodes
 * (vring_ctrl0/1, allocated by the rpmsg MASTER). */
#define SHM_NODE       DT_CHOSEN(zephyr_ipc_shm)
#define SHM_START_ADDR DT_REG_ADDR(SHM_NODE)
#define SHM_SIZE       DT_REG_SIZE(SHM_NODE)

#define RSC_TABLE_ADDR DT_REG_ADDR(DT_NODELABEL(rsctbl))

/* Liveness beacon + attach epoch (alp-sdk #683, #2586): shared with the
 * ipc_service backend, see zephyr/drivers/ipc/alp_v2n_beacon.h.  The beacon
 * lives at the TOP of the rsctbl page, out of the resource table's way. */

/* 2048 not 1024: the RX callback + echo thread now hold a struct sc_frame (~520 B)
 * on the stack for the queued-echo path (#707); the deep OpenAMP rx call chain
 * needs the extra headroom. */
#define APP_TASK_STACK_SIZE (2048)

K_THREAD_STACK_DEFINE(thread_mng_stack, APP_TASK_STACK_SIZE);
K_THREAD_STACK_DEFINE(thread_rp_client_stack, APP_TASK_STACK_SIZE);

static struct k_thread thread_mng_data;
static struct k_thread thread_rp_client_data;

/* `chosen { zephyr,ipc = &ipc0; }` in the generated board dts (see
 * scripts/gen_zephyr_board.py) carries the MHU-B "tx" / "rx" mbox pair; this
 * firmware only uses "rx" -- the reverse doorbell is a direct register write
 * (alp_v2n_doorbell_ring()). */
static const struct mbox_dt_spec tx_channel = MBOX_DT_SPEC_GET(DT_CHOSEN(zephyr_ipc), tx);
static const struct mbox_dt_spec rx_channel = MBOX_DT_SPEC_GET(DT_CHOSEN(zephyr_ipc), rx);

static metal_phys_addr_t shm_physmap = CM33_TO_A55_ADDR_NS(SHM_START_ADDR);
static metal_phys_addr_t rsc_physmap = RSC_TABLE_ADDR;

/* One libmetal "generic" device carrying two regions: the rpmsg shared
 * buffer pool (region 0) and the resource table (region 1).  Needs
 * METAL_MAX_DEVICE_REGIONS=2 (default is 1) -- set in this app's
 * CMakeLists.txt. */
struct metal_device shm_device = {
	.name        = SHM_DEVICE_NAME,
	.num_regions = 2,
	{
	    { .virt = NULL }, /* shared memory */
	    { .virt = NULL }, /* rsc_table memory */
	},
	.node    = { NULL },
	.irq_num = 0,
};

static struct metal_io_region      *shm_io;
static struct rpmsg_virtio_shm_pool shpool;

static struct metal_io_region    *rsc_io;
static struct rpmsg_virtio_device rvdev;

static void                *rsc_table;
static struct rpmsg_device *rpdev;

static struct rpmsg_endpoint sc_ept;

/* #707: echo RX frames via a QUEUE, not a single buffer + binary sem.  The old
 * single sc_msg buffer + K_SEM(...,1) dropped the second of two rapid frames --
 * the RX callback overwrote sc_msg before the echo thread ran -- so the A55
 * GHSA-xhm8 self-close test (a fast "close_me" trigger + a "slow_..." blocked
 * call, back to back) never opened its race window on silicon (#697 cycle 13).
 * The queue echoes both, in order. */
struct sc_frame {
	size_t len;
	char   data[512];
};
K_MSGQ_DEFINE(sc_frame_q, sizeof(struct sc_frame), 8, 4);

static K_SEM_DEFINE(data_sem, 0, 1);
/* data_sc_sem: "sc_ept is up, start echoing" handoff from the manager thread
 * (which creates sc_ept itself, before its receive loop) to the responder
 * thread, once per A55 attach; per-frame delivery goes through sc_frame_q
 * above.  responder_stopped_sem is the reverse handoff on an attach reset. */
static K_SEM_DEFINE(data_sc_sem, 0, 1);
static K_SEM_DEFINE(responder_stopped_sem, 0, 1);

/* sc_frame.len value that tells the responder to stop (#2586). */
#define SC_FRAME_STOP ((size_t)-1)

/* Set while rpmsg_link_reset() tears the link down: the responder drops a
 * frame it was still holding instead of sending it onto the old vring. */
static atomic_t link_resetting;

/* Doorbell RX: the A55 side kicked our mailbox after touching a vring --
 * just wake the manager thread, which figures out which vring via
 * rproc_virtio_notified() below. */
static void platform_mbox_callback(const struct device *dev,
                                   mbox_channel_id_t    channel_id,
                                   void                *user_data,
                                   struct mbox_msg     *data)
{
	ARG_UNUSED(dev);
	ARG_UNUSED(channel_id);
	ARG_UNUSED(user_data);
	ARG_UNUSED(data);
	k_sem_give(&data_sem);
}

static int
rpmsg_recv_cs_callback(struct rpmsg_endpoint *ept, void *data, size_t len, uint32_t src, void *priv)
{
	ARG_UNUSED(ept);
	ARG_UNUSED(src);
	ARG_UNUSED(priv);
	struct sc_frame f;
	f.len = len < sizeof(f.data) ? len : sizeof(f.data);
	memcpy(f.data, data, f.len);
	/* Drop (don't block the OpenAMP RX path) if the echo queue is full -- it is
	 * bounded and the A55 side never has more than a couple frames in flight. */
	(void)k_msgq_put(&sc_frame_q, &f, K_NO_WAIT);
	return RPMSG_SUCCESS;
}

/* Returns false when the A55 asked for a link reset: it wrote vdev.status = 0
 * (no DRIVER_OK) and kicked, ahead of re-creating its virtio driver and
 * zeroing both vrings (#2586).  OpenAMP's rproc_virtio_notified() never looks
 * at the status, so the check has to happen here, before it walks a ring the
 * A55 is about to reset. */
static bool receive_message(void)
{
	if (k_sem_take(&data_sem, K_FOREVER) != 0) {
		return true;
	}
	uint8_t status = 0;
	(void)virtio_get_status(rvdev.vdev, &status);
	if ((status & VIRTIO_CONFIG_STATUS_DRIVER_OK) == 0U) {
		return false;
	}
	rproc_virtio_notified(rvdev.vdev, VRING1_ID);
	return true;
}

static void new_service_cb(struct rpmsg_device *rdev, const char *name, uint32_t src)
{
	ARG_UNUSED(rdev);
	ARG_UNUSED(src);
	LOG_INF("%s: message received from service %s", __func__, name);
}

/* OpenAMP calls this whenever a vring needs the peer's attention; on this
 * link that means "ring the MHU doorbell" (the actual payload is already
 * in shared memory -- the mailbox only ever carries a wakeup, never
 * data). */
/* Reverse doorbell: a direct MHU-B write, see alp_v2n_doorbell_ring(). */
int mailbox_notify(void *priv, uint32_t id)
{
	ARG_UNUSED(priv);
	ARG_UNUSED(id);
	alp_v2n_doorbell_ring();
	return 0;
}

int platform_init(void)
{
	void                    *rsc_tab_addr;
	int                      rsc_size;
	struct metal_device     *device;
	struct metal_init_params metal_params = METAL_INIT_DEFAULTS;
	int                      status;

	status = metal_init(&metal_params);
	if (status) {
		LOG_ERR("metal_init failed: %d", status);
		return -1;
	}

	status = metal_register_generic_device(&shm_device);
	if (status) {
		LOG_ERR("failed to register shared memory: %d", status);
		return -1;
	}

	status = metal_device_open("generic", SHM_DEVICE_NAME, &device);
	if (status) {
		LOG_ERR("metal_device_open failed: %d", status);
		return -1;
	}

	/* Region 0: the rpmsg buffer pool, shared verbatim with the A55. */
	metal_io_init(&device->regions[0], (void *)SHM_START_ADDR, &shm_physmap, SHM_SIZE, -1, 0, NULL);
	shm_io = metal_device_io_region(device, 0);
	if (!shm_io) {
		LOG_ERR("failed to get shm_io region");
		return -1;
	}

	/* Region 1: our resource table -- copied into place at RSC_TABLE_ADDR
	 * (the `rsctbl` DT node) so the A55's remoteproc attach can read it
	 * back over the matching UIO device.  This copy is deliberate, not
	 * link-placement: BL22 loads only this app's SRAM raw-bin, so a
	 * `.resource_table` section linked AT the DDR rsctbl address (0x9F7xxxxx)
	 * would simply never be loaded.  Keeping the const table in the SRAM
	 * image (zephyr/drivers/ipc/resource_table.c's `.resource_table` section) and memcpy'ing it
	 * here is what actually gets it into DDR (alp-sdk #683 address fix). */
	rsc_table_get(&rsc_tab_addr, &rsc_size);
	memcpy((void *)RSC_TABLE_ADDR, rsc_tab_addr, rsc_size);
	rsc_table = (struct fw_resource_table *)RSC_TABLE_ADDR;

	metal_io_init(&device->regions[1], (void *)RSC_TABLE_ADDR, &rsc_physmap, rsc_size, -1, 0, NULL);
	rsc_io = metal_device_io_region(device, 1);
	if (!rsc_io) {
		LOG_ERR("failed to get rsc_io region");
		return -1;
	}

	if (!mbox_is_ready_dt(&tx_channel)) {
		LOG_ERR("mailbox TX channel is not ready");
		return -1;
	}
	if (!mbox_is_ready_dt(&rx_channel)) {
		LOG_ERR("mailbox RX channel is not ready");
		return -1;
	}
	mbox_register_callback_dt(&rx_channel, platform_mbox_callback, NULL);
	status = mbox_set_enabled_dt(&rx_channel, true);
	if (status) {
		LOG_ERR("mbox_set_enabled_dt failed: %d", status);
		return -1;
	}

	return 0;
}

static void platform_deinit(void)
{
	mbox_set_enabled_dt(&rx_channel, false);
	metal_finish();
}

static void cleanup_system(void)
{
	/* rpmsg_deinit_vdev() NULLs rvdev.vdev, so take it first or
	 * rproc_virtio_remove_vdev() frees nothing (#2586: this path now runs
	 * once per A55 re-attach, so the leak would add up). */
	struct virtio_device *vdev = rvdev.vdev;

	rpmsg_deinit_vdev(&rvdev);
	rproc_virtio_remove_vdev(vdev);
	/* vdev.status is deliberately NOT written here: on the reset path the
	 * A55 already wrote 0 before kicking, and a store from this side could
	 * overwrite a DRIVER_OK the A55 has since set for its next attach. */
}

struct rpmsg_device *platform_create_rpmsg_vdev(unsigned int vdev_index,
                                                unsigned int role,
                                                void (*rst_cb)(struct virtio_device *vdev),
                                                rpmsg_ns_bind_cb ns_cb)
{
	ARG_UNUSED(vdev_index);
	ARG_UNUSED(rst_cb);

	struct fw_rsc_vdev_vring *vring_rsc;
	struct virtio_device     *vdev;
	int                       ret;

	vdev = rproc_virtio_create_vdev(VIRTIO_DEV_DEVICE,
	                                VDEV_ID,
	                                rsc_table_to_vdev(rsc_table),
	                                rsc_io,
	                                NULL,
	                                mailbox_notify,
	                                NULL);
	if (!vdev) {
		LOG_ERR("failed to create vdev");
		return NULL;
	}

	/* Block until the A55 side's remoteproc attach has published its own
	 * half of the handshake -- this is the "who goes first" resolution
	 * for an ATTACH-mode (not rproc-load) link: the M33 is already
	 * running (booted by BL22 before Linux even starts), so it waits
	 * here for Linux to catch up. */
	rproc_virtio_wait_remote_ready(vdev);

	vring_rsc = rsc_table_get_vring0(rsc_table);
	ret       = rproc_virtio_init_vring(vdev,
	                                    0,
	                                    vring_rsc->notifyid,
	                                    (void *)VRING_TX_ADDR_CM33,
	                                    rsc_io,
	                                    vring_rsc->num,
	                                    vring_rsc->align);
	if (ret) {
		LOG_ERR("failed to init vring 0: %d", ret);
		goto failed;
	}

	vring_rsc = rsc_table_get_vring1(rsc_table);
	ret       = rproc_virtio_init_vring(vdev,
	                                    1,
	                                    vring_rsc->notifyid,
	                                    (void *)VRING_RX_ADDR_CM33,
	                                    rsc_io,
	                                    vring_rsc->num,
	                                    vring_rsc->align);
	if (ret) {
		LOG_ERR("failed to init vring 1: %d", ret);
		goto failed;
	}

	/* rproc_virtio_create_vdev() makes a VIRTIO_DEV_DEVICE (not
	 * _DRIVER), so gfeatures is never set for us; rpmsg_init_vdev()
	 * below asserts gfeatures == dfeatures, so set it by hand -- we
	 * accept every remote feature the A55 offers. */
	virtio_set_features(vdev, 0x1);

	rpmsg_virtio_init_shm_pool(&shpool, NULL, SHM_SIZE);
	ret = rpmsg_init_vdev(&rvdev, vdev, ns_cb, shm_io, &shpool);
	if (ret) {
		LOG_ERR("rpmsg_init_vdev failed: %d", ret);
		goto failed;
	}

	alp_v2n_beacon_epoch_bump(); /* even -> odd: bound */
	return rpmsg_virtio_get_rpmsg_device(&rvdev);

failed:
	rproc_virtio_remove_vdev(vdev);
	return NULL;
}

/* Echoes every message it receives back to the same endpoint address --
 * lets the A55's rpmsg_sample_client validate the round trip byte-for-byte
 * (see the file header for why the echo is kept, not trimmed). */
static void app_rpmsg_client_sample(void *arg1, void *arg2, void *arg3)
{
	ARG_UNUSED(arg1);
	ARG_UNUSED(arg2);
	ARG_UNUSED(arg3);

	/* One pass per A55 attach.  Wait until the manager thread has created
	 * sc_ept (it does so inline, before its receive loop, to avoid dropping
	 * the A55's first frame -- see rpmsg_mng_task).  Then drain the echo queue
	 * until rpmsg_link_reset() queues the stop marker. */
	for (;;) {
		k_sem_take(&data_sc_sem, K_FOREVER);
		LOG_INF("rpmsg-v2n/m33_sm: Linux responder started");

		for (;;) {
			struct sc_frame f;
			if (k_msgq_get(&sc_frame_q, &f, K_FOREVER) != 0) {
				continue;
			}
			if (f.len == SC_FRAME_STOP) {
				break;
			}
			/* #697/#707 self-close-race harness: delay echoing any
			 * "slow"-prefixed method so the A55's blocked UINT32_MAX call
			 * stays in-flight while the fast "close_me" echo fires the
			 * self-close, so the two actually race.  Both frames are QUEUED
			 * (sc_frame_q) so neither is lost -- the fix for why #697 cycle 13
			 * never opened the window.  Frame is <method>\0<payload>
			 * (include/alp/rpc.h); normal echoes (echo_test) are unaffected. */
			if (f.len >= 4 && memcmp(f.data, "slow", 4) == 0) {
				k_sleep(K_MSEC(150));
			}
			if (atomic_get(&link_resetting) != 0) {
				continue; /* the A55 is resetting the link: drop it */
			}
			rpmsg_send(&sc_ept, f.data, f.len);
		}

		LOG_INF("rpmsg-v2n/m33_sm: Linux responder stopped");
		k_sem_give(&responder_stopped_sem);
	}
}

/* The A55 asked for a link reset (#2586): stop the responder, drop queued
 * frames, tear the virtio device down and acknowledge, so the next attach
 * starts from fresh ring indices on both sides. */
static void rpmsg_link_reset(void)
{
	struct sc_frame stop = { .len = SC_FRAME_STOP };

	atomic_set(&link_resetting, 1);
	k_msgq_purge(&sc_frame_q);
	(void)k_msgq_put(&sc_frame_q, &stop, K_FOREVER);
	k_sem_take(&responder_stopped_sem, K_FOREVER);

	/* An empty name skips the name-service destroy announcement
	 * rpmsg_destroy_ept() would otherwise queue onto the old A55 ring (the
	 * A55 is about to zero it); with no free TX buffer there rpmsg_send()
	 * busy-waits up to 15 s and the A55 gives up on the ack. */
	sc_ept.name[0] = '\0';
	cleanup_system();
	atomic_set(&link_resetting, 0);
	alp_v2n_beacon_epoch_bump(); /* odd -> even: waiting; the A55 may proceed */
}

static void rpmsg_mng_task(void *arg1, void *arg2, void *arg3)
{
	ARG_UNUSED(arg1);
	ARG_UNUSED(arg2);
	ARG_UNUSED(arg3);

	/* One pass per A55 attach (#2586): the virtio device and endpoint are
	 * re-created after every attach reset, because the A55 zeroes both vrings
	 * whenever it re-attaches and OpenAMP keeps the ring indices in the
	 * virtqueue objects. */
	for (;;) {
		LOG_INF("rpmsg-v2n/m33_sm: bringing up the rpmsg virtio device");

		rpdev = platform_create_rpmsg_vdev(0, VIRTIO_DEV_DEVICE, NULL, new_service_cb);
		if (!rpdev) {
			LOG_ERR("failed to create rpmsg virtio device");
			return;
		}

		/* Create the responder endpoint HERE -- before the receive_message()
		 * loop -- not in the responder thread.  The A55's first request sits on
		 * the RX vring until receive_message() processes it below; if sc_ept
		 * doesn't exist yet the rpmsg RX path drops that frame for want of a
		 * matching endpoint, and the A55's first alp_rpc_call() times out
		 * (#697: echo[1-byte] on a cold attach).  The old code created sc_ept
		 * in app_rpmsg_client_sample() via data_sc_sem, which raced this loop
		 * and lost.  Creating it inline, before the loop starts, guarantees
		 * the endpoint is live for the very first frame. */
		if (rpmsg_create_ept(&sc_ept,
		                     rpdev,
		                     "rpmsg-service-0",
		                     APP_EPT_ADDR,
		                     RPMSG_ADDR_ANY,
		                     rpmsg_recv_cs_callback,
		                     NULL) != 0) {
			LOG_ERR("failed to create responder endpoint");
			cleanup_system();
			alp_v2n_beacon_epoch_bump(); /* odd -> even: no longer bound */
			return;
		}

		/* Release the responder thread's echo loop now that sc_ept exists. */
		k_sem_give(&data_sc_sem);
		while (receive_message()) {
		}

		LOG_INF("rpmsg-v2n/m33_sm: A55 reset the link; waiting for the next attach");
		rpmsg_link_reset();
	}
}

int main(void)
{
	/* CRITICAL: the liveness beacon is the VERY FIRST action, ahead of
	 * OpenAMP/libmetal/driver init below -- so a bench `devmem` read that
	 * catches this firmware mid-fault still sees "alive, once" rather than
	 * nothing at all.  It also goes ahead of the first LOG_INF: a boot was
	 * seen to stall inside main()'s first log call before the beacon (#3068). */
	alp_v2n_beacon_start();

	LOG_INF("rpmsg-v2n/m33_sm: starting (alp-sdk #683, Path B Phase 1)");

	if (platform_init() != 0) {
		LOG_ERR("platform_init failed");
		return -1;
	}

	k_thread_create(&thread_mng_data,
	                thread_mng_stack,
	                APP_TASK_STACK_SIZE,
	                (k_thread_entry_t)rpmsg_mng_task,
	                NULL,
	                NULL,
	                NULL,
	                K_PRIO_COOP(8),
	                0,
	                K_NO_WAIT);
	k_thread_create(&thread_rp_client_data,
	                thread_rp_client_stack,
	                APP_TASK_STACK_SIZE,
	                (k_thread_entry_t)app_rpmsg_client_sample,
	                NULL,
	                NULL,
	                NULL,
	                K_PRIO_COOP(7),
	                0,
	                K_NO_WAIT);

	k_thread_join(&thread_mng_data, K_FOREVER);
	k_thread_join(&thread_rp_client_data, K_FOREVER);

	platform_deinit();
	return 0;
}
```

## src/resource_table.c
```c
/*
 * Copyright 2026 Alp Lab AB
 * SPDX-License-Identifier: Apache-2.0
 *
 * Overriding Zephyr's generic OpenAMP resource table with a hand-built one
 * whose vring0/vring1 addresses already match this link's master (the
 * A55/Linux OpenAMP implementation expects those addresses to be resolved
 * by IT, not by us -- see resource_table.h's header comment).  This is
 * placed in the `.resource_table` link section: the Linux OpenAMP
 * remoteproc loader locates a firmware's resource table by scanning the
 * ELF for that exact section name, so any renaming here breaks the A55
 * attach path silently.
 */

#include <zephyr/kernel.h>
#include <resource_table.h>

#define __resource Z_GENERIC_SECTION(.resource_table)

static struct fw_resource_table __resource resource_table = {
	.ver      = 1,
	.num      = RSC_TABLE_NUM_ENTRY,
	.reserved = { 0, 0 },
	/* Offset */
	{
	    offsetof(struct fw_resource_table, vdev),
	},
	/* Virtio device entry */
	{
	    RSC_VDEV,
	    VIRTIO_ID_RPMSG,
	    0,
	    RPMSG_IPU_C0_FEATURES,
	    0,
	    0,
	    0,
	    VRING_COUNT,
	    { 0, 0 },
	},
	/* Vring rsc entry -- part of vdev rsc entry */
	.vring0 = { VRING_TX_ADDR_A55, VRING_ALIGNMENT, RSC_TABLE_NUM_RPMSG_BUFF, VRING0_ID, 0 },
	.vring1 = { VRING_RX_ADDR_A55, VRING_ALIGNMENT, RSC_TABLE_NUM_RPMSG_BUFF, VRING1_ID, 0 },
};

void rsc_table_get(void **table_ptr, int *length)
{
	*table_ptr = (void *)&resource_table;
	*length    = sizeof(resource_table);
}
```

## src/resource_table.h
```c
/*
 * Copyright 2026 Alp Lab AB
 * SPDX-License-Identifier: Apache-2.0
 *
 * OpenAMP resource table for the RZ/V2N M33-SM <-> A55/Linux rpmsg link
 * (alp-sdk #683, Path B Phase 1).
 *
 * Adapted near-verbatim from Renesas's own
 * zephyr/samples/boards/renesas/openamp_linux_zephyr/src/resource_table.h --
 * this header has no RZ/V2L-specific content (only the generic OpenAMP
 * vdev/vring shapes + a CM33<->A55 address helper), so porting to V2N is a
 * straight reuse.  The board-level `vring_ctrl0` / `vring_ctrl1` devicetree
 * nodes this file reads addresses from are declared in this project's board
 * overlay (zephyr/boards/alp/e1m_v2n101_m33_sm/...cm33.dts).
 *
 * Per the commit this comment block in the vendor header references
 * (25ec73986b, "lib: open-amp: add helper to add resource table in
 * project"): vring TX/RX addresses are allocated by the rpmsg MASTER (the
 * A55/Linux side here), so this slave publishes them in its own resource
 * table for the master to read back -- CONFIG_OPENAMP_RSC_TABLE=n in this
 * example's prj.conf (see main.c) so nothing overwrites this table with a
 * Zephyr-generated one.
 */

#ifndef RESOURCE_TABLE_H__
#define RESOURCE_TABLE_H__

#include <openamp/remoteproc.h>
#include <openamp/virtio.h>

#ifdef __cplusplus
extern "C" {
#endif

#define VDEV_ID   0xFF
#define VRING0_ID 0
#define VRING1_ID 1

#define VRING_COUNT           2
#define RPMSG_IPU_C0_FEATURES 1

#define R_VRING_TX         DT_NODELABEL(vring_ctrl0)
#define R_VRING_RX         DT_NODELABEL(vring_ctrl1)
#define VRING_TX_ADDR_CM33 DT_REG_ADDR(R_VRING_TX)
#define VRING_RX_ADDR_CM33 DT_REG_ADDR(R_VRING_RX)

/*
 * CM33 <-> A55 address-space translation, corrected against the
 * AUTHORITATIVE V2N slave-address map (Renesas FSP
 * drivers/rz/fsp/src/rzv/bsp/mcu/rzv2n/bsp_slave_address.h): the DDR
 * window is CM33-secure 0x80000000 / CM33-non-secure 0x90000000 /
 * A55 0x40000000, 256 MiB.  So the non-secure alias reads/writes the
 * same physical memory as the A55 sees at (addr - 0x50000000), and the
 * secure alias is (addr - 0x40000000) -- NOT the RZ/V2L offsets
 * (0x20000000 / 0x30000000) this file was ported from, which put every
 * CM33-NS OpenAMP address below the A55 DRAM base (0x48000000) on V2N,
 * i.e. unbacked memory.  Only the non-secure helper is used here -- this
 * link runs entirely in the non-secure world on both cores.
 */
#ifndef _ASMLANGUAGE

#define CM33_ADDRESS_OFFSET_SECURE    (0x40000000)
#define CM33_ADDRESS_OFFSET_NONSECURE (0x50000000)
#define CM33_TO_A55_ADDR_S(x)         ((x) - CM33_ADDRESS_OFFSET_SECURE)
#define CM33_TO_A55_ADDR_NS(x)        ((x) - CM33_ADDRESS_OFFSET_NONSECURE)

#endif

#define VRING_TX_ADDR_A55 CM33_TO_A55_ADDR_NS(VRING_TX_ADDR_CM33)
#define VRING_RX_ADDR_A55 CM33_TO_A55_ADDR_NS(VRING_RX_ADDR_CM33)
#define VRING_ALIGNMENT   (0x100U)

#define RSC_TABLE_NUM_RPMSG_BUFF 512

enum rsc_table_entries { RSC_TABLE_VDEV_ENTRY, RSC_TABLE_NUM_ENTRY };

struct fw_resource_table {
	unsigned int ver;
	unsigned int num;
	unsigned int reserved[2];
	unsigned int offset[RSC_TABLE_NUM_ENTRY];

	struct fw_rsc_vdev       vdev;
	struct fw_rsc_vdev_vring vring0;
	struct fw_rsc_vdev_vring vring1;
} METAL_PACKED_END;

void rsc_table_get(void **table_ptr, int *length);

static inline struct fw_rsc_vdev *rsc_table_to_vdev(void *rsc_table)
{
	return &((struct fw_resource_table *)rsc_table)->vdev;
}

static inline struct fw_rsc_vdev_vring *rsc_table_get_vring0(void *rsc_table)
{
	return &((struct fw_resource_table *)rsc_table)->vring0;
}

static inline struct fw_rsc_vdev_vring *rsc_table_get_vring1(void *rsc_table)
{
	return &((struct fw_resource_table *)rsc_table)->vring1;
}

#ifdef __cplusplus
}
#endif

#endif /* RESOURCE_TABLE_H__ */
```
