## CMakeLists.txt
```
# SPDX-License-Identifier: Apache-2.0
#
# Cortex-M33-SM / Zephyr slice of microros-ros2-v2n.  Same bring-up recipe
# as ../../rpmsg-v2n/m33_sm/CMakeLists.txt (read that file for the "why" of
# each step); the differences are called out inline.

cmake_minimum_required(VERSION 3.20)

if(DEFINED ENV{ALP_SDK_ROOT})
    set(ALP_SDK_ROOT $ENV{ALP_SDK_ROOT})
else()
    get_filename_component(ALP_SDK_ROOT ${CMAKE_CURRENT_SOURCE_DIR}/../../../.. ABSOLUTE)
endif()

# Python BEFORE Zephyr (Zephyr pins an interpreter on import).
find_package(Python3 REQUIRED COMPONENTS Interpreter)

# Per-core alp.conf (generated/alp.conf) is layered by the build plan /
# scripts/gen_example_alp_conf.py via EXTRA_CONF_FILE, not by this file.

# micro-ROS: the west project micro_ros_zephyr_module is NOT itself a Zephyr
# module (no zephyr/module.yml at its root); the module proper is its
# modules/libmicroros subdirectory, so hand that to Zephyr explicitly.
#
# The carried patches below must never touch the shared west checkout (it is
# one tree for every build and every example).  So the default is a PER-BUILD
# COPY of the pinned module under this build directory, patched there:
#   MICROROS_ZEPHYR_MODULE_SRC  the pinned checkout, read-only (west.yml path)
#   MICROROS_ZEPHYR_MODULE_DIR  override: patch THIS checkout in place instead
#                               (e.g. -DMICROROS_ZEPHYR_MODULE_DIR=/my/module)
set(MICROROS_ZEPHYR_MODULE_SRC
    "$ENV{ZEPHYR_BASE}/../modules/lib/micro_ros_zephyr_module"
    CACHE PATH "pinned micro_ros_zephyr_module checkout (west.yml path), never modified")
set(MICROROS_ZEPHYR_MODULE_DIR "" CACHE PATH
    "micro_ros_zephyr_module to patch in place; empty = per-build copy of MICROROS_ZEPHYR_MODULE_SRC")
if(NOT MICROROS_ZEPHYR_MODULE_DIR)
    set(MICROROS_ZEPHYR_MODULE_DIR ${CMAKE_BINARY_DIR}/micro_ros_zephyr_module)
    if(NOT EXISTS ${MICROROS_ZEPHYR_MODULE_DIR}/modules/libmicroros)
        # .git comes along so `git apply` below runs inside the copy's own
        # repo, not inside whatever repository the build directory sits in.
        file(COPY ${MICROROS_ZEPHYR_MODULE_SRC}/
             DESTINATION ${MICROROS_ZEPHYR_MODULE_DIR})
    endif()
endif()
# Carried patches, applied in order (each file's header says why):
#   0001  no "bring your own transport" Kconfig choice in the pinned module
#   0002  the module's colcon cross-build and link on Zephyr 4.4 / picolibc
# Apply each once; already-applied is detected by a reverse check.
file(GLOB _microros_patches ${CMAKE_CURRENT_SOURCE_DIR}/patches/*.patch)
list(SORT _microros_patches)
foreach(_microros_patch IN LISTS _microros_patches)
    execute_process(
        COMMAND git -C ${MICROROS_ZEPHYR_MODULE_DIR} apply --reverse --check ${_microros_patch}
        RESULT_VARIABLE _microros_patched OUTPUT_QUIET ERROR_QUIET)
    if(NOT _microros_patched EQUAL 0)
        execute_process(
            COMMAND git -C ${MICROROS_ZEPHYR_MODULE_DIR} apply ${_microros_patch}
            RESULT_VARIABLE _microros_rv ERROR_VARIABLE _microros_err)
        if(NOT _microros_rv EQUAL 0)
            message(FATAL_ERROR "cannot apply ${_microros_patch} to ${MICROROS_ZEPHYR_MODULE_DIR}: ${_microros_err}")
        endif()
    endif()
endforeach()
list(APPEND ZEPHYR_EXTRA_MODULES ${MICROROS_ZEPHYR_MODULE_DIR}/modules/libmicroros)

find_package(Zephyr REQUIRED HINTS $ENV{ZEPHYR_BASE})
project(microros_ros2_v2n_m33_sm LANGUAGES C)

# Two libmetal regions: the rpmsg buffer pool + the resource table.
zephyr_compile_definitions(METAL_MAX_DEVICE_REGIONS=2)

# Reuse the SDK's bench-proven vendor-shaped resource table verbatim rather
# than forking it; the board's devicetree is the same.
set(_rpmsg_v2n_src ${ALP_SDK_ROOT}/zephyr/drivers/ipc)

target_include_directories(app PRIVATE ${LIBMETAL_INCLUDE_DIR} ${OPENAMP_INCLUDE_DIR}
                            ${PLATFORM_DIR} src ${_rpmsg_v2n_src})
target_sources(app PRIVATE src/main.c src/rpmsg_link.c ${_rpmsg_v2n_src}/resource_table.c
                           ${_rpmsg_v2n_src}/alp_v2n_beacon.c)
```

## prj.conf
```kconfig
# SPDX-License-Identifier: Apache-2.0
#
# The rest of this app's Kconfig comes from build/generated/alp.conf
# (emitted from ../board.yaml, layered via EXTRA_CONF_FILE).

# --- micro-ROS (module pinned in west.yml, ADR 0018) --------------------
# Master enable of micro_ros_zephyr_module.  The module cross-builds the
# whole micro-ROS client stack (rcl/rclc/rmw_microxrcedds/Micro XRCE-DDS
# Client) with colcon at configure time.
CONFIG_MICROROS=y
# Transport: the app supplies its own (RPMsg).  CUSTOM comes from
# m33_sm/patches/ (the pinned module ships only serial/serial-usb/udp).
CONFIG_MICROROS_TRANSPORT_CUSTOM=y
# XRCE datagram MTU must fit one RPMsg payload: 496-byte buffer minus the
# 5-byte "xrce\0" method header = 491 (module default is 512).
CONFIG_MICROROS_XRCE_DDS_MTU="491"
# rclc + rcl make deep call chains.  The module's own sample sets
# MAIN_STACK_SIZE=25000 and also NEWLIB_LIBC=y, NEWLIB_LIBC_NANO=n,
# POSIX_CLOCK=y, CPP=y, PTHREAD_IPC=n.  The values below deviate from that:
# stack 10000 (unproven at runtime), POSIX_API, and the default (picolibc)
# libc instead of newlib -- the combination the build was verified with
# (m33_sm/patches/0002).
CONFIG_MAIN_STACK_SIZE=10000
CONFIG_HEAP_MEM_POOL_SIZE=32768
# micro-ROS needs a POSIX clock (rmw_uros_sync_session, rcutils time).
CONFIG_POSIX_API=y

# --- RPMsg link (identical to ../../rpmsg-v2n/m33_sm/prj.conf) -----------
CONFIG_MBOX=y
CONFIG_OPENAMP=y
# Ship our own vendor-shaped resource table (zephyr/drivers/ipc/resource_table.c).
CONFIG_OPENAMP_RSC_TABLE=n

# This firmware drives the link with raw OpenAMP itself (src/); the board.yaml
# ipc: rpmsg entry must not also pull in the <alp/rpc.h> ipc_service backend.
CONFIG_IPC_SERVICE_BACKEND_ALP_V2N_RPMSG=n
```

## src/main.c
```c
/*
 * Copyright 2026 Alp Lab AB
 * SPDX-License-Identifier: Apache-2.0
 *
 * microros-ros2-v2n / m33_sm -- a micro-ROS node on the RZ/V2N Cortex-M33.
 *
 * WHAT THIS DEMONSTRATES
 *   A ROS 2 node running on a microcontroller: it publishes a
 *   std_msgs/Int32 counter on the topic `alp_counter` once per second, and
 *   an ordinary `ros2 topic echo` on the Cortex-A55 (Yocto side) prints it.
 *   No ROS 2 is installed on the M33; micro-ROS is a thin client that speaks
 *   the Micro XRCE-DDS protocol to a "micro-ROS agent", and the agent turns
 *   that into real DDS traffic for the rest of the ROS 2 graph.
 *
 * WHERE THE BYTES GO  (docs/adr/0035-micro-ros-cross-core-transport.md, Option B)
 *
 *   this file            rpmsg_link.c        A55: linux/src/bridge.c     A55: agent
 *   rclc publisher --> custom transport --> RPMsg (ADR 0016) --> UDP 127.0.0.1:8888 --> micro-ROS
 *   (rcl_publish)      (4 callbacks below)  <alp/rpc.h> "xrce"    unmodified udp4      agent
 *
 *   The XRCE client normally talks over serial or UDP.  Both need a device
 *   the M33 does not have towards the A55 (the V2N Yocto BSP has no kernel
 *   rpmsg tty/netdev), so we use micro-ROS's *custom transport* hook instead:
 *   four callbacks -- open / close / write / read -- that move opaque
 *   datagrams.  Our callbacks are thin wrappers over rpmsg_link.c.
 *
 * WHY framing = false
 *   Serial transports need HDLC framing + CRC to find packet boundaries in a
 *   byte stream.  RPMsg is already message-oriented (one send = one receive),
 *   so we pass framing=false and each callback moves exactly one XRCE
 *   datagram.
 *
 * STATUS: the platform_init path builds on Zephyr 4.4.1 and boots past platform_init on an
 * E1M-V2M103 (2026-10-07; main() ran and wrote the resource table).  The AMP beacon and
 * attach-reset code in rpmsg_link.c is not yet compiled.  NOT
 * proven: a ROS 2 topic round-trip with a micro-ROS agent.  See README.md
 * ("What is untested").
 */

#include <zephyr/kernel.h>
#include <zephyr/sys/printk.h>

#include <rcl/error_handling.h>
#include <rcl/rcl.h>
#include <rclc/rclc.h>
#include <rmw_microros/rmw_microros.h>
#include <std_msgs/msg/int32.h>

#include "rpmsg_link.h"

/* Status lines go through printk, not LOG_*: the CM33 has no UART, its only
 * console is the RAM console (docs/heterogeneous-builds.md), and the board
 * defconfig sets CONFIG_LOG_PRINTK=n, so no log backend would ever carry a
 * LOG_INF line there.  printk lands in the RAM console directly. */
#define STATUS(fmt, ...) printk("microros_v2n: " fmt "\n", ##__VA_ARGS__)

/* ------------------------------------------------------------------ */
/* Custom XRCE transport: open / close / write / read over RPMsg       */
/* ------------------------------------------------------------------ */

/* Called by the XRCE client when it opens a session.  Returns true when the
 * link is usable.  The M33 is the RPMsg *slave* and cannot address the A55
 * until the bridge has spoken first, so "open" means "wait for the bridge's
 * first frame".  The 1 s timeout lets the caller's ping loop keep retrying
 * (and keeps the log alive) instead of blocking forever. */
static bool transport_open(struct uxrCustomTransport *t)
{
	ARG_UNUSED(t);
	return rpmsg_link_wait_peer(1000) == 0;
}

/* Nothing to tear down: the RPMsg endpoint lives for the life of the app so a
 * new XRCE session (after an agent restart) can reuse it. */
static bool transport_close(struct uxrCustomTransport *t)
{
	ARG_UNUSED(t);
	return true;
}

/* One call = one datagram to the agent.  Returns the number of bytes written;
 * 0 plus *err != 0 tells the client the write failed.  Datagrams larger than
 * the RPMsg payload (RPMSG_LINK_MTU) are refused -- prj.conf sets
 * CONFIG_MICROROS_XRCE_DDS_MTU to 491 so the client never emits one. */
static size_t
transport_write(struct uxrCustomTransport *t, const uint8_t *buf, size_t len, uint8_t *err)
{
	ARG_UNUSED(t);
	size_t n = rpmsg_link_send(buf, len);

	*err = (n == len) ? 0 : 1;
	return n;
}

/* Wait up to timeout_ms (the client passes its own poll interval) for one
 * datagram from the agent.  Returns 0 on timeout -- that is the normal idle
 * case, not an error, so *err stays 0. */
static size_t
transport_read(struct uxrCustomTransport *t, uint8_t *buf, size_t len, int timeout_ms, uint8_t *err)
{
	ARG_UNUSED(t);
	*err = 0;
	return rpmsg_link_recv(buf, len, timeout_ms);
}

/* ------------------------------------------------------------------ */
/* The micro-ROS node                                                  */
/* ------------------------------------------------------------------ */

#define PUBLISH_PERIOD_MS 1000

/* rclc calls return rcl_ret_t; anything but RCL_RET_OK aborts this session. */
#define RC_OK(call) \
	({ \
		rcl_ret_t rc_ = (call); \
		if (rc_ != RCL_RET_OK) { \
			STATUS("%s failed: %d (line %d)", #call, (int)rc_, __LINE__); \
		} \
		rc_ == RCL_RET_OK; \
	})

/* One XRCE session: create the node + publisher, publish until a publish
 * fails (agent gone / bridge restarted), then tear everything down so main()
 * can start a fresh session.  Returns when the session is over. */
static void run_session(void)
{
	rcl_allocator_t      allocator = rcl_get_default_allocator();
	rclc_support_t       support;
	rcl_node_t           node;
	rcl_publisher_t      pub;
	std_msgs__msg__Int32 msg = { .data = 0 };

	if (!RC_OK(rclc_support_init(&support, 0, NULL, &allocator))) {
		return;
	}
	if (!RC_OK(rclc_node_init_default(&node, "alp_v2n_m33", "", &support))) {
		goto fini_support;
	}
	if (!RC_OK(rclc_publisher_init_default(
	        &pub, &node, ROSIDL_GET_MSG_TYPE_SUPPORT(std_msgs, msg, Int32), "alp_counter"))) {
		goto fini_node;
	}

	STATUS("publishing std_msgs/Int32 on /alp_counter every %d ms", PUBLISH_PERIOD_MS);
	while (RC_OK(rcl_publish(&pub, &msg, NULL))) {
		msg.data++;
		k_msleep(PUBLISH_PERIOD_MS);
	}

	/* Teardown results are only reported: the session is over either way and
	 * main() starts a fresh one.  GCC's warn_unused_result is not silenced by
	 * a (void) cast, so the code is checked via RC_OK, which logs a failure. */
	(void)RC_OK(rcl_publisher_fini(&pub, &node));
fini_node:
	(void)RC_OK(rcl_node_fini(&node));
fini_support:
	(void)RC_OK(rclc_support_fini(&support));
}

int main(void)
{
	if (rpmsg_link_start() != 0) {
		STATUS("rpmsg link bring-up failed");
		return -1;
	}

	/* framing=false: RPMsg already delimits messages (see file header).
	 * args=NULL: our callbacks keep their state in rpmsg_link.c. */
	rmw_uros_set_custom_transport(
	    false, NULL, transport_open, transport_close, transport_write, transport_read);

	for (;;) {
		/* Ping the agent (through the transport above) until it answers:
		 * 1 s timeout, 5 attempts per round.  This is what makes start
		 * order irrelevant -- the M33 boots first, the agent may come
		 * up minutes later. */
		if (rmw_uros_ping_agent(1000, 5) != RMW_RET_OK) {
			STATUS("waiting for the micro-ROS agent (is the A55 bridge running?)");
			continue;
		}
		STATUS("agent reachable, starting session");
		run_session();
		STATUS("session ended, retrying");
		k_msleep(1000);
	}
	return 0;
}
```

## src/rpmsg_link.c
```c
/*
 * Copyright 2026 Alp Lab AB
 * SPDX-License-Identifier: Apache-2.0
 *
 * rpmsg_link -- OpenAMP/RPMsg plumbing for the micro-ROS transport.
 *
 * The bring-up half of this file (metal device, resource table copy, MHU
 * doorbell, vdev creation) is the BENCH-PROVEN sequence from
 * ../../rpmsg-v2n/m33_sm/src/main.c (alp-sdk #683/#697/#2374), trimmed to
 * what a datagram pipe needs: no self-close test harness, no echo.  The
 * AMP liveness beacon and the attach-reset handshake are kept: the A55 side
 * (yocto_uio_drv.c) requires both (see "Attach protocol" below).  It is
 * duplicated on purpose rather than refactored out of rpmsg-v2n so the
 * proven example stays untouched; see README.md ("Maintainer decisions")
 * for the follow-up to share one platform file.
 * The M33 endpoint address (1024) and the doorbell asymmetry are explained
 * in that file's header and are not repeated here.
 *
 * What this file adds is the datagram layer.  The A55 side is
 * <alp/rpc.h> (yocto_uio_drv.c), which frames every RPMsg payload as
 * `<method>\0<bytes>`.  We carry XRCE datagrams under the method "xrce"
 * and treat any other method (the bridge sends "hello") purely as a
 * "peer is alive" signal:
 *
 *     A55 bridge                              M33 (this file)
 *     ----------                              ---------------
 *     "hello\0"        ------------------->   rpmsg learns the A55 address
 *                                             from the frame source;
 *                                             peer_sem fires
 *     "xrce\0<XRCE>"   <------------------>   queued -> rpmsg_link_recv()
 *                                             rpmsg_link_send() -> "xrce\0<XRCE>"
 *
 * Attach protocol (same as ../../rpmsg-v2n/m33_sm/src/main.c, #683/#2586)
 *   The A55 backend (src/backends/rpc/yocto_uio_drv.c, uio_attach_reset())
 *   runs on EVERY alp_rpc_open().  It reads the beacon at the top of the
 *   rsctbl page (<alp/protocol/amp_beacon.h>, published by the shared
 *   zephyr/drivers/ipc/alp_v2n_beacon.c) and:
 *     - no magic            -> fails the open with ALP_ERR_NOT_READY;
 *     - epoch ODD (bound)   -> writes vdev.status = 0, kicks, and waits for
 *                              EVEN, then zeroes both vrings;
 *     - epoch EVEN          -> proceeds straight to zeroing the vrings.
 *   So this firmware must (1) publish the beacon first thing, (2) bump the
 *   epoch to ODD once the virtio device is bound, and (3) on a doorbell that
 *   finds DRIVER_OK clear, tear the vdev down, bump the epoch back to EVEN
 *   and build a fresh vdev -- the A55 zeroes the vrings, and OpenAMP keeps
 *   its ring indices in the virtqueue objects, so reusing the old vdev would
 *   desync the second bridge run in one CM33 boot.
 */

#include <string.h>

#include <zephyr/device.h>
#include <zephyr/drivers/mbox.h>
#include <zephyr/kernel.h>
#include <zephyr/logging/log.h>
#include <zephyr/sys/atomic.h>

#include <metal/device.h>
#include <openamp/open_amp.h>

#include "alp_v2n_beacon.h"
#include "resource_table.h"
#include "rpmsg_link.h"

LOG_MODULE_REGISTER(rpmsg_link, LOG_LEVEL_INF);

#define SHM_DEVICE_NAME "shm"

#if !DT_HAS_CHOSEN(zephyr_ipc_shm)
#error \
    "microros-ros2-v2n/m33_sm requires `chosen { zephyr,ipc_shm = ...; }` -- see the board overlay"
#endif

/* Fixed endpoint address the A55 bridge dials -- same constant as
 * rpmsg-v2n (APP_EPT_ADDR) so alp_rpc_open()'s dst_ept matches. */
#define APP_EPT_ADDR (1024)

#define SHM_NODE       DT_CHOSEN(zephyr_ipc_shm)
#define SHM_START_ADDR DT_REG_ADDR(SHM_NODE)
#define SHM_SIZE       DT_REG_SIZE(SHM_NODE)
#define RSC_TABLE_ADDR DT_REG_ADDR(DT_NODELABEL(rsctbl))

/* <alp/rpc.h> method that carries XRCE datagrams; the length includes the NUL. */
#define XRCE_METHOD     "xrce"
#define XRCE_METHOD_LEN (sizeof(XRCE_METHOD))

#define LINK_STACK_SIZE 2048
K_THREAD_STACK_DEFINE(link_stack, LINK_STACK_SIZE);
static struct k_thread link_thread;

static const struct mbox_dt_spec tx_channel = MBOX_DT_SPEC_GET(DT_CHOSEN(zephyr_ipc), tx);
static const struct mbox_dt_spec rx_channel = MBOX_DT_SPEC_GET(DT_CHOSEN(zephyr_ipc), rx);

static metal_phys_addr_t shm_physmap = CM33_TO_A55_ADDR_NS(SHM_START_ADDR);
static metal_phys_addr_t rsc_physmap = RSC_TABLE_ADDR;

struct metal_device shm_device = {
	.name        = SHM_DEVICE_NAME,
	.num_regions = 2,
	{
	    { .virt = NULL }, /* shared memory */
	    { .virt = NULL }, /* rsc_table memory */
	},
	.node    = { NULL },
	.irq_num = 0,
};

static struct metal_io_region      *shm_io;
static struct rpmsg_virtio_shm_pool shpool;
static struct metal_io_region      *rsc_io;
static struct rpmsg_virtio_device   rvdev;
static void                        *rsc_table;
static struct rpmsg_device         *rpdev;
static struct rpmsg_endpoint        ept;

/* One received XRCE datagram, method header already stripped. */
struct datagram {
	uint16_t len;
	uint8_t  data[RPMSG_LINK_MTU];
};
K_MSGQ_DEFINE(rx_q, sizeof(struct datagram), 8, 4);

static K_SEM_DEFINE(doorbell_sem, 0, 1); /* A55 kicked the mailbox */
static K_SEM_DEFINE(peer_sem, 0, 1);     /* first frame from the A55 seen */

/* Set while link_reset() tears the link down: rpmsg_link_send() refuses to
 * touch the endpoint of a vdev that is being removed. */
static atomic_t link_resetting;

/* Serialises the sender against teardown.  rpmsg_link_send() holds it across
 * the (non-blocking) send; link_reset() takes it before rpmsg_deinit_vdev(),
 * so a publish already in flight drains first and a later one sees
 * link_resetting under the lock.  Priority inheritance lifts the preempted
 * sender above link_task while link_task waits. */
static K_MUTEX_DEFINE(send_lock);

static void mbox_rx_cb(const struct device *dev, mbox_channel_id_t ch, void *u, struct mbox_msg *m)
{
	ARG_UNUSED(dev);
	ARG_UNUSED(ch);
	ARG_UNUSED(u);
	ARG_UNUSED(m);
	k_sem_give(&doorbell_sem);
}

/* Runs on the manager thread (inside rproc_virtio_notified). */
static int ept_rx_cb(struct rpmsg_endpoint *e, void *data, size_t len, uint32_t src, void *priv)
{
	ARG_UNUSED(e);
	ARG_UNUSED(src);
	ARG_UNUSED(priv);

	/* Any frame proves the A55 is there; open-amp has already recorded its
	 * address as our reply destination (we created the ept with RPMSG_ADDR_ANY). */
	k_sem_give(&peer_sem);

	if (len <= XRCE_METHOD_LEN || memcmp(data, XRCE_METHOD, XRCE_METHOD_LEN) != 0) {
		return RPMSG_SUCCESS; /* "hello" or anything else: liveness only */
	}

	struct datagram d;
	d.len = (uint16_t)(len - XRCE_METHOD_LEN);
	if (d.len > sizeof(d.data)) {
		return RPMSG_SUCCESS; /* cannot happen: rpmsg buffers are 496 B */
	}
	memcpy(d.data, (const uint8_t *)data + XRCE_METHOD_LEN, d.len);
	/* Never block the OpenAMP RX path; XRCE reliable streams retransmit. */
	if (k_msgq_put(&rx_q, &d, K_NO_WAIT) != 0) {
		LOG_WRN("rx queue full, dropped %u B datagram", d.len);
	}
	return RPMSG_SUCCESS;
}

int mailbox_notify(void *priv, uint32_t id)
{
	ARG_UNUSED(priv);
	ARG_UNUSED(id);
	/* CM33 -> A55 doorbell: the line <alp/protocol/v2n_mhu_doorbell.h> selects (SWINT unit 12 by
	 * default, rsp_ch8_ns with CONFIG_ALP_V2N_DOORBELL_RSP_CH8), the one the A55 backend listens on. */
	alp_v2n_doorbell_ring();
	return 0;
}

static int platform_init(void)
{
	void                    *rsc_tab_addr;
	int                      rsc_size;
	struct metal_device     *device;
	struct metal_init_params metal_params = METAL_INIT_DEFAULTS;

	if (metal_init(&metal_params) || metal_register_generic_device(&shm_device) ||
	    metal_device_open("generic", SHM_DEVICE_NAME, &device)) {
		LOG_ERR("libmetal init failed");
		return -1;
	}

	metal_io_init(&device->regions[0], (void *)SHM_START_ADDR, &shm_physmap, SHM_SIZE, -1, 0, NULL);
	shm_io = metal_device_io_region(device, 0);

	/* Copy the resource table into the DDR window the A55 attaches to
	 * (BL22 only loads the SRAM image; see rpmsg-v2n main.c). */
	rsc_table_get(&rsc_tab_addr, &rsc_size);
	memcpy((void *)RSC_TABLE_ADDR, rsc_tab_addr, rsc_size);
	rsc_table = (struct fw_resource_table *)RSC_TABLE_ADDR;
	metal_io_init(&device->regions[1], (void *)RSC_TABLE_ADDR, &rsc_physmap, rsc_size, -1, 0, NULL);
	rsc_io = metal_device_io_region(device, 1);
	if (!shm_io || !rsc_io) {
		LOG_ERR("failed to get libmetal io regions");
		return -1;
	}

	if (!mbox_is_ready_dt(&tx_channel) || !mbox_is_ready_dt(&rx_channel)) {
		LOG_ERR("mailbox channels not ready");
		return -1;
	}
	mbox_register_callback_dt(&rx_channel, mbox_rx_cb, NULL);
	if (mbox_set_enabled_dt(&rx_channel, true)) {
		LOG_ERR("mbox_set_enabled_dt failed");
		return -1;
	}
	return 0;
}

static struct rpmsg_device *create_rpmsg_vdev(void)
{
	struct fw_rsc_vdev_vring *vring_rsc;
	struct virtio_device     *vdev;

	vdev = rproc_virtio_create_vdev(VIRTIO_DEV_DEVICE,
	                                VDEV_ID,
	                                rsc_table_to_vdev(rsc_table),
	                                rsc_io,
	                                NULL,
	                                mailbox_notify,
	                                NULL);
	if (!vdev) {
		LOG_ERR("failed to create vdev");
		return NULL;
	}

	/* ATTACH mode: this M33 is already running, wait for Linux to catch up. */
	rproc_virtio_wait_remote_ready(vdev);

	vring_rsc = rsc_table_get_vring0(rsc_table);
	if (rproc_virtio_init_vring(vdev,
	                            0,
	                            vring_rsc->notifyid,
	                            (void *)VRING_TX_ADDR_CM33,
	                            rsc_io,
	                            vring_rsc->num,
	                            vring_rsc->align)) {
		goto failed;
	}
	vring_rsc = rsc_table_get_vring1(rsc_table);
	if (rproc_virtio_init_vring(vdev,
	                            1,
	                            vring_rsc->notifyid,
	                            (void *)VRING_RX_ADDR_CM33,
	                            rsc_io,
	                            vring_rsc->num,
	                            vring_rsc->align)) {
		goto failed;
	}

	/* VIRTIO_DEV_DEVICE never sets gfeatures; rpmsg_init_vdev() asserts them
	 * equal, so accept every feature the A55 offers. */
	virtio_set_features(vdev, 0x1);
	rpmsg_virtio_init_shm_pool(&shpool, NULL, SHM_SIZE);
	if (rpmsg_init_vdev(&rvdev, vdev, NULL, shm_io, &shpool)) {
		goto failed;
	}
	alp_v2n_beacon_epoch_bump(); /* even -> odd: bound */
	return rpmsg_virtio_get_rpmsg_device(&rvdev);

failed:
	LOG_ERR("vring / rpmsg vdev init failed");
	rproc_virtio_remove_vdev(vdev);
	return NULL;
}

/* The A55 asked for a link reset (it wrote vdev.status = 0 and kicked, ahead
 * of re-creating its virtio driver and zeroing both vrings): tear the virtio
 * device down and acknowledge with an EVEN epoch so the next attach starts
 * from fresh ring indices on both sides. */
static void link_reset(void)
{
	/* rpmsg_deinit_vdev() NULLs rvdev.vdev, so take it first or
	 * rproc_virtio_remove_vdev() frees nothing. */
	struct virtio_device *vdev = rvdev.vdev;

	k_mutex_lock(&send_lock, K_FOREVER);
	atomic_set(&link_resetting, 1);
	/* An empty name skips the name-service destroy announcement
	 * rpmsg_destroy_ept() would queue onto the old A55 ring (the A55 is
	 * about to zero it). */
	ept.name[0] = '\0';
	rpmsg_deinit_vdev(&rvdev);
	rproc_virtio_remove_vdev(vdev);
	k_mutex_unlock(&send_lock);
	/* vdev.status is deliberately NOT written: the A55 already wrote 0, and a
	 * store from this side could overwrite a DRIVER_OK it has since set. */

	/* Datagrams and the peer token belong to the old session; the new bridge
	 * says "hello" again.  A stale doorbell would be read against the new vdev. */
	k_msgq_purge(&rx_q);
	k_sem_reset(&peer_sem);
	k_sem_reset(&doorbell_sem);
	atomic_set(&link_resetting, 0);
	alp_v2n_beacon_epoch_bump(); /* odd -> even: waiting; the A55 may proceed */
}

/* Manager thread: one pass per A55 attach.  Bring the vdev up, create the
 * endpoint, then turn every A55 doorbell into an rproc_virtio_notified() so
 * ept_rx_cb() runs, until the A55 resets the link. */
static void link_task(void *a, void *b, void *c)
{
	ARG_UNUSED(a);
	ARG_UNUSED(b);
	ARG_UNUSED(c);

	for (;;) {
		rpdev = create_rpmsg_vdev();
		if (!rpdev) {
			return;
		}
		/* Create the endpoint BEFORE the receive loop so the A55's first frame
		 * is not dropped for want of a matching endpoint (rpmsg-v2n #697). */
		if (rpmsg_create_ept(
		        &ept, rpdev, "rpmsg-service-0", APP_EPT_ADDR, RPMSG_ADDR_ANY, ept_rx_cb, NULL)) {
			LOG_ERR("failed to create endpoint");
			link_reset(); /* odd -> even: no longer bound */
			return;
		}
		LOG_INF("rpmsg link up, waiting for the A55 bridge");
		for (;;) {
			if (k_sem_take(&doorbell_sem, K_FOREVER) != 0) {
				continue;
			}
			/* No DRIVER_OK = the A55 is resetting the link ahead of zeroing the
			 * vrings.  rproc_virtio_notified() never looks at the status, so check
			 * here, before it walks a ring the A55 is about to reset. */
			uint8_t status = 0;
			(void)virtio_get_status(rvdev.vdev, &status);
			if ((status & VIRTIO_CONFIG_STATUS_DRIVER_OK) == 0U) {
				break;
			}
			rproc_virtio_notified(rvdev.vdev, VRING1_ID);
		}
		LOG_INF("A55 reset the link; waiting for the next attach");
		link_reset();
	}
}

int rpmsg_link_start(void)
{
	/* First action, ahead of OpenAMP/libmetal init: the A55 backend refuses to
	 * open without the magic, and a bench read that catches this firmware
	 * mid-fault still sees "alive, once". */
	alp_v2n_beacon_start();

	if (platform_init() != 0) {
		return -1;
	}
	k_thread_create(&link_thread,
	                link_stack,
	                LINK_STACK_SIZE,
	                link_task,
	                NULL,
	                NULL,
	                NULL,
	                K_PRIO_COOP(8),
	                0,
	                K_NO_WAIT);
	return 0;
}

int rpmsg_link_wait_peer(int32_t timeout_ms)
{
	k_timeout_t t = timeout_ms < 0 ? K_FOREVER : K_MSEC(timeout_ms);

	if (k_sem_take(&peer_sem, t) != 0) {
		return -1;
	}
	/* Put the token back: once the peer is known it stays known (limit 1),
	 * so re-opening the transport after an XRCE session reset returns at once. */
	k_sem_give(&peer_sem);
	return 0;
}

size_t rpmsg_link_send(const uint8_t *data, size_t len)
{
	uint8_t frame[XRCE_METHOD_LEN + RPMSG_LINK_MTU];

	if (len == 0 || len > RPMSG_LINK_MTU) {
		return 0;
	}
	memcpy(frame, XRCE_METHOD, XRCE_METHOD_LEN);
	memcpy(frame + XRCE_METHOD_LEN, data, len);

	/* rpmsg_trysend() never sleeps for a TX buffer, so the lock is held only
	 * briefly and link_reset() is never stalled past the A55 attach ack
	 * timeout.  Back-pressure is waited out here, outside the lock. */
	for (int tries = 0; tries < 1500; tries++) {
		int rc;

		k_mutex_lock(&send_lock, K_FOREVER);
		if (atomic_get(&link_resetting) != 0) {
			k_mutex_unlock(&send_lock);
			return 0;
		}
		rc = rpmsg_trysend(&ept, frame, XRCE_METHOD_LEN + len);
		k_mutex_unlock(&send_lock);
		if (rc > 0) {
			return len;
		}
		if (rc != RPMSG_ERR_NO_BUFF) {
			return 0;
		}
		k_msleep(10);
	}
	return 0;
}

size_t rpmsg_link_recv(uint8_t *buf, size_t cap, int timeout_ms)
{
	struct datagram d;

	if (k_msgq_get(&rx_q, &d, timeout_ms < 0 ? K_FOREVER : K_MSEC(timeout_ms)) != 0) {
		return 0;
	}
	if (d.len > cap) {
		LOG_WRN("datagram %u B > read buffer %u B, dropped", d.len, (unsigned)cap);
		return 0;
	}
	memcpy(buf, d.data, d.len);
	return d.len;
}
```

## src/rpmsg_link.h
```c
/*
 * Copyright 2026 Alp Lab AB
 * SPDX-License-Identifier: Apache-2.0
 *
 * rpmsg_link -- a datagram pipe from the Cortex-M33 to the A55 over the
 * ADR 0016 RPMsg channel.  main.c's micro-ROS transport callbacks sit on
 * top of these four calls and know nothing about OpenAMP.
 */

#ifndef RPMSG_LINK_H
#define RPMSG_LINK_H

#include <stddef.h>
#include <stdint.h>

/** Largest datagram rpmsg_link_send() accepts / rpmsg_link_recv() can return.
 *  RPMsg buffers are 512 B with a 16 B header = 496 B on the wire, minus the
 *  5-byte "xrce\0" method header of the <alp/rpc.h> framing. */
#define RPMSG_LINK_MTU 491

/** Bring up libmetal + the rpmsg vdev on a manager thread.  0 on success. */
int rpmsg_link_start(void);

/** Block until the A55 bridge has sent its first frame (the M33 is the rpmsg
 *  slave: it cannot address the A55 until it has heard from it).
 *  @return 0 when the peer is known, -1 on timeout (@p timeout_ms < 0 = forever). */
int rpmsg_link_wait_peer(int32_t timeout_ms);

/** Send one datagram (<= RPMSG_LINK_MTU).  @return bytes sent, 0 on error. */
size_t rpmsg_link_send(const uint8_t *data, size_t len);

/** Receive one datagram, waiting up to @p timeout_ms (< 0 = forever).
 *  @return bytes received, 0 on timeout (or a datagram larger than @p cap,
 *  which is dropped). */
size_t rpmsg_link_recv(uint8_t *buf, size_t cap, int timeout_ms);

#endif /* RPMSG_LINK_H */
```
